ASAP2_VERSION 1 61
/begin PROJECT Econtrols_4G "4G Test"
/begin HEADER "4G A2L Configuration" PROJECT_NO EControls4G /* config for version control */ VERSION "$Revision: 82130 $:" /* config for version control */ /end HEADER
/begin MODULE EControls_4G_SH2A "EControls 4G"
/begin MOD_COMMON "" DEPOSIT ABSOLUTE BYTE_ORDER MSB_FIRST /end MOD_COMMON
/* Define the Record Layouts */
/begin RECORD_LAYOUT ECIPP_ALIGNMENT_UBYTE FNC_VALUES 1 UBYTE COLUMN_DIR DIRECT /end RECORD_LAYOUT
/begin RECORD_LAYOUT ECIPP_ALIGNMENT_UWORD FNC_VALUES 1 UWORD COLUMN_DIR DIRECT /end RECORD_LAYOUT
/begin RECORD_LAYOUT ECIPP_ALIGNMENT_ULONG FNC_VALUES 1 ULONG COLUMN_DIR DIRECT /end RECORD_LAYOUT
/begin RECORD_LAYOUT ECIPP_ALIGNMENT_FLOAT32_IEEE FNC_VALUES 1 FLOAT32_IEEE COLUMN_DIR DIRECT /end RECORD_LAYOUT
/begin COMPU_METHOD Compu_IDENTITY "Discrete Values " /* Identifier */ IDENTICAL "%.0" /* Format */ "-" /* Units */ /end COMPU_METHOD
/begin CHARACTERISTIC FCdc4_J1939_TSC1_chksum "FCtl_DTC_0x04(792)" VALUE 0x001E46C6 /* @ECU_Address@FCtl_DTC_0x04@0x024C4630@ */ ECIPP_ALIGNMENT_UWORD 65535 Compu_IDENTITY 0 65535 PHYS_UNIT "System ID + DTC" /end CHARACTERISTIC
/begin CHARACTERISTIC FCdc4_J1939_TSC1_cntr "FCtl_DTC_0x04(791)" VALUE 0x001E46C4 /* @ECU_Address@FCtl_DTC_0x04@0x024C462E@ */ ECIPP_ALIGNMENT_UWORD 65535 Compu_IDENTITY 0 65535 PHYS_UNIT "System ID + DTC" /end CHARACTERISTIC
/begin CHARACTERISTIC FCdc4_J1939_TSC1_loss "FCtl_DTC_0x04(217)" VALUE 0x001E4248 /* @ECU_Address@FCtl_DTC_0x04@0x024C41B2@ */ ECIPP_ALIGNMENT_UWORD 65535 Compu_IDENTITY 0 65535 PHYS_UNIT "System ID + DTC" /end CHARACTERISTIC
/begin CHARACTERISTIC FCdc4_J1939_Tx2Fail "FCtl_DTC_0x04(297)" VALUE 0x001E42E8 /* @ECU_Address@FCtl_DTC_0x04@0x024C4252@ */ ECIPP_ALIGNMENT_UWORD 65535 Compu_IDENTITY 0 65535 PHYS_UNIT "System ID + DTC" /end CHARACTERISTIC
/begin CHARACTERISTIC FCdc4_J1939_Tx3Fail "FCtl_DTC_0x04(298)" VALUE 0x001E42EA /* @ECU_Address@FCtl_DTC_0x04@0x024C4254@ */ ECIPP_ALIGNMENT_UWORD 65535 Compu_IDENTITY 0 65535 PHYS_UNIT "System ID + DTC" /end CHARACTERISTIC
/begin CHARACTERISTIC FCdc4_J1939_TxFail "FCtl_DTC_0x04(154)" VALUE 0x001E41CA /* @ECU_Address@FCtl_DTC_0x04@0x024C4134@ */ ECIPP_ALIGNMENT_UWORD 65535 Compu_IDENTITY 0 65535 PHYS_UNIT "System ID + DTC" /end CHARACTERISTIC
/begin CHARACTERISTIC FCdc4_KNK_max "FCtl_DTC_0x04(107)" VALUE 0x001E416C /* @ECU_Address@FCtl_DTC_0x04@0x024C40D6@ */ ECIPP_ALIGNMENT_UWORD 65535 Compu_IDENTITY 0 65535 PHYS_UNIT "System ID + DTC" /end CHARACTERISTIC
/begin CHARACTERISTIC FCdc4_KNK_min "FCtl_DTC_0x04(89)" VALUE 0x001E4148 /* @ECU_Address@FCtl_DTC_0x04@0x024C40B2@ */ ECIPP_ALIGNMENT_UWORD 65535 Compu_IDENTITY 0 65535 PHYS_UNIT "System ID + DTC" /end CHARACTERISTIC
/begin CHARACTERISTIC FCdc4_KNK_retardlmt "FCtl_DTC_0x04(504)" VALUE 0x001E4486 /* @ECU_Address@FCtl_DTC_0x04@0x024C43F0@ */ ECIPP_ALIGNMENT_UWORD 65535 Compu_IDENTITY 0 65535 PHYS_UNIT "System ID + DTC" /end CHARACTERISTIC
/begin CHARACTERISTIC FCdc4_KNK_retardlmt2 "FCtl_DTC_0x04(698)" VALUE 0x001E460A /* @ECU_Address@FCtl_DTC_0x04@0x024C4574@ */ ECIPP_ALIGNMENT_UWORD 65535 Compu_IDENTITY 0 65535 PHYS_UNIT "System ID + DTC" /end CHARACTERISTIC
/begin CHARACTERISTIC FCdc4_KV1_deltaHi "FCtl_DTC_0x04(961)" VALUE 0x001E4818 /* @ECU_Address@FCtl_DTC_0x04@0x024C4782@ */ ECIPP_ALIGNMENT_UWORD 65535 Compu_IDENTITY 0 65535 PHYS_UNIT "System ID + DTC" /end CHARACTERISTIC
/begin CHARACTERISTIC FCdc4_KV1_deltaLo "FCtl_DTC_0x04(973)" VALUE 0x001E4830 /* @ECU_Address@FCtl_DTC_0x04@0x024C479A@ */ ECIPP_ALIGNMENT_UWORD 65535 Compu_IDENTITY 0 65535 PHYS_UNIT "System ID + DTC" /end CHARACTERISTIC
/begin CHARACTERISTIC FCdc4_KV1_high "FCtl_DTC_0x04(877)" VALUE 0x001E4770 /* @ECU_Address@FCtl_DTC_0x04@0x024C46DA@ */ ECIPP_ALIGNMENT_UWORD 65535 Compu_IDENTITY 0 65535 PHYS_UNIT "System ID + DTC" /end CHARACTERISTIC
/begin CHARACTERISTIC FCdc4_KV1_low "FCtl_DTC_0x04(889)" VALUE 0x001E4788 /* @ECU_Address@FCtl_DTC_0x04@0x024C46F2@ */ ECIPP_ALIGNMENT_UWORD 65535 Compu_IDENTITY 0 65535 PHYS_UNIT "System ID + DTC" /end CHARACTERISTIC
/begin CHARACTERISTIC FCdc4_LOD_flk "FCtl_DTC_0x04(736)" VALUE 0x001E4656 /* @ECU_Address@FCtl_DTC_0x04@0x024C45C0@ */ ECIPP_ALIGNMENT_UWORD 65535 Compu_IDENTITY 0 65535 PHYS_UNIT "System ID + DTC" /end CHARACTERISTIC
/begin CHARACTERISTIC FCdc4_LOD_FROmax "FCtl_DTC_0x04(218)" VALUE 0x001E424A /* @ECU_Address@FCtl_DTC_0x04@0x024C41B4@ */ ECIPP_ALIGNMENT_UWORD 65535 Compu_IDENTITY 0 65535 PHYS_UNIT "System ID + DTC" /end CHARACTERISTIC
/begin CHARACTERISTIC FCdc4_LOD_slk "FCtl_DTC_0x04(735)" VALUE 0x001E4654 /* @ECU_Address@FCtl_DTC_0x04@0x024C45BE@ */ ECIPP_ALIGNMENT_UWORD 65535 Compu_IDENTITY 0 65535 PHYS_UNIT "System ID + DTC" /end CHARACTERISTIC
/begin CHARACTERISTIC FCdc4_low_fuel_mon "FCtl_DTC_0x04(1015)" VALUE 0x001E4884 /* @ECU_Address@FCtl_DTC_0x04@0x024C47EE@ */ ECIPP_ALIGNMENT_UWORD 65535 Compu_IDENTITY 0 65535 PHYS_UNIT "System ID + DTC" /end CHARACTERISTIC
/begin CHARACTERISTIC FCdc4_LowCLTemp "FCtl_DTC_0x04(650)" VALUE 0x001E45AA /* @ECU_Address@FCtl_DTC_0x04@0x024C4514@ */ ECIPP_ALIGNMENT_UWORD 65535 Compu_IDENTITY 0 65535 PHYS_UNIT "System ID + DTC" /end CHARACTERISTIC
/begin CHARACTERISTIC FCdc4_LowDiagTemp "FCtl_DTC_0x04(651)" VALUE 0x001E45AC /* @ECU_Address@FCtl_DTC_0x04@0x024C4516@ */ ECIPP_ALIGNMENT_UWORD 65535 Compu_IDENTITY 0 65535 PHYS_UNIT "System ID + DTC" /end CHARACTERISTIC
/begin CHARACTERISTIC FCdc4_LowOperTemp "FCtl_DTC_0x04(407)" VALUE 0x001E43C4 /* @ECU_Address@FCtl_DTC_0x04@0x024C432E@ */ ECIPP_ALIGNMENT_UWORD 65535 Compu_IDENTITY 0 65535 PHYS_UNIT "System ID + DTC" /end CHARACTERISTIC
/begin CHARACTERISTIC FCdc4_MAP_HiExp "FCtl_DTC_0x04(519)" VALUE 0x001E44A4 /* @ECU_Address@FCtl_DTC_0x04@0x024C440E@ */ ECIPP_ALIGNMENT_UWORD 65535 Compu_IDENTITY 0 65535 PHYS_UNIT "System ID + DTC" /end CHARACTERISTIC
/begin CHARACTERISTIC FCdc4_MAP_max "FCtl_DTC_0x04(0)" VALUE 0x001E4096 /* @ECU_Address@FCtl_DTC_0x04@0x024C4000@ */ ECIPP_ALIGNMENT_UWORD 65535 Compu_IDENTITY 0 65535 PHYS_UNIT "System ID + DTC" /end CHARACTERISTIC
/begin CHARACTERISTIC FCdc4_MAP_minv "FCtl_DTC_0x04(1)" VALUE 0x001E4098 /* @ECU_Address@FCtl_DTC_0x04@0x024C4002@ */ ECIPP_ALIGNMENT_UWORD 65535 Compu_IDENTITY 0 65535 PHYS_UNIT "System ID + DTC" /end CHARACTERISTIC
/begin CHARACTERISTIC FCdc4_MFA_ctout "FCtl_DTC_0x04(759)" VALUE 0x001E4684 /* @ECU_Address@FCtl_DTC_0x04@0x024C45EE@ */ ECIPP_ALIGNMENT_UWORD 65535 Compu_IDENTITY 0 65535 PHYS_UNIT "System ID + DTC" /end CHARACTERISTIC
/begin CHARACTERISTIC FCdc4_MFA_hi_flow "FCtl_DTC_0x04(857)" VALUE 0x001E4748 /* @ECU_Address@FCtl_DTC_0x04@0x024C46B2@ */ ECIPP_ALIGNMENT_UWORD 65535 Compu_IDENTITY 0 65535 PHYS_UNIT "System ID + DTC" /end CHARACTERISTIC
/begin CHARACTERISTIC FCdc4_MFA_hsd_comm "FCtl_DTC_0x04(762)" VALUE 0x001E468A /* @ECU_Address@FCtl_DTC_0x04@0x024C45F4@ */ ECIPP_ALIGNMENT_UWORD 65535 Compu_IDENTITY 0 65535 PHYS_UNIT "System ID + DTC" /end CHARACTERISTIC
/begin CHARACTERISTIC FCdc4_MFA_intF_circ "FCtl_DTC_0x04(760)" VALUE 0x001E4686 /* @ECU_Address@FCtl_DTC_0x04@0x024C45F0@ */ ECIPP_ALIGNMENT_UWORD 65535 Compu_IDENTITY 0 65535 PHYS_UNIT "System ID + DTC" /end CHARACTERISTIC
/begin CHARACTERISTIC FCdc4_MFA_intF_DP_V_max "FCtl_DTC_0x04(788)" VALUE 0x001E46BE /* @ECU_Address@FCtl_DTC_0x04@0x024C4628@ */ ECIPP_ALIGNMENT_UWORD 65535 Compu_IDENTITY 0 65535 PHYS_UNIT "System ID + DTC" /end CHARACTERISTIC
/begin CHARACTERISTIC FCdc4_MFA_intF_DP_V_min "FCtl_DTC_0x04(789)" VALUE 0x001E46C0 /* @ECU_Address@FCtl_DTC_0x04@0x024C462A@ */ ECIPP_ALIGNMENT_UWORD 65535 Compu_IDENTITY 0 65535 PHYS_UNIT "System ID + DTC" /end CHARACTERISTIC
/begin CHARACTERISTIC FCdc4_MFA_intF_DSPress_V_max "FCtl_DTC_0x04(786)" VALUE 0x001E46BA /* @ECU_Address@FCtl_DTC_0x04@0x024C4624@ */ ECIPP_ALIGNMENT_UWORD 65535 Compu_IDENTITY 0 65535 PHYS_UNIT "System ID + DTC" /end CHARACTERISTIC
/begin CHARACTERISTIC FCdc4_MFA_intF_DSPress_V_min "FCtl_DTC_0x04(787)" VALUE 0x001E46BC /* @ECU_Address@FCtl_DTC_0x04@0x024C4626@ */ ECIPP_ALIGNMENT_UWORD 65535 Compu_IDENTITY 0 65535 PHYS_UNIT "System ID + DTC" /end CHARACTERISTIC
/begin CHARACTERISTIC FCdc4_MFA_intF_FTemp_V_max "FCtl_DTC_0x04(782)" VALUE 0x001E46B2 /* @ECU_Address@FCtl_DTC_0x04@0x024C461C@ */ ECIPP_ALIGNMENT_UWORD 65535 Compu_IDENTITY 0 65535 PHYS_UNIT "System ID + DTC" /end CHARACTERISTIC
/begin CHARACTERISTIC FCdc4_MFA_intF_FTemp_V_min "FCtl_DTC_0x04(783)" VALUE 0x001E46B4 /* @ECU_Address@FCtl_DTC_0x04@0x024C461E@ */ ECIPP_ALIGNMENT_UWORD 65535 Compu_IDENTITY 0 65535 PHYS_UNIT "System ID + DTC" /end CHARACTERISTIC
/begin CHARACTERISTIC FCdc4_MFA_intF_general "FCtl_DTC_0x04(790)" VALUE 0x001E46C2 /* @ECU_Address@FCtl_DTC_0x04@0x024C462C@ */ ECIPP_ALIGNMENT_UWORD 65535 Compu_IDENTITY 0 65535 PHYS_UNIT "System ID + DTC" /end CHARACTERISTIC
/begin CHARACTERISTIC FCdc4_MFA_intF_Tposerr_n "FCtl_DTC_0x04(779)" VALUE 0x001E46AC /* @ECU_Address@FCtl_DTC_0x04@0x024C4616@ */ ECIPP_ALIGNMENT_UWORD 65535 Compu_IDENTITY 0 65535 PHYS_UNIT "System ID + DTC" /end CHARACTERISTIC
/begin CHARACTERISTIC FCdc4_MFA_intF_Tposerr_p "FCtl_DTC_0x04(778)" VALUE 0x001E46AA /* @ECU_Address@FCtl_DTC_0x04@0x024C4614@ */ ECIPP_ALIGNMENT_UWORD 65535 Compu_IDENTITY 0 65535 PHYS_UNIT "System ID + DTC" /end CHARACTERISTIC
/begin CHARACTERISTIC FCdc4_MFA_intF_USPress_V_max "FCtl_DTC_0x04(784)" VALUE 0x001E46B6 /* @ECU_Address@FCtl_DTC_0x04@0x024C4620@ */ ECIPP_ALIGNMENT_UWORD 65535 Compu_IDENTITY 0 65535 PHYS_UNIT "System ID + DTC" /end CHARACTERISTIC
/begin CHARACTERISTIC FCdc4_MFA_intF_USPress_V_min "FCtl_DTC_0x04(785)" VALUE 0x001E46B8 /* @ECU_Address@FCtl_DTC_0x04@0x024C4622@ */ ECIPP_ALIGNMENT_UWORD 65535 Compu_IDENTITY 0 65535 PHYS_UNIT "System ID + DTC" /end CHARACTERISTIC
/begin CHARACTERISTIC FCdc4_MFA_intF_Vbat_max "FCtl_DTC_0x04(780)" VALUE 0x001E46AE /* @ECU_Address@FCtl_DTC_0x04@0x024C4618@ */ ECIPP_ALIGNMENT_UWORD 65535 Compu_IDENTITY 0 65535 PHYS_UNIT "System ID + DTC" /end CHARACTERISTIC
/begin CHARACTERISTIC FCdc4_MFA_intF_Vbat_min "FCtl_DTC_0x04(781)" VALUE 0x001E46B0 /* @ECU_Address@FCtl_DTC_0x04@0x024C461A@ */ ECIPP_ALIGNMENT_UWORD 65535 Compu_IDENTITY 0 65535 PHYS_UNIT "System ID + DTC" /end CHARACTERISTIC
/begin CHARACTERISTIC FCdc4_MFA_lo_flow "FCtl_DTC_0x04(856)" VALUE 0x001E4746 /* @ECU_Address@FCtl_DTC_0x04@0x024C46B0@ */ ECIPP_ALIGNMENT_UWORD 65535 Compu_IDENTITY 0 65535 PHYS_UNIT "System ID + DTC" /end CHARACTERISTIC
/begin CHARACTERISTIC FCdc4_MFG_ctout "FCtl_DTC_0x04(757)" VALUE 0x001E4680 /* @ECU_Address@FCtl_DTC_0x04@0x024C45EA@ */ ECIPP_ALIGNMENT_UWORD 65535 Compu_IDENTITY 0 65535 PHYS_UNIT "System ID + DTC" /end CHARACTERISTIC
/begin CHARACTERISTIC FCdc4_MFG_hi_flow "FCtl_DTC_0x04(859)" VALUE 0x001E474C /* @ECU_Address@FCtl_DTC_0x04@0x024C46B6@ */ ECIPP_ALIGNMENT_UWORD 65535 Compu_IDENTITY 0 65535 PHYS_UNIT "System ID + DTC" /end CHARACTERISTIC
/begin CHARACTERISTIC FCdc4_MFG_hsd_comm "FCtl_DTC_0x04(761)" VALUE 0x001E4688 /* @ECU_Address@FCtl_DTC_0x04@0x024C45F2@ */ ECIPP_ALIGNMENT_UWORD 65535 Compu_IDENTITY 0 65535 PHYS_UNIT "System ID + DTC" /end CHARACTERISTIC
/begin CHARACTERISTIC FCdc4_MFG_intF_circ "FCtl_DTC_0x04(758)" VALUE 0x001E4682 /* @ECU_Address@FCtl_DTC_0x04@0x024C45EC@ */ ECIPP_ALIGNMENT_UWORD 65535 Compu_IDENTITY 0 65535 PHYS_UNIT "System ID + DTC" /end CHARACTERISTIC
/begin CHARACTERISTIC FCdc4_MFG_intF_DP_V_max "FCtl_DTC_0x04(775)" VALUE 0x001E46A4 /* @ECU_Address@FCtl_DTC_0x04@0x024C460E@ */ ECIPP_ALIGNMENT_UWORD 65535 Compu_IDENTITY 0 65535 PHYS_UNIT "System ID + DTC" /end CHARACTERISTIC
/begin CHARACTERISTIC FCdc4_MFG_intF_DP_V_min "FCtl_DTC_0x04(776)" VALUE 0x001E46A6 /* @ECU_Address@FCtl_DTC_0x04@0x024C4610@ */ ECIPP_ALIGNMENT_UWORD 65535 Compu_IDENTITY 0 65535 PHYS_UNIT "System ID + DTC" /end CHARACTERISTIC
/begin CHARACTERISTIC FCdc4_MFG_intF_DPzVolt_V_max "FCtl_DTC_0x04(773)" VALUE 0x001E46A0 /* @ECU_Address@FCtl_DTC_0x04@0x024C460A@ */ ECIPP_ALIGNMENT_UWORD 65535 Compu_IDENTITY 0 65535 PHYS_UNIT "System ID + DTC" /end CHARACTERISTIC
/begin CHARACTERISTIC FCdc4_MFG_intF_DPzVolt_V_min "FCtl_DTC_0x04(774)" VALUE 0x001E46A2 /* @ECU_Address@FCtl_DTC_0x04@0x024C460C@ */ ECIPP_ALIGNMENT_UWORD 65535 Compu_IDENTITY 0 65535 PHYS_UNIT "System ID + DTC" /end CHARACTERISTIC
/begin CHARACTERISTIC FCdc4_MFG_intF_DSPress_V_max "FCtl_DTC_0x04(771)" VALUE 0x001E469C /* @ECU_Address@FCtl_DTC_0x04@0x024C4606@ */ ECIPP_ALIGNMENT_UWORD 65535 Compu_IDENTITY 0 65535 PHYS_UNIT "System ID + DTC" /end CHARACTERISTIC
/begin CHARACTERISTIC FCdc4_MFG_intF_DSPress_V_min "FCtl_DTC_0x04(772)" VALUE 0x001E469E /* @ECU_Address@FCtl_DTC_0x04@0x024C4608@ */ ECIPP_ALIGNMENT_UWORD 65535 Compu_IDENTITY 0 65535 PHYS_UNIT "System ID + DTC" /end CHARACTERISTIC
/begin CHARACTERISTIC FCdc4_MFG_intF_FTemp_V_max "FCtl_DTC_0x04(767)" VALUE 0x001E4694 /* @ECU_Address@FCtl_DTC_0x04@0x024C45FE@ */ ECIPP_ALIGNMENT_UWORD 65535 Compu_IDENTITY 0 65535 PHYS_UNIT "System ID + DTC" /end CHARACTERISTIC
/begin CHARACTERISTIC FCdc4_MFG_intF_FTemp_V_min "FCtl_DTC_0x04(768)" VALUE 0x001E4696 /* @ECU_Address@FCtl_DTC_0x04@0x024C4600@ */ ECIPP_ALIGNMENT_UWORD 65535 Compu_IDENTITY 0 65535 PHYS_UNIT "System ID + DTC" /end CHARACTERISTIC
/begin CHARACTERISTIC FCdc4_MFG_intF_general "FCtl_DTC_0x04(777)" VALUE 0x001E46A8 /* @ECU_Address@FCtl_DTC_0x04@0x024C4612@ */ ECIPP_ALIGNMENT_UWORD 65535 Compu_IDENTITY 0 65535 PHYS_UNIT "System ID + DTC" /end CHARACTERISTIC
/begin CHARACTERISTIC FCdc4_MFG_intF_Tposerr_n "FCtl_DTC_0x04(764)" VALUE 0x001E468E /* @ECU_Address@FCtl_DTC_0x04@0x024C45F8@ */ ECIPP_ALIGNMENT_UWORD 65535 Compu_IDENTITY 0 65535 PHYS_UNIT "System ID + DTC" /end CHARACTERISTIC
/begin CHARACTERISTIC FCdc4_MFG_intF_Tposerr_p "FCtl_DTC_0x04(763)" VALUE 0x001E468C /* @ECU_Address@FCtl_DTC_0x04@0x024C45F6@ */ ECIPP_ALIGNMENT_UWORD 65535 Compu_IDENTITY 0 65535 PHYS_UNIT "System ID + DTC" /end CHARACTERISTIC
/begin CHARACTERISTIC FCdc4_MFG_intF_USPress_V_max "FCtl_DTC_0x04(769)" VALUE 0x001E4698 /* @ECU_Address@FCtl_DTC_0x04@0x024C4602@ */ ECIPP_ALIGNMENT_UWORD 65535 Compu_IDENTITY 0 65535 PHYS_UNIT "System ID + DTC" /end CHARACTERISTIC
/begin CHARACTERISTIC FCdc4_MFG_intF_USPress_V_min "FCtl_DTC_0x04(770)" VALUE 0x001E469A /* @ECU_Address@FCtl_DTC_0x04@0x024C4604@ */ ECIPP_ALIGNMENT_UWORD 65535 Compu_IDENTITY 0 65535 PHYS_UNIT "System ID + DTC" /end CHARACTERISTIC
/begin CHARACTERISTIC FCdc4_MFG_intF_Vbat_max "FCtl_DTC_0x04(765)" VALUE 0x001E4690 /* @ECU_Address@FCtl_DTC_0x04@0x024C45FA@ */ ECIPP_ALIGNMENT_UWORD 65535 Compu_IDENTITY 0 65535 PHYS_UNIT "System ID + DTC" /end CHARACTERISTIC
/begin CHARACTERISTIC FCdc4_MFG_intF_Vbat_min "FCtl_DTC_0x04(766)" VALUE 0x001E4692 /* @ECU_Address@FCtl_DTC_0x04@0x024C45FC@ */ ECIPP_ALIGNMENT_UWORD 65535 Compu_IDENTITY 0 65535 PHYS_UNIT "System ID + DTC" /end CHARACTERISTIC
/begin CHARACTERISTIC FCdc4_MFG_lo_flow "FCtl_DTC_0x04(858)" VALUE 0x001E474A /* @ECU_Address@FCtl_DTC_0x04@0x024C46B4@ */ ECIPP_ALIGNMENT_UWORD 65535 Compu_IDENTITY 0 65535 PHYS_UNIT "System ID + DTC" /end CHARACTERISTIC
/begin CHARACTERISTIC FCdc4_MFG_RLV_fail "FCtl_DTC_0x04(801)" VALUE 0x001E46D8 /* @ECU_Address@FCtl_DTC_0x04@0x024C4642@ */ ECIPP_ALIGNMENT_UWORD 65535 Compu_IDENTITY 0 65535 PHYS_UNIT "System ID + DTC" /end CHARACTERISTIC
/begin CHARACTERISTIC FCdc4_MIL_coilopen "FCtl_DTC_0x04(171)" VALUE 0x001E41EC /* @ECU_Address@FCtl_DTC_0x04@0x024C4156@ */ ECIPP_ALIGNMENT_UWORD 65535 Compu_IDENTITY 0 65535 PHYS_UNIT "System ID + DTC" /end CHARACTERISTIC
/begin CHARACTERISTIC FCdc4_MIL_coilshort "FCtl_DTC_0x04(172)" VALUE 0x001E41EE /* @ECU_Address@FCtl_DTC_0x04@0x024C4158@ */ ECIPP_ALIGNMENT_UWORD 65535 Compu_IDENTITY 0 65535 PHYS_UNIT "System ID + DTC" /end CHARACTERISTIC
/begin CHARACTERISTIC FCdc4_MIL_gndshort "FCtl_DTC_0x04(170)" VALUE 0x001E41EA /* @ECU_Address@FCtl_DTC_0x04@0x024C4154@ */ ECIPP_ALIGNMENT_UWORD 65535 Compu_IDENTITY 0 65535 PHYS_UNIT "System ID + DTC" /end CHARACTERISTIC
/begin CHARACTERISTIC FCdc4_MJ_comm_tout "FCtl_DTC_0x04(135)" VALUE 0x001E41A4 /* @ECU_Address@FCtl_DTC_0x04@0x024C410E@ */ ECIPP_ALIGNMENT_UWORD 65535 Compu_IDENTITY 0 65535 PHYS_UNIT "System ID + DTC" /end CHARACTERISTIC
/begin CHARACTERISTIC FCdc4_MJ_intF_act "FCtl_DTC_0x04(138)" VALUE 0x001E41AA /* @ECU_Address@FCtl_DTC_0x04@0x024C4114@ */ ECIPP_ALIGNMENT_UWORD 65535 Compu_IDENTITY 0 65535 PHYS_UNIT "System ID + DTC" /end CHARACTERISTIC
/begin CHARACTERISTIC FCdc4_MJ_intF_az "FCtl_DTC_0x04(287)" VALUE 0x001E42D4 /* @ECU_Address@FCtl_DTC_0x04@0x024C423E@ */ ECIPP_ALIGNMENT_UWORD 65535 Compu_IDENTITY 0 65535 PHYS_UNIT "System ID + DTC" /end CHARACTERISTIC
/begin CHARACTERISTIC FPnd_J1939_TSC1_chksum "FPrm_pending(622)" VALUE 0x001E55EE /* @ECU_Address@FPrm_pending@0x021BE4DC@ */ ECIPP_ALIGNMENT_UWORD 65535 Compu_IDENTITY 0 65535 PHYS_UNIT "Bit Mask" /end CHARACTERISTIC
/begin CHARACTERISTIC FPnd_J1939_TSC1_cntr "FPrm_pending(621)" VALUE 0x001E55EC /* @ECU_Address@FPrm_pending@0x021BE4DA@ */ ECIPP_ALIGNMENT_UWORD 65535 Compu_IDENTITY 0 65535 PHYS_UNIT "Bit Mask" /end CHARACTERISTIC
/begin CHARACTERISTIC FPnd_J1939_TSC1_loss "FPrm_pending(173)" VALUE 0x001E526C /* @ECU_Address@FPrm_pending@0x021BE15A@ */ ECIPP_ALIGNMENT_UWORD 65535 Compu_IDENTITY 0 65535 PHYS_UNIT "Bit Mask" /end CHARACTERISTIC
/begin CHARACTERISTIC FPnd_J1939_Tx2Fail "FPrm_pending(219)" VALUE 0x001E52C8 /* @ECU_Address@FPrm_pending@0x021BE1B6@ */ ECIPP_ALIGNMENT_UWORD 65535 Compu_IDENTITY 0 65535 PHYS_UNIT "Bit Mask" /end CHARACTERISTIC
/begin CHARACTERISTIC FPnd_J1939_Tx3Fail "FPrm_pending(220)" VALUE 0x001E52CA /* @ECU_Address@FPrm_pending@0x021BE1B8@ */ ECIPP_ALIGNMENT_UWORD 65535 Compu_IDENTITY 0 65535 PHYS_UNIT "Bit Mask" /end CHARACTERISTIC
/begin CHARACTERISTIC FPnd_J1939_TxFail "FPrm_pending(114)" VALUE 0x001E51F6 /* @ECU_Address@FPrm_pending@0x021BE0E4@ */ ECIPP_ALIGNMENT_UWORD 65535 Compu_IDENTITY 0 65535 PHYS_UNIT "Bit Mask" /end CHARACTERISTIC
/begin CHARACTERISTIC FPnd_KNK_max "FPrm_pending(13)" VALUE 0x001E512C /* @ECU_Address@FPrm_pending@0x021BE01A@ */ ECIPP_ALIGNMENT_UWORD 65535 Compu_IDENTITY 0 65535 PHYS_UNIT "Bit Mask" /end CHARACTERISTIC
/begin CHARACTERISTIC FPnd_KNK_min "FPrm_pending(12)" VALUE 0x001E512A /* @ECU_Address@FPrm_pending@0x021BE018@ */ ECIPP_ALIGNMENT_UWORD 65535 Compu_IDENTITY 0 65535 PHYS_UNIT "Bit Mask" /end CHARACTERISTIC
/begin CHARACTERISTIC FPnd_KNK_retardlmt "FPrm_pending(383)" VALUE 0x001E5410 /* @ECU_Address@FPrm_pending@0x021BE2FE@ */ ECIPP_ALIGNMENT_UWORD 65535 Compu_IDENTITY 0 65535 PHYS_UNIT "Bit Mask" /end CHARACTERISTIC
/begin CHARACTERISTIC FPnd_KNK_retardlmt2 "FPrm_pending(528)" VALUE 0x001E5532 /* @ECU_Address@FPrm_pending@0x021BE420@ */ ECIPP_ALIGNMENT_UWORD 65535 Compu_IDENTITY 0 65535 PHYS_UNIT "Bit Mask" /end CHARACTERISTIC
/begin CHARACTERISTIC FPnd_KV1_deltaHi "FPrm_pending(708)" VALUE 0x001E569A /* @ECU_Address@FPrm_pending@0x021BE588@ */ ECIPP_ALIGNMENT_UWORD 65535 Compu_IDENTITY 0 65535 PHYS_UNIT "Bit Mask" /end CHARACTERISTIC
/begin CHARACTERISTIC FPnd_KV1_deltaLo "FPrm_pending(709)" VALUE 0x001E569C /* @ECU_Address@FPrm_pending@0x021BE58A@ */ ECIPP_ALIGNMENT_UWORD 65535 Compu_IDENTITY 0 65535 PHYS_UNIT "Bit Mask" /end CHARACTERISTIC
/begin CHARACTERISTIC FPnd_KV1_high "FPrm_pending(701)" VALUE 0x001E568C /* @ECU_Address@FPrm_pending@0x021BE57A@ */ ECIPP_ALIGNMENT_UWORD 65535 Compu_IDENTITY 0 65535 PHYS_UNIT "Bit Mask" /end CHARACTERISTIC
/begin CHARACTERISTIC FPnd_KV1_low "FPrm_pending(702)" VALUE 0x001E568E /* @ECU_Address@FPrm_pending@0x021BE57C@ */ ECIPP_ALIGNMENT_UWORD 65535 Compu_IDENTITY 0 65535 PHYS_UNIT "Bit Mask" /end CHARACTERISTIC
/begin CHARACTERISTIC FPnd_LOD_flk "FPrm_pending(566)" VALUE 0x001E557E /* @ECU_Address@FPrm_pending@0x021BE46C@ */ ECIPP_ALIGNMENT_UWORD 65535 Compu_IDENTITY 0 65535 PHYS_UNIT "Bit Mask" /end CHARACTERISTIC
/begin CHARACTERISTIC FPnd_LOD_FROmax "FPrm_pending(174)" VALUE 0x001E526E /* @ECU_Address@FPrm_pending@0x021BE15C@ */ ECIPP_ALIGNMENT_UWORD 65535 Compu_IDENTITY 0 65535 PHYS_UNIT "Bit Mask" /end CHARACTERISTIC
/begin CHARACTERISTIC FPnd_LOD_slk "FPrm_pending(565)" VALUE 0x001E557C /* @ECU_Address@FPrm_pending@0x021BE46A@ */ ECIPP_ALIGNMENT_UWORD 65535 Compu_IDENTITY 0 65535 PHYS_UNIT "Bit Mask" /end CHARACTERISTIC
/begin CHARACTERISTIC FPnd_low_fuel_mon "FPrm_pending(711)" VALUE 0x001E56A0 /* @ECU_Address@FPrm_pending@0x021BE58E@ */ ECIPP_ALIGNMENT_UWORD 65535 Compu_IDENTITY 0 65535 PHYS_UNIT "Bit Mask" /end CHARACTERISTIC
/begin CHARACTERISTIC FPnd_LowCLTemp "FPrm_pending(480)" VALUE 0x001E54D2 /* @ECU_Address@FPrm_pending@0x021BE3C0@ */ ECIPP_ALIGNMENT_UWORD 65535 Compu_IDENTITY 0 65535 PHYS_UNIT "Bit Mask" /end CHARACTERISTIC
/begin CHARACTERISTIC FPnd_LowDiagTemp "FPrm_pending(481)" VALUE 0x001E54D4 /* @ECU_Address@FPrm_pending@0x021BE3C2@ */ ECIPP_ALIGNMENT_UWORD 65535 Compu_IDENTITY 0 65535 PHYS_UNIT "Bit Mask" /end CHARACTERISTIC
/begin CHARACTERISTIC FPnd_LowOperTemp "FPrm_pending(316)" VALUE 0x001E538A /* @ECU_Address@FPrm_pending@0x021BE278@ */ ECIPP_ALIGNMENT_UWORD 65535 Compu_IDENTITY 0 65535 PHYS_UNIT "Bit Mask" /end CHARACTERISTIC
/begin CHARACTERISTIC FPnd_MAP_HiExp "FPrm_pending(389)" VALUE 0x001E541C /* @ECU_Address@FPrm_pending@0x021BE30A@ */ ECIPP_ALIGNMENT_UWORD 65535 Compu_IDENTITY 0 65535 PHYS_UNIT "Bit Mask" /end CHARACTERISTIC
/begin CHARACTERISTIC FPnd_MAP_max "FPrm_pending(0)" VALUE 0x001E5112 /* @ECU_Address@FPrm_pending@0x021BE000@ */ ECIPP_ALIGNMENT_UWORD 65535 Compu_IDENTITY 0 65535 PHYS_UNIT "Bit Mask" /end CHARACTERISTIC
/begin CHARACTERISTIC FPnd_MAP_minv "FPrm_pending(1)" VALUE 0x001E5114 /* @ECU_Address@FPrm_pending@0x021BE002@ */ ECIPP_ALIGNMENT_UWORD 65535 Compu_IDENTITY 0 65535 PHYS_UNIT "Bit Mask" /end CHARACTERISTIC
/begin CHARACTERISTIC FPnd_MFA_ctout "FPrm_pending(589)" VALUE 0x001E55AC /* @ECU_Address@FPrm_pending@0x021BE49A@ */ ECIPP_ALIGNMENT_UWORD 65535 Compu_IDENTITY 0 65535 PHYS_UNIT "Bit Mask" /end CHARACTERISTIC
/begin CHARACTERISTIC FPnd_MFA_hi_flow "FPrm_pending(684)" VALUE 0x001E566A /* @ECU_Address@FPrm_pending@0x021BE558@ */ ECIPP_ALIGNMENT_UWORD 65535 Compu_IDENTITY 0 65535 PHYS_UNIT "Bit Mask" /end CHARACTERISTIC
/begin CHARACTERISTIC FPnd_MFA_hsd_comm "FPrm_pending(592)" VALUE 0x001E55B2 /* @ECU_Address@FPrm_pending@0x021BE4A0@ */ ECIPP_ALIGNMENT_UWORD 65535 Compu_IDENTITY 0 65535 PHYS_UNIT "Bit Mask" /end CHARACTERISTIC
/begin CHARACTERISTIC FPnd_MFA_intF_circ "FPrm_pending(590)" VALUE 0x001E55AE /* @ECU_Address@FPrm_pending@0x021BE49C@ */ ECIPP_ALIGNMENT_UWORD 65535 Compu_IDENTITY 0 65535 PHYS_UNIT "Bit Mask" /end CHARACTERISTIC
/begin CHARACTERISTIC FPnd_MFA_intF_DP_V_max "FPrm_pending(618)" VALUE 0x001E55E6 /* @ECU_Address@FPrm_pending@0x021BE4D4@ */ ECIPP_ALIGNMENT_UWORD 65535 Compu_IDENTITY 0 65535 PHYS_UNIT "Bit Mask" /end CHARACTERISTIC
/begin CHARACTERISTIC FPnd_MFA_intF_DP_V_min "FPrm_pending(619)" VALUE 0x001E55E8 /* @ECU_Address@FPrm_pending@0x021BE4D6@ */ ECIPP_ALIGNMENT_UWORD 65535 Compu_IDENTITY 0 65535 PHYS_UNIT "Bit Mask" /end CHARACTERISTIC
/begin CHARACTERISTIC FPnd_MFA_intF_DSPress_V_max "FPrm_pending(616)" VALUE 0x001E55E2 /* @ECU_Address@FPrm_pending@0x021BE4D0@ */ ECIPP_ALIGNMENT_UWORD 65535 Compu_IDENTITY 0 65535 PHYS_UNIT "Bit Mask" /end CHARACTERISTIC
/begin CHARACTERISTIC FPnd_MFA_intF_DSPress_V_min "FPrm_pending(617)" VALUE 0x001E55E4 /* @ECU_Address@FPrm_pending@0x021BE4D2@ */ ECIPP_ALIGNMENT_UWORD 65535 Compu_IDENTITY 0 65535 PHYS_UNIT "Bit Mask" /end CHARACTERISTIC
/begin CHARACTERISTIC FPnd_MFA_intF_FTemp_V_max "FPrm_pending(612)" VALUE 0x001E55DA /* @ECU_Address@FPrm_pending@0x021BE4C8@ */ ECIPP_ALIGNMENT_UWORD 65535 Compu_IDENTITY 0 65535 PHYS_UNIT "Bit Mask" /end CHARACTERISTIC
/begin CHARACTERISTIC FPnd_MFA_intF_FTemp_V_min "FPrm_pending(613)" VALUE 0x001E55DC /* @ECU_Address@FPrm_pending@0x021BE4CA@ */ ECIPP_ALIGNMENT_UWORD 65535 Compu_IDENTITY 0 65535 PHYS_UNIT "Bit Mask" /end CHARACTERISTIC
/begin CHARACTERISTIC FPnd_MFA_intF_general "FPrm_pending(620)" VALUE 0x001E55EA /* @ECU_Address@FPrm_pending@0x021BE4D8@ */ ECIPP_ALIGNMENT_UWORD 65535 Compu_IDENTITY 0 65535 PHYS_UNIT "Bit Mask" /end CHARACTERISTIC
/begin CHARACTERISTIC FPnd_MFA_intF_Tposerr_n "FPrm_pending(609)" VALUE 0x001E55D4 /* @ECU_Address@FPrm_pending@0x021BE4C2@ */ ECIPP_ALIGNMENT_UWORD 65535 Compu_IDENTITY 0 65535 PHYS_UNIT "Bit Mask" /end CHARACTERISTIC
/begin CHARACTERISTIC FPnd_MFA_intF_Tposerr_p "FPrm_pending(608)" VALUE 0x001E55D2 /* @ECU_Address@FPrm_pending@0x021BE4C0@ */ ECIPP_ALIGNMENT_UWORD 65535 Compu_IDENTITY 0 65535 PHYS_UNIT "Bit Mask" /end CHARACTERISTIC
/begin CHARACTERISTIC FPnd_MFA_intF_USPress_V_max "FPrm_pending(614)" VALUE 0x001E55DE /* @ECU_Address@FPrm_pending@0x021BE4CC@ */ ECIPP_ALIGNMENT_UWORD 65535 Compu_IDENTITY 0 65535 PHYS_UNIT "Bit Mask" /end CHARACTERISTIC
/begin CHARACTERISTIC FPnd_MFA_intF_USPress_V_min "FPrm_pending(615)" VALUE 0x001E55E0 /* @ECU_Address@FPrm_pending@0x021BE4CE@ */ ECIPP_ALIGNMENT_UWORD 65535 Compu_IDENTITY 0 65535 PHYS_UNIT "Bit Mask" /end CHARACTERISTIC
/begin CHARACTERISTIC FPnd_MFA_intF_Vbat_max "FPrm_pending(610)" VALUE 0x001E55D6 /* @ECU_Address@FPrm_pending@0x021BE4C4@ */ ECIPP_ALIGNMENT_UWORD 65535 Compu_IDENTITY 0 65535 PHYS_UNIT "Bit Mask" /end CHARACTERISTIC
/begin CHARACTERISTIC FPnd_MFA_intF_Vbat_min "FPrm_pending(611)" VALUE 0x001E55D8 /* @ECU_Address@FPrm_pending@0x021BE4C6@ */ ECIPP_ALIGNMENT_UWORD 65535 Compu_IDENTITY 0 65535 PHYS_UNIT "Bit Mask" /end CHARACTERISTIC
/begin CHARACTERISTIC FPnd_MFA_lo_flow "FPrm_pending(683)" VALUE 0x001E5668 /* @ECU_Address@FPrm_pending@0x021BE556@ */ ECIPP_ALIGNMENT_UWORD 65535 Compu_IDENTITY 0 65535 PHYS_UNIT "Bit Mask" /end CHARACTERISTIC
/begin CHARACTERISTIC FPnd_MFG_ctout "FPrm_pending(587)" VALUE 0x001E55A8 /* @ECU_Address@FPrm_pending@0x021BE496@ */ ECIPP_ALIGNMENT_UWORD 65535 Compu_IDENTITY 0 65535 PHYS_UNIT "Bit Mask" /end CHARACTERISTIC
/begin CHARACTERISTIC FPnd_MFG_hi_flow "FPrm_pending(686)" VALUE 0x001E566E /* @ECU_Address@FPrm_pending@0x021BE55C@ */ ECIPP_ALIGNMENT_UWORD 65535 Compu_IDENTITY 0 65535 PHYS_UNIT "Bit Mask" /end CHARACTERISTIC
/begin CHARACTERISTIC FPnd_MFG_hsd_comm "FPrm_pending(591)" VALUE 0x001E55B0 /* @ECU_Address@FPrm_pending@0x021BE49E@ */ ECIPP_ALIGNMENT_UWORD 65535 Compu_IDENTITY 0 65535 PHYS_UNIT "Bit Mask" /end CHARACTERISTIC
/begin CHARACTERISTIC FPnd_MFG_intF_circ "FPrm_pending(588)" VALUE 0x001E55AA /* @ECU_Address@FPrm_pending@0x021BE498@ */ ECIPP_ALIGNMENT_UWORD 65535 Compu_IDENTITY 0 65535 PHYS_UNIT "Bit Mask" /end CHARACTERISTIC
/begin CHARACTERISTIC FPnd_MFG_intF_DP_V_max "FPrm_pending(605)" VALUE 0x001E55CC /* @ECU_Address@FPrm_pending@0x021BE4BA@ */ ECIPP_ALIGNMENT_UWORD 65535 Compu_IDENTITY 0 65535 PHYS_UNIT "Bit Mask" /end CHARACTERISTIC
/begin CHARACTERISTIC FPnd_MFG_intF_DP_V_min "FPrm_pending(606)" VALUE 0x001E55CE /* @ECU_Address@FPrm_pending@0x021BE4BC@ */ ECIPP_ALIGNMENT_UWORD 65535 Compu_IDENTITY 0 65535 PHYS_UNIT "Bit Mask" /end CHARACTERISTIC
/begin CHARACTERISTIC FPnd_MFG_intF_DPzVolt_V_max "FPrm_pending(603)" VALUE 0x001E55C8 /* @ECU_Address@FPrm_pending@0x021BE4B6@ */ ECIPP_ALIGNMENT_UWORD 65535 Compu_IDENTITY 0 65535 PHYS_UNIT "Bit Mask" /end CHARACTERISTIC
/begin CHARACTERISTIC FPnd_MFG_intF_DPzVolt_V_min "FPrm_pending(604)" VALUE 0x001E55CA /* @ECU_Address@FPrm_pending@0x021BE4B8@ */ ECIPP_ALIGNMENT_UWORD 65535 Compu_IDENTITY 0 65535 PHYS_UNIT "Bit Mask" /end CHARACTERISTIC
/begin CHARACTERISTIC FPnd_MFG_intF_DSPress_V_max "FPrm_pending(601)" VALUE 0x001E55C4 /* @ECU_Address@FPrm_pending@0x021BE4B2@ */ ECIPP_ALIGNMENT_UWORD 65535 Compu_IDENTITY 0 65535 PHYS_UNIT "Bit Mask" /end CHARACTERISTIC
/begin CHARACTERISTIC FPnd_MFG_intF_DSPress_V_min "FPrm_pending(602)" VALUE 0x001E55C6 /* @ECU_Address@FPrm_pending@0x021BE4B4@ */ ECIPP_ALIGNMENT_UWORD 65535 Compu_IDENTITY 0 65535 PHYS_UNIT "Bit Mask" /end CHARACTERISTIC
/begin CHARACTERISTIC FPnd_MFG_intF_FTemp_V_max "FPrm_pending(597)" VALUE 0x001E55BC /* @ECU_Address@FPrm_pending@0x021BE4AA@ */ ECIPP_ALIGNMENT_UWORD 65535 Compu_IDENTITY 0 65535 PHYS_UNIT "Bit Mask" /end CHARACTERISTIC
/begin CHARACTERISTIC FPnd_MFG_intF_FTemp_V_min "FPrm_pending(598)" VALUE 0x001E55BE /* @ECU_Address@FPrm_pending@0x021BE4AC@ */ ECIPP_ALIGNMENT_UWORD 65535 Compu_IDENTITY 0 65535 PHYS_UNIT "Bit Mask" /end CHARACTERISTIC
/begin CHARACTERISTIC FPnd_MFG_intF_general "FPrm_pending(607)" VALUE 0x001E55D0 /* @ECU_Address@FPrm_pending@0x021BE4BE@ */ ECIPP_ALIGNMENT_UWORD 65535 Compu_IDENTITY 0 65535 PHYS_UNIT "Bit Mask" /end CHARACTERISTIC
/begin CHARACTERISTIC FPnd_MFG_intF_Tposerr_n "FPrm_pending(594)" VALUE 0x001E55B6 /* @ECU_Address@FPrm_pending@0x021BE4A4@ */ ECIPP_ALIGNMENT_UWORD 65535 Compu_IDENTITY 0 65535 PHYS_UNIT "Bit Mask" /end CHARACTERISTIC
/begin CHARACTERISTIC FPnd_MFG_intF_Tposerr_p "FPrm_pending(593)" VALUE 0x001E55B4 /* @ECU_Address@FPrm_pending@0x021BE4A2@ */ ECIPP_ALIGNMENT_UWORD 65535 Compu_IDENTITY 0 65535 PHYS_UNIT "Bit Mask" /end CHARACTERISTIC
/begin CHARACTERISTIC FPnd_MFG_intF_USPress_V_max "FPrm_pending(599)" VALUE 0x001E55C0 /* @ECU_Address@FPrm_pending@0x021BE4AE@ */ ECIPP_ALIGNMENT_UWORD 65535 Compu_IDENTITY 0 65535 PHYS_UNIT "Bit Mask" /end CHARACTERISTIC
/begin CHARACTERISTIC FPnd_MFG_intF_USPress_V_min "FPrm_pending(600)" VALUE 0x001E55C2 /* @ECU_Address@FPrm_pending@0x021BE4B0@ */ ECIPP_ALIGNMENT_UWORD 65535 Compu_IDENTITY 0 65535 PHYS_UNIT "Bit Mask" /end CHARACTERISTIC
/begin CHARACTERISTIC FPnd_MFG_intF_Vbat_max "FPrm_pending(595)" VALUE 0x001E55B8 /* @ECU_Address@FPrm_pending@0x021BE4A6@ */ ECIPP_ALIGNMENT_UWORD 65535 Compu_IDENTITY 0 65535 PHYS_UNIT "Bit Mask" /end CHARACTERISTIC
/begin CHARACTERISTIC FPnd_MFG_intF_Vbat_min "FPrm_pending(596)" VALUE 0x001E55BA /* @ECU_Address@FPrm_pending@0x021BE4A8@ */ ECIPP_ALIGNMENT_UWORD 65535 Compu_IDENTITY 0 65535 PHYS_UNIT "Bit Mask" /end CHARACTERISTIC
/begin CHARACTERISTIC FPnd_MFG_lo_flow "FPrm_pending(685)" VALUE 0x001E566C /* @ECU_Address@FPrm_pending@0x021BE55A@ */ ECIPP_ALIGNMENT_UWORD 65535 Compu_IDENTITY 0 65535 PHYS_UNIT "Bit Mask" /end CHARACTERISTIC
/begin CHARACTERISTIC FPnd_MFG_RLV_fail "FPrm_pending(630)" VALUE 0x001E55FE /* @ECU_Address@FPrm_pending@0x021BE4EC@ */ ECIPP_ALIGNMENT_UWORD 65535 Compu_IDENTITY 0 65535 PHYS_UNIT "Bit Mask" /end CHARACTERISTIC
/begin CHARACTERISTIC FPnd_MIL_coilopen "FPrm_pending(131)" VALUE 0x001E5218 /* @ECU_Address@FPrm_pending@0x021BE106@ */ ECIPP_ALIGNMENT_UWORD 65535 Compu_IDENTITY 0 65535 PHYS_UNIT "Bit Mask" /end CHARACTERISTIC
/begin CHARACTERISTIC FPnd_MIL_coilshort "FPrm_pending(132)" VALUE 0x001E521A /* @ECU_Address@FPrm_pending@0x021BE108@ */ ECIPP_ALIGNMENT_UWORD 65535 Compu_IDENTITY 0 65535 PHYS_UNIT "Bit Mask" /end CHARACTERISTIC
/begin CHARACTERISTIC FPnd_MIL_gndshort "FPrm_pending(130)" VALUE 0x001E5216 /* @ECU_Address@FPrm_pending@0x021BE104@ */ ECIPP_ALIGNMENT_UWORD 65535 Compu_IDENTITY 0 65535 PHYS_UNIT "Bit Mask" /end CHARACTERISTIC
/begin CHARACTERISTIC FPnd_MJ_comm_tout "FPrm_pending(94)" VALUE 0x001E51CE /* @ECU_Address@FPrm_pending@0x021BE0BC@ */ ECIPP_ALIGNMENT_UWORD 65535 Compu_IDENTITY 0 65535 PHYS_UNIT "Bit Mask" /end CHARACTERISTIC
/begin CHARACTERISTIC FPnd_MJ_intF_act "FPrm_pending(97)" VALUE 0x001E51D4 /* @ECU_Address@FPrm_pending@0x021BE0C2@ */ ECIPP_ALIGNMENT_UWORD 65535 Compu_IDENTITY 0 65535 PHYS_UNIT "Bit Mask" /end CHARACTERISTIC
/begin CHARACTERISTIC FPnd_MJ_intF_az "FPrm_pending(209)" VALUE 0x001E52B4 /* @ECU_Address@FPrm_pending@0x021BE1A2@ */ ECIPP_ALIGNMENT_UWORD 65535 Compu_IDENTITY 0 65535 PHYS_UNIT "Bit Mask" /end CHARACTERISTIC
/begin CHARACTERISTIC FPsvr_J1939_TSC1_chksum "FPrm_severity(622)" VALUE 0x001E6A83 /* @ECU_Address@FPrm_severity@0x024B326E@ */ ECIPP_ALIGNMENT_UBYTE 255 Compu_IDENTITY 0 255 PHYS_UNIT "Severity+Class" /end CHARACTERISTIC
/begin CHARACTERISTIC FPsvr_J1939_TSC1_cntr "FPrm_severity(621)" VALUE 0x001E6A82 /* @ECU_Address@FPrm_severity@0x024B326D@ */ ECIPP_ALIGNMENT_UBYTE 255 Compu_IDENTITY 0 255 PHYS_UNIT "Severity+Class" /end CHARACTERISTIC
/begin CHARACTERISTIC FPsvr_J1939_TSC1_loss "FPrm_severity(173)" VALUE 0x001E68C2 /* @ECU_Address@FPrm_severity@0x024B30AD@ */ ECIPP_ALIGNMENT_UBYTE 255 Compu_IDENTITY 0 255 PHYS_UNIT "Severity+Class" /end CHARACTERISTIC
/begin CHARACTERISTIC FPsvr_J1939_Tx2Fail "FPrm_severity(219)" VALUE 0x001E68F0 /* @ECU_Address@FPrm_severity@0x024B30DB@ */ ECIPP_ALIGNMENT_UBYTE 255 Compu_IDENTITY 0 255 PHYS_UNIT "Severity+Class" /end CHARACTERISTIC
/begin CHARACTERISTIC FPsvr_J1939_Tx3Fail "FPrm_severity(220)" VALUE 0x001E68F1 /* @ECU_Address@FPrm_severity@0x024B30DC@ */ ECIPP_ALIGNMENT_UBYTE 255 Compu_IDENTITY 0 255 PHYS_UNIT "Severity+Class" /end CHARACTERISTIC
/begin CHARACTERISTIC FPsvr_J1939_TxFail "FPrm_severity(114)" VALUE 0x001E6887 /* @ECU_Address@FPrm_severity@0x024B3072@ */ ECIPP_ALIGNMENT_UBYTE 255 Compu_IDENTITY 0 255 PHYS_UNIT "Severity+Class" /end CHARACTERISTIC
/begin CHARACTERISTIC FPsvr_KNK_max "FPrm_severity(13)" VALUE 0x001E6822 /* @ECU_Address@FPrm_severity@0x024B300D@ */ ECIPP_ALIGNMENT_UBYTE 255 Compu_IDENTITY 0 255 PHYS_UNIT "Severity+Class" /end CHARACTERISTIC
/begin CHARACTERISTIC FPsvr_KNK_min "FPrm_severity(12)" VALUE 0x001E6821 /* @ECU_Address@FPrm_severity@0x024B300C@ */ ECIPP_ALIGNMENT_UBYTE 255 Compu_IDENTITY 0 255 PHYS_UNIT "Severity+Class" /end CHARACTERISTIC
/begin CHARACTERISTIC FPsvr_KNK_retardlmt "FPrm_severity(383)" VALUE 0x001E6994 /* @ECU_Address@FPrm_severity@0x024B317F@ */ ECIPP_ALIGNMENT_UBYTE 255 Compu_IDENTITY 0 255 PHYS_UNIT "Severity+Class" /end CHARACTERISTIC
/begin CHARACTERISTIC FPsvr_KNK_retardlmt2 "FPrm_severity(528)" VALUE 0x001E6A25 /* @ECU_Address@FPrm_severity@0x024B3210@ */ ECIPP_ALIGNMENT_UBYTE 255 Compu_IDENTITY 0 255 PHYS_UNIT "Severity+Class" /end CHARACTERISTIC
/begin CHARACTERISTIC FPsvr_KV1_deltaHi "FPrm_severity(708)" VALUE 0x001E6AD9 /* @ECU_Address@FPrm_severity@0x024B32C4@ */ ECIPP_ALIGNMENT_UBYTE 255 Compu_IDENTITY 0 255 PHYS_UNIT "Severity+Class" /end CHARACTERISTIC
/begin CHARACTERISTIC FPsvr_KV1_deltaLo "FPrm_severity(709)" VALUE 0x001E6ADA /* @ECU_Address@FPrm_severity@0x024B32C5@ */ ECIPP_ALIGNMENT_UBYTE 255 Compu_IDENTITY 0 255 PHYS_UNIT "Severity+Class" /end CHARACTERISTIC
/begin CHARACTERISTIC FPsvr_KV1_high "FPrm_severity(701)" VALUE 0x001E6AD2 /* @ECU_Address@FPrm_severity@0x024B32BD@ */ ECIPP_ALIGNMENT_UBYTE 255 Compu_IDENTITY 0 255 PHYS_UNIT "Severity+Class" /end CHARACTERISTIC
/begin CHARACTERISTIC FPsvr_KV1_low "FPrm_severity(702)" VALUE 0x001E6AD3 /* @ECU_Address@FPrm_severity@0x024B32BE@ */ ECIPP_ALIGNMENT_UBYTE 255 Compu_IDENTITY 0 255 PHYS_UNIT "Severity+Class" /end CHARACTERISTIC
/begin CHARACTERISTIC FPsvr_LOD_flk "FPrm_severity(566)" VALUE 0x001E6A4B /* @ECU_Address@FPrm_severity@0x024B3236@ */ ECIPP_ALIGNMENT_UBYTE 255 Compu_IDENTITY 0 255 PHYS_UNIT "Severity+Class" /end CHARACTERISTIC
/begin CHARACTERISTIC FPsvr_LOD_FROmax "FPrm_severity(174)" VALUE 0x001E68C3 /* @ECU_Address@FPrm_severity@0x024B30AE@ */ ECIPP_ALIGNMENT_UBYTE 255 Compu_IDENTITY 0 255 PHYS_UNIT "Severity+Class" /end CHARACTERISTIC
/begin CHARACTERISTIC FPsvr_LOD_slk "FPrm_severity(565)" VALUE 0x001E6A4A /* @ECU_Address@FPrm_severity@0x024B3235@ */ ECIPP_ALIGNMENT_UBYTE 255 Compu_IDENTITY 0 255 PHYS_UNIT "Severity+Class" /end CHARACTERISTIC
/begin CHARACTERISTIC FPsvr_low_fuel_mon "FPrm_severity(711)" VALUE 0x001E6ADC /* @ECU_Address@FPrm_severity@0x024B32C7@ */ ECIPP_ALIGNMENT_UBYTE 255 Compu_IDENTITY 0 255 PHYS_UNIT "Severity+Class" /end CHARACTERISTIC
/begin CHARACTERISTIC FPsvr_LowCLTemp "FPrm_severity(480)" VALUE 0x001E69F5 /* @ECU_Address@FPrm_severity@0x024B31E0@ */ ECIPP_ALIGNMENT_UBYTE 255 Compu_IDENTITY 0 255 PHYS_UNIT "Severity+Class" /end CHARACTERISTIC
/begin CHARACTERISTIC FPsvr_LowDiagTemp "FPrm_severity(481)" VALUE 0x001E69F6 /* @ECU_Address@FPrm_severity@0x024B31E1@ */ ECIPP_ALIGNMENT_UBYTE 255 Compu_IDENTITY 0 255 PHYS_UNIT "Severity+Class" /end CHARACTERISTIC
/begin CHARACTERISTIC FPsvr_LowOperTemp "FPrm_severity(316)" VALUE 0x001E6951 /* @ECU_Address@FPrm_severity@0x024B313C@ */ ECIPP_ALIGNMENT_UBYTE 255 Compu_IDENTITY 0 255 PHYS_UNIT "Severity+Class" /end CHARACTERISTIC
/begin CHARACTERISTIC FPsvr_MAP_HiExp "FPrm_severity(389)" VALUE 0x001E699A /* @ECU_Address@FPrm_severity@0x024B3185@ */ ECIPP_ALIGNMENT_UBYTE 255 Compu_IDENTITY 0 255 PHYS_UNIT "Severity+Class" /end CHARACTERISTIC
/begin CHARACTERISTIC FPsvr_MAP_max "FPrm_severity(0)" VALUE 0x001E6815 /* @ECU_Address@FPrm_severity@0x024B3000@ */ ECIPP_ALIGNMENT_UBYTE 255 Compu_IDENTITY 0 255 PHYS_UNIT "Severity+Class" /end CHARACTERISTIC
/begin CHARACTERISTIC FPsvr_MAP_minv "FPrm_severity(1)" VALUE 0x001E6816 /* @ECU_Address@FPrm_severity@0x024B3001@ */ ECIPP_ALIGNMENT_UBYTE 255 Compu_IDENTITY 0 255 PHYS_UNIT "Severity+Class" /end CHARACTERISTIC
/begin CHARACTERISTIC FPsvr_MFA_ctout "FPrm_severity(589)" VALUE 0x001E6A62 /* @ECU_Address@FPrm_severity@0x024B324D@ */ ECIPP_ALIGNMENT_UBYTE 255 Compu_IDENTITY 0 255 PHYS_UNIT "Severity+Class" /end CHARACTERISTIC
/begin CHARACTERISTIC FPsvr_MFA_hi_flow "FPrm_severity(684)" VALUE 0x001E6AC1 /* @ECU_Address@FPrm_severity@0x024B32AC@ */ ECIPP_ALIGNMENT_UBYTE 255 Compu_IDENTITY 0 255 PHYS_UNIT "Severity+Class" /end CHARACTERISTIC
/begin CHARACTERISTIC FPsvr_MFA_hsd_comm "FPrm_severity(592)" VALUE 0x001E6A65 /* @ECU_Address@FPrm_severity@0x024B3250@ */ ECIPP_ALIGNMENT_UBYTE 255 Compu_IDENTITY 0 255 PHYS_UNIT "Severity+Class" /end CHARACTERISTIC
/begin CHARACTERISTIC FPsvr_MFA_intF_circ "FPrm_severity(590)" VALUE 0x001E6A63 /* @ECU_Address@FPrm_severity@0x024B324E@ */ ECIPP_ALIGNMENT_UBYTE 255 Compu_IDENTITY 0 255 PHYS_UNIT "Severity+Class" /end CHARACTERISTIC
/begin CHARACTERISTIC FPsvr_MFA_intF_DP_V_max "FPrm_severity(618)" VALUE 0x001E6A7F /* @ECU_Address@FPrm_severity@0x024B326A@ */ ECIPP_ALIGNMENT_UBYTE 255 Compu_IDENTITY 0 255 PHYS_UNIT "Severity+Class" /end CHARACTERISTIC
/begin CHARACTERISTIC FPsvr_MFA_intF_DP_V_min "FPrm_severity(619)" VALUE 0x001E6A80 /* @ECU_Address@FPrm_severity@0x024B326B@ */ ECIPP_ALIGNMENT_UBYTE 255 Compu_IDENTITY 0 255 PHYS_UNIT "Severity+Class" /end CHARACTERISTIC
/begin CHARACTERISTIC FPsvr_MFA_intF_DSPress_V_max "FPrm_severity(616)" VALUE 0x001E6A7D /* @ECU_Address@FPrm_severity@0x024B3268@ */ ECIPP_ALIGNMENT_UBYTE 255 Compu_IDENTITY 0 255 PHYS_UNIT "Severity+Class" /end CHARACTERISTIC
/begin CHARACTERISTIC FPsvr_MFA_intF_DSPress_V_min "FPrm_severity(617)" VALUE 0x001E6A7E /* @ECU_Address@FPrm_severity@0x024B3269@ */ ECIPP_ALIGNMENT_UBYTE 255 Compu_IDENTITY 0 255 PHYS_UNIT "Severity+Class" /end CHARACTERISTIC
/begin CHARACTERISTIC FPsvr_MFA_intF_FTemp_V_max "FPrm_severity(612)" VALUE 0x001E6A79 /* @ECU_Address@FPrm_severity@0x024B3264@ */ ECIPP_ALIGNMENT_UBYTE 255 Compu_IDENTITY 0 255 PHYS_UNIT "Severity+Class" /end CHARACTERISTIC
/begin CHARACTERISTIC FPsvr_MFA_intF_FTemp_V_min "FPrm_severity(613)" VALUE 0x001E6A7A /* @ECU_Address@FPrm_severity@0x024B3265@ */ ECIPP_ALIGNMENT_UBYTE 255 Compu_IDENTITY 0 255 PHYS_UNIT "Severity+Class" /end CHARACTERISTIC
/begin CHARACTERISTIC FPsvr_MFA_intF_general "FPrm_severity(620)" VALUE 0x001E6A81 /* @ECU_Address@FPrm_severity@0x024B326C@ */ ECIPP_ALIGNMENT_UBYTE 255 Compu_IDENTITY 0 255 PHYS_UNIT "Severity+Class" /end CHARACTERISTIC
/begin CHARACTERISTIC FPsvr_MFA_intF_Tposerr_n "FPrm_severity(609)" VALUE 0x001E6A76 /* @ECU_Address@FPrm_severity@0x024B3261@ */ ECIPP_ALIGNMENT_UBYTE 255 Compu_IDENTITY 0 255 PHYS_UNIT "Severity+Class" /end CHARACTERISTIC
/begin CHARACTERISTIC FPsvr_MFA_intF_Tposerr_p "FPrm_severity(608)" VALUE 0x001E6A75 /* @ECU_Address@FPrm_severity@0x024B3260@ */ ECIPP_ALIGNMENT_UBYTE 255 Compu_IDENTITY 0 255 PHYS_UNIT "Severity+Class" /end CHARACTERISTIC
/begin CHARACTERISTIC FPsvr_MFA_intF_USPress_V_max "FPrm_severity(614)" VALUE 0x001E6A7B /* @ECU_Address@FPrm_severity@0x024B3266@ */ ECIPP_ALIGNMENT_UBYTE 255 Compu_IDENTITY 0 255 PHYS_UNIT "Severity+Class" /end CHARACTERISTIC
/begin CHARACTERISTIC FPsvr_MFA_intF_USPress_V_min "FPrm_severity(615)" VALUE 0x001E6A7C /* @ECU_Address@FPrm_severity@0x024B3267@ */ ECIPP_ALIGNMENT_UBYTE 255 Compu_IDENTITY 0 255 PHYS_UNIT "Severity+Class" /end CHARACTERISTIC
/begin CHARACTERISTIC FPsvr_MFA_intF_Vbat_max "FPrm_severity(610)" VALUE 0x001E6A77 /* @ECU_Address@FPrm_severity@0x024B3262@ */ ECIPP_ALIGNMENT_UBYTE 255 Compu_IDENTITY 0 255 PHYS_UNIT "Severity+Class" /end CHARACTERISTIC
/begin CHARACTERISTIC FPsvr_MFA_intF_Vbat_min "FPrm_severity(611)" VALUE 0x001E6A78 /* @ECU_Address@FPrm_severity@0x024B3263@ */ ECIPP_ALIGNMENT_UBYTE 255 Compu_IDENTITY 0 255 PHYS_UNIT "Severity+Class" /end CHARACTERISTIC
/begin CHARACTERISTIC FPsvr_MFA_lo_flow "FPrm_severity(683)" VALUE 0x001E6AC0 /* @ECU_Address@FPrm_severity@0x024B32AB@ */ ECIPP_ALIGNMENT_UBYTE 255 Compu_IDENTITY 0 255 PHYS_UNIT "Severity+Class" /end CHARACTERISTIC
/begin CHARACTERISTIC FPsvr_MFG_ctout "FPrm_severity(587)" VALUE 0x001E6A60 /* @ECU_Address@FPrm_severity@0x024B324B@ */ ECIPP_ALIGNMENT_UBYTE 255 Compu_IDENTITY 0 255 PHYS_UNIT "Severity+Class" /end CHARACTERISTIC
/begin CHARACTERISTIC FPsvr_MFG_hi_flow "FPrm_severity(686)" VALUE 0x001E6AC3 /* @ECU_Address@FPrm_severity@0x024B32AE@ */ ECIPP_ALIGNMENT_UBYTE 255 Compu_IDENTITY 0 255 PHYS_UNIT "Severity+Class" /end CHARACTERISTIC
/begin CHARACTERISTIC FPsvr_MFG_hsd_comm "FPrm_severity(591)" VALUE 0x001E6A64 /* @ECU_Address@FPrm_severity@0x024B324F@ */ ECIPP_ALIGNMENT_UBYTE 255 Compu_IDENTITY 0 255 PHYS_UNIT "Severity+Class" /end CHARACTERISTIC
/begin CHARACTERISTIC FPsvr_MFG_intF_circ "FPrm_severity(588)" VALUE 0x001E6A61 /* @ECU_Address@FPrm_severity@0x024B324C@ */ ECIPP_ALIGNMENT_UBYTE 255 Compu_IDENTITY 0 255 PHYS_UNIT "Severity+Class" /end CHARACTERISTIC
/begin CHARACTERISTIC FPsvr_MFG_intF_DP_V_max "FPrm_severity(605)" VALUE 0x001E6A72 /* @ECU_Address@FPrm_severity@0x024B325D@ */ ECIPP_ALIGNMENT_UBYTE 255 Compu_IDENTITY 0 255 PHYS_UNIT "Severity+Class" /end CHARACTERISTIC
/begin CHARACTERISTIC FPsvr_MFG_intF_DP_V_min "FPrm_severity(606)" VALUE 0x001E6A73 /* @ECU_Address@FPrm_severity@0x024B325E@ */ ECIPP_ALIGNMENT_UBYTE 255 Compu_IDENTITY 0 255 PHYS_UNIT "Severity+Class" /end CHARACTERISTIC
/begin CHARACTERISTIC FPsvr_MFG_intF_DPzVolt_V_max "FPrm_severity(603)" VALUE 0x001E6A70 /* @ECU_Address@FPrm_severity@0x024B325B@ */ ECIPP_ALIGNMENT_UBYTE 255 Compu_IDENTITY 0 255 PHYS_UNIT "Severity+Class" /end CHARACTERISTIC
/begin CHARACTERISTIC FPsvr_MFG_intF_DPzVolt_V_min "FPrm_severity(604)" VALUE 0x001E6A71 /* @ECU_Address@FPrm_severity@0x024B325C@ */ ECIPP_ALIGNMENT_UBYTE 255 Compu_IDENTITY 0 255 PHYS_UNIT "Severity+Class" /end CHARACTERISTIC
/begin CHARACTERISTIC FPsvr_MFG_intF_DSPress_V_max "FPrm_severity(601)" VALUE 0x001E6A6E /* @ECU_Address@FPrm_severity@0x024B3259@ */ ECIPP_ALIGNMENT_UBYTE 255 Compu_IDENTITY 0 255 PHYS_UNIT "Severity+Class" /end CHARACTERISTIC
/begin CHARACTERISTIC FPsvr_MFG_intF_DSPress_V_min "FPrm_severity(602)" VALUE 0x001E6A6F /* @ECU_Address@FPrm_severity@0x024B325A@ */ ECIPP_ALIGNMENT_UBYTE 255 Compu_IDENTITY 0 255 PHYS_UNIT "Severity+Class" /end CHARACTERISTIC
/begin CHARACTERISTIC FPsvr_MFG_intF_FTemp_V_max "FPrm_severity(597)" VALUE 0x001E6A6A /* @ECU_Address@FPrm_severity@0x024B3255@ */ ECIPP_ALIGNMENT_UBYTE 255 Compu_IDENTITY 0 255 PHYS_UNIT "Severity+Class" /end CHARACTERISTIC
/begin CHARACTERISTIC FPsvr_MFG_intF_FTemp_V_min "FPrm_severity(598)" VALUE 0x001E6A6B /* @ECU_Address@FPrm_severity@0x024B3256@ */ ECIPP_ALIGNMENT_UBYTE 255 Compu_IDENTITY 0 255 PHYS_UNIT "Severity+Class" /end CHARACTERISTIC
/begin CHARACTERISTIC FPsvr_MFG_intF_general "FPrm_severity(607)" VALUE 0x001E6A74 /* @ECU_Address@FPrm_severity@0x024B325F@ */ ECIPP_ALIGNMENT_UBYTE 255 Compu_IDENTITY 0 255 PHYS_UNIT "Severity+Class" /end CHARACTERISTIC
/begin CHARACTERISTIC FPsvr_MFG_intF_Tposerr_n "FPrm_severity(594)" VALUE 0x001E6A67 /* @ECU_Address@FPrm_severity@0x024B3252@ */ ECIPP_ALIGNMENT_UBYTE 255 Compu_IDENTITY 0 255 PHYS_UNIT "Severity+Class" /end CHARACTERISTIC
/begin CHARACTERISTIC FPsvr_MFG_intF_Tposerr_p "FPrm_severity(593)" VALUE 0x001E6A66 /* @ECU_Address@FPrm_severity@0x024B3251@ */ ECIPP_ALIGNMENT_UBYTE 255 Compu_IDENTITY 0 255 PHYS_UNIT "Severity+Class" /end CHARACTERISTIC
/begin CHARACTERISTIC FPsvr_MFG_intF_USPress_V_max "FPrm_severity(599)" VALUE 0x001E6A6C /* @ECU_Address@FPrm_severity@0x024B3257@ */ ECIPP_ALIGNMENT_UBYTE 255 Compu_IDENTITY 0 255 PHYS_UNIT "Severity+Class" /end CHARACTERISTIC
/begin CHARACTERISTIC FPsvr_MFG_intF_USPress_V_min "FPrm_severity(600)" VALUE 0x001E6A6D /* @ECU_Address@FPrm_severity@0x024B3258@ */ ECIPP_ALIGNMENT_UBYTE 255 Compu_IDENTITY 0 255 PHYS_UNIT "Severity+Class" /end CHARACTERISTIC
/begin CHARACTERISTIC FPsvr_MFG_intF_Vbat_max "FPrm_severity(595)" VALUE 0x001E6A68 /* @ECU_Address@FPrm_severity@0x024B3253@ */ ECIPP_ALIGNMENT_UBYTE 255 Compu_IDENTITY 0 255 PHYS_UNIT "Severity+Class" /end CHARACTERISTIC
/begin CHARACTERISTIC FPsvr_MFG_intF_Vbat_min "FPrm_severity(596)" VALUE 0x001E6A69 /* @ECU_Address@FPrm_severity@0x024B3254@ */ ECIPP_ALIGNMENT_UBYTE 255 Compu_IDENTITY 0 255 PHYS_UNIT "Severity+Class" /end CHARACTERISTIC
/begin CHARACTERISTIC FPsvr_MFG_lo_flow "FPrm_severity(685)" VALUE 0x001E6AC2 /* @ECU_Address@FPrm_severity@0x024B32AD@ */ ECIPP_ALIGNMENT_UBYTE 255 Compu_IDENTITY 0 255 PHYS_UNIT "Severity+Class" /end CHARACTERISTIC
/begin CHARACTERISTIC FPsvr_MFG_RLV_fail "FPrm_severity(630)" VALUE 0x001E6A8B /* @ECU_Address@FPrm_severity@0x024B3276@ */ ECIPP_ALIGNMENT_UBYTE 255 Compu_IDENTITY 0 255 PHYS_UNIT "Severity+Class" /end CHARACTERISTIC
/begin CHARACTERISTIC FPsvr_MIL_coilopen "FPrm_severity(131)" VALUE 0x001E6898 /* @ECU_Address@FPrm_severity@0x024B3083@ */ ECIPP_ALIGNMENT_UBYTE 255 Compu_IDENTITY 0 255 PHYS_UNIT "Severity+Class" /end CHARACTERISTIC
/begin CHARACTERISTIC FPsvr_MIL_coilshort "FPrm_severity(132)" VALUE 0x001E6899 /* @ECU_Address@FPrm_severity@0x024B3084@ */ ECIPP_ALIGNMENT_UBYTE 255 Compu_IDENTITY 0 255 PHYS_UNIT "Severity+Class" /end CHARACTERISTIC
/begin CHARACTERISTIC FPsvr_MIL_gndshort "FPrm_severity(130)" VALUE 0x001E6897 /* @ECU_Address@FPrm_severity@0x024B3082@ */ ECIPP_ALIGNMENT_UBYTE 255 Compu_IDENTITY 0 255 PHYS_UNIT "Severity+Class" /end CHARACTERISTIC
/begin CHARACTERISTIC FPsvr_MJ_comm_tout "FPrm_severity(94)" VALUE 0x001E6873 /* @ECU_Address@FPrm_severity@0x024B305E@ */ ECIPP_ALIGNMENT_UBYTE 255 Compu_IDENTITY 0 255 PHYS_UNIT "Severity+Class" /end CHARACTERISTIC
/begin CHARACTERISTIC FPsvr_MJ_intF_act "FPrm_severity(97)" VALUE 0x001E6876 /* @ECU_Address@FPrm_severity@0x024B3061@ */ ECIPP_ALIGNMENT_UBYTE 255 Compu_IDENTITY 0 255 PHYS_UNIT "Severity+Class" /end CHARACTERISTIC
/begin CHARACTERISTIC FPsvr_MJ_intF_az "FPrm_severity(209)" VALUE 0x001E68E6 /* @ECU_Address@FPrm_severity@0x024B30D1@ */ ECIPP_ALIGNMENT_UBYTE 255 Compu_IDENTITY 0 255 PHYS_UNIT "Severity+Class" /end CHARACTERISTIC
/begin CHARACTERISTIC FPsw_ext1_J1939_TSC1_chksum "FPrm_switches_ext1(622)" VALUE 0x001C7A5A /* @ECU_Address@FPrm_switches_ext1@0x023A54DC@ */ ECIPP_ALIGNMENT_UWORD 65535 Compu_IDENTITY 0 65535 PHYS_UNIT "Enable bits" /end CHARACTERISTIC
/begin CHARACTERISTIC FPsw_ext1_J1939_TSC1_cntr "FPrm_switches_ext1(621)" VALUE 0x001C7A58 /* @ECU_Address@FPrm_switches_ext1@0x023A54DA@ */ ECIPP_ALIGNMENT_UWORD 65535 Compu_IDENTITY 0 65535 PHYS_UNIT "Enable bits" /end CHARACTERISTIC
/begin CHARACTERISTIC FPsw_ext1_J1939_TSC1_loss "FPrm_switches_ext1(173)" VALUE 0x001C76D8 /* @ECU_Address@FPrm_switches_ext1@0x023A515A@ */ ECIPP_ALIGNMENT_UWORD 65535 Compu_IDENTITY 0 65535 PHYS_UNIT "Enable bits" /end CHARACTERISTIC
/begin CHARACTERISTIC FPsw_ext1_J1939_Tx2Fail "FPrm_switches_ext1(219)" VALUE 0x001C7734 /* @ECU_Address@FPrm_switches_ext1@0x023A51B6@ */ ECIPP_ALIGNMENT_UWORD 65535 Compu_IDENTITY 0 65535 PHYS_UNIT "Enable bits" /end CHARACTERISTIC
/begin CHARACTERISTIC FPsw_ext1_J1939_Tx3Fail "FPrm_switches_ext1(220)" VALUE 0x001C7736 /* @ECU_Address@FPrm_switches_ext1@0x023A51B8@ */ ECIPP_ALIGNMENT_UWORD 65535 Compu_IDENTITY 0 65535 PHYS_UNIT "Enable bits" /end CHARACTERISTIC
/begin CHARACTERISTIC FPsw_ext1_J1939_TxFail "FPrm_switches_ext1(114)" VALUE 0x001C7662 /* @ECU_Address@FPrm_switches_ext1@0x023A50E4@ */ ECIPP_ALIGNMENT_UWORD 65535 Compu_IDENTITY 0 65535 PHYS_UNIT "Enable bits" /end CHARACTERISTIC
/begin CHARACTERISTIC FPsw_ext1_KNK_max "FPrm_switches_ext1(13)" VALUE 0x001C7598 /* @ECU_Address@FPrm_switches_ext1@0x023A501A@ */ ECIPP_ALIGNMENT_UWORD 65535 Compu_IDENTITY 0 65535 PHYS_UNIT "Enable bits" /end CHARACTERISTIC
/begin CHARACTERISTIC FPsw_ext1_KNK_min "FPrm_switches_ext1(12)" VALUE 0x001C7596 /* @ECU_Address@FPrm_switches_ext1@0x023A5018@ */ ECIPP_ALIGNMENT_UWORD 65535 Compu_IDENTITY 0 65535 PHYS_UNIT "Enable bits" /end CHARACTERISTIC
/begin CHARACTERISTIC FPsw_ext1_KNK_retardlmt "FPrm_switches_ext1(383)" VALUE 0x001C787C /* @ECU_Address@FPrm_switches_ext1@0x023A52FE@ */ ECIPP_ALIGNMENT_UWORD 65535 Compu_IDENTITY 0 65535 PHYS_UNIT "Enable bits" /end CHARACTERISTIC
/begin CHARACTERISTIC FPsw_ext1_KNK_retardlmt2 "FPrm_switches_ext1(528)" VALUE 0x001C799E /* @ECU_Address@FPrm_switches_ext1@0x023A5420@ */ ECIPP_ALIGNMENT_UWORD 65535 Compu_IDENTITY 0 65535 PHYS_UNIT "Enable bits" /end CHARACTERISTIC
/begin CHARACTERISTIC FPsw_ext1_KV1_deltaHi "FPrm_switches_ext1(708)" VALUE 0x001C7B06 /* @ECU_Address@FPrm_switches_ext1@0x023A5588@ */ ECIPP_ALIGNMENT_UWORD 65535 Compu_IDENTITY 0 65535 PHYS_UNIT "Enable bits" /end CHARACTERISTIC
/begin CHARACTERISTIC FPsw_ext1_KV1_deltaLo "FPrm_switches_ext1(709)" VALUE 0x001C7B08 /* @ECU_Address@FPrm_switches_ext1@0x023A558A@ */ ECIPP_ALIGNMENT_UWORD 65535 Compu_IDENTITY 0 65535 PHYS_UNIT "Enable bits" /end CHARACTERISTIC
/begin CHARACTERISTIC FPsw_ext1_KV1_high "FPrm_switches_ext1(701)" VALUE 0x001C7AF8 /* @ECU_Address@FPrm_switches_ext1@0x023A557A@ */ ECIPP_ALIGNMENT_UWORD 65535 Compu_IDENTITY 0 65535 PHYS_UNIT "Enable bits" /end CHARACTERISTIC
/begin CHARACTERISTIC FPsw_ext1_KV1_low "FPrm_switches_ext1(702)" VALUE 0x001C7AFA /* @ECU_Address@FPrm_switches_ext1@0x023A557C@ */ ECIPP_ALIGNMENT_UWORD 65535 Compu_IDENTITY 0 65535 PHYS_UNIT "Enable bits" /end CHARACTERISTIC
/begin CHARACTERISTIC FPsw_ext1_LOD_flk "FPrm_switches_ext1(566)" VALUE 0x001C79EA /* @ECU_Address@FPrm_switches_ext1@0x023A546C@ */ ECIPP_ALIGNMENT_UWORD 65535 Compu_IDENTITY 0 65535 PHYS_UNIT "Enable bits" /end CHARACTERISTIC
/begin CHARACTERISTIC FPsw_ext1_LOD_FROmax "FPrm_switches_ext1(174)" VALUE 0x001C76DA /* @ECU_Address@FPrm_switches_ext1@0x023A515C@ */ ECIPP_ALIGNMENT_UWORD 65535 Compu_IDENTITY 0 65535 PHYS_UNIT "Enable bits" /end CHARACTERISTIC
/begin CHARACTERISTIC FPsw_ext1_LOD_slk "FPrm_switches_ext1(565)" VALUE 0x001C79E8 /* @ECU_Address@FPrm_switches_ext1@0x023A546A@ */ ECIPP_ALIGNMENT_UWORD 65535 Compu_IDENTITY 0 65535 PHYS_UNIT "Enable bits" /end CHARACTERISTIC
/begin CHARACTERISTIC FPsw_ext1_low_fuel_mon "FPrm_switches_ext1(711)" VALUE 0x001C7B0C /* @ECU_Address@FPrm_switches_ext1@0x023A558E@ */ ECIPP_ALIGNMENT_UWORD 65535 Compu_IDENTITY 0 65535 PHYS_UNIT "Enable bits" /end CHARACTERISTIC
/begin CHARACTERISTIC FPsw_ext1_LowCLTemp "FPrm_switches_ext1(480)" VALUE 0x001C793E /* @ECU_Address@FPrm_switches_ext1@0x023A53C0@ */ ECIPP_ALIGNMENT_UWORD 65535 Compu_IDENTITY 0 65535 PHYS_UNIT "Enable bits" /end CHARACTERISTIC
/begin CHARACTERISTIC FPsw_ext1_LowDiagTemp "FPrm_switches_ext1(481)" VALUE 0x001C7940 /* @ECU_Address@FPrm_switches_ext1@0x023A53C2@ */ ECIPP_ALIGNMENT_UWORD 65535 Compu_IDENTITY 0 65535 PHYS_UNIT "Enable bits" /end CHARACTERISTIC
/begin CHARACTERISTIC FPsw_ext1_LowOperTemp "FPrm_switches_ext1(316)" VALUE 0x001C77F6 /* @ECU_Address@FPrm_switches_ext1@0x023A5278@ */ ECIPP_ALIGNMENT_UWORD 65535 Compu_IDENTITY 0 65535 PHYS_UNIT "Enable bits" /end CHARACTERISTIC
/begin CHARACTERISTIC FPsw_ext1_MAP_HiExp "FPrm_switches_ext1(389)" VALUE 0x001C7888 /* @ECU_Address@FPrm_switches_ext1@0x023A530A@ */ ECIPP_ALIGNMENT_UWORD 65535 Compu_IDENTITY 0 65535 PHYS_UNIT "Enable bits" /end CHARACTERISTIC
/begin CHARACTERISTIC FPsw_ext1_MAP_max "FPrm_switches_ext1(0)" VALUE 0x001C757E /* @ECU_Address@FPrm_switches_ext1@0x023A5000@ */ ECIPP_ALIGNMENT_UWORD 65535 Compu_IDENTITY 0 65535 PHYS_UNIT "Enable bits" /end CHARACTERISTIC
/begin CHARACTERISTIC FPsw_ext1_MAP_minv "FPrm_switches_ext1(1)" VALUE 0x001C7580 /* @ECU_Address@FPrm_switches_ext1@0x023A5002@ */ ECIPP_ALIGNMENT_UWORD 65535 Compu_IDENTITY 0 65535 PHYS_UNIT "Enable bits" /end CHARACTERISTIC
/begin CHARACTERISTIC FPsw_ext1_MFA_ctout "FPrm_switches_ext1(589)" VALUE 0x001C7A18 /* @ECU_Address@FPrm_switches_ext1@0x023A549A@ */ ECIPP_ALIGNMENT_UWORD 65535 Compu_IDENTITY 0 65535 PHYS_UNIT "Enable bits" /end CHARACTERISTIC
/begin CHARACTERISTIC FPsw_ext1_MFA_hi_flow "FPrm_switches_ext1(684)" VALUE 0x001C7AD6 /* @ECU_Address@FPrm_switches_ext1@0x023A5558@ */ ECIPP_ALIGNMENT_UWORD 65535 Compu_IDENTITY 0 65535 PHYS_UNIT "Enable bits" /end CHARACTERISTIC
/begin CHARACTERISTIC FPsw_ext1_MFA_hsd_comm "FPrm_switches_ext1(592)" VALUE 0x001C7A1E /* @ECU_Address@FPrm_switches_ext1@0x023A54A0@ */ ECIPP_ALIGNMENT_UWORD 65535 Compu_IDENTITY 0 65535 PHYS_UNIT "Enable bits" /end CHARACTERISTIC
/begin CHARACTERISTIC FPsw_ext1_MFA_intF_circ "FPrm_switches_ext1(590)" VALUE 0x001C7A1A /* @ECU_Address@FPrm_switches_ext1@0x023A549C@ */ ECIPP_ALIGNMENT_UWORD 65535 Compu_IDENTITY 0 65535 PHYS_UNIT "Enable bits" /end CHARACTERISTIC
/begin CHARACTERISTIC FPsw_ext1_MFA_intF_DP_V_max "FPrm_switches_ext1(618)" VALUE 0x001C7A52 /* @ECU_Address@FPrm_switches_ext1@0x023A54D4@ */ ECIPP_ALIGNMENT_UWORD 65535 Compu_IDENTITY 0 65535 PHYS_UNIT "Enable bits" /end CHARACTERISTIC
/begin CHARACTERISTIC FPsw_ext1_MFA_intF_DP_V_min "FPrm_switches_ext1(619)" VALUE 0x001C7A54 /* @ECU_Address@FPrm_switches_ext1@0x023A54D6@ */ ECIPP_ALIGNMENT_UWORD 65535 Compu_IDENTITY 0 65535 PHYS_UNIT "Enable bits" /end CHARACTERISTIC
/begin CHARACTERISTIC FPsw_ext1_MFA_intF_DSPress_V_max "FPrm_switches_ext1(616)" VALUE 0x001C7A4E /* @ECU_Address@FPrm_switches_ext1@0x023A54D0@ */ ECIPP_ALIGNMENT_UWORD 65535 Compu_IDENTITY 0 65535 PHYS_UNIT "Enable bits" /end CHARACTERISTIC
/begin CHARACTERISTIC FPsw_ext1_MFA_intF_DSPress_V_min "FPrm_switches_ext1(617)" VALUE 0x001C7A50 /* @ECU_Address@FPrm_switches_ext1@0x023A54D2@ */ ECIPP_ALIGNMENT_UWORD 65535 Compu_IDENTITY 0 65535 PHYS_UNIT "Enable bits" /end CHARACTERISTIC
/begin CHARACTERISTIC FPsw_ext1_MFA_intF_FTemp_V_max "FPrm_switches_ext1(612)" VALUE 0x001C7A46 /* @ECU_Address@FPrm_switches_ext1@0x023A54C8@ */ ECIPP_ALIGNMENT_UWORD 65535 Compu_IDENTITY 0 65535 PHYS_UNIT "Enable bits" /end CHARACTERISTIC
/begin CHARACTERISTIC FPsw_ext1_MFA_intF_FTemp_V_min "FPrm_switches_ext1(613)" VALUE 0x001C7A48 /* @ECU_Address@FPrm_switches_ext1@0x023A54CA@ */ ECIPP_ALIGNMENT_UWORD 65535 Compu_IDENTITY 0 65535 PHYS_UNIT "Enable bits" /end CHARACTERISTIC
/begin CHARACTERISTIC FPsw_ext1_MFA_intF_general "FPrm_switches_ext1(620)" VALUE 0x001C7A56 /* @ECU_Address@FPrm_switches_ext1@0x023A54D8@ */ ECIPP_ALIGNMENT_UWORD 65535 Compu_IDENTITY 0 65535 PHYS_UNIT "Enable bits" /end CHARACTERISTIC
/begin CHARACTERISTIC FPsw_ext1_MFA_intF_Tposerr_n "FPrm_switches_ext1(609)" VALUE 0x001C7A40 /* @ECU_Address@FPrm_switches_ext1@0x023A54C2@ */ ECIPP_ALIGNMENT_UWORD 65535 Compu_IDENTITY 0 65535 PHYS_UNIT "Enable bits" /end CHARACTERISTIC
/begin CHARACTERISTIC FPsw_ext1_MFA_intF_Tposerr_p "FPrm_switches_ext1(608)" VALUE 0x001C7A3E /* @ECU_Address@FPrm_switches_ext1@0x023A54C0@ */ ECIPP_ALIGNMENT_UWORD 65535 Compu_IDENTITY 0 65535 PHYS_UNIT "Enable bits" /end CHARACTERISTIC
/begin CHARACTERISTIC FPsw_ext1_MFA_intF_USPress_V_max "FPrm_switches_ext1(614)" VALUE 0x001C7A4A /* @ECU_Address@FPrm_switches_ext1@0x023A54CC@ */ ECIPP_ALIGNMENT_UWORD 65535 Compu_IDENTITY 0 65535 PHYS_UNIT "Enable bits" /end CHARACTERISTIC
/begin CHARACTERISTIC FPsw_ext1_MFA_intF_USPress_V_min "FPrm_switches_ext1(615)" VALUE 0x001C7A4C /* @ECU_Address@FPrm_switches_ext1@0x023A54CE@ */ ECIPP_ALIGNMENT_UWORD 65535 Compu_IDENTITY 0 65535 PHYS_UNIT "Enable bits" /end CHARACTERISTIC
/begin CHARACTERISTIC FPsw_ext1_MFA_intF_Vbat_max "FPrm_switches_ext1(610)" VALUE 0x001C7A42 /* @ECU_Address@FPrm_switches_ext1@0x023A54C4@ */ ECIPP_ALIGNMENT_UWORD 65535 Compu_IDENTITY 0 65535 PHYS_UNIT "Enable bits" /end CHARACTERISTIC
/begin CHARACTERISTIC FPsw_ext1_MFA_intF_Vbat_min "FPrm_switches_ext1(611)" VALUE 0x001C7A44 /* @ECU_Address@FPrm_switches_ext1@0x023A54C6@ */ ECIPP_ALIGNMENT_UWORD 65535 Compu_IDENTITY 0 65535 PHYS_UNIT "Enable bits" /end CHARACTERISTIC
/begin CHARACTERISTIC FPsw_ext1_MFA_lo_flow "FPrm_switches_ext1(683)" VALUE 0x001C7AD4 /* @ECU_Address@FPrm_switches_ext1@0x023A5556@ */ ECIPP_ALIGNMENT_UWORD 65535 Compu_IDENTITY 0 65535 PHYS_UNIT "Enable bits" /end CHARACTERISTIC
/begin CHARACTERISTIC FPsw_ext1_MFG_ctout "FPrm_switches_ext1(587)" VALUE 0x001C7A14 /* @ECU_Address@FPrm_switches_ext1@0x023A5496@ */ ECIPP_ALIGNMENT_UWORD 65535 Compu_IDENTITY 0 65535 PHYS_UNIT "Enable bits" /end CHARACTERISTIC
/begin CHARACTERISTIC FPsw_ext1_MFG_hi_flow "FPrm_switches_ext1(686)" VALUE 0x001C7ADA /* @ECU_Address@FPrm_switches_ext1@0x023A555C@ */ ECIPP_ALIGNMENT_UWORD 65535 Compu_IDENTITY 0 65535 PHYS_UNIT "Enable bits" /end CHARACTERISTIC
/begin CHARACTERISTIC FPsw_ext1_MFG_hsd_comm "FPrm_switches_ext1(591)" VALUE 0x001C7A1C /* @ECU_Address@FPrm_switches_ext1@0x023A549E@ */ ECIPP_ALIGNMENT_UWORD 65535 Compu_IDENTITY 0 65535 PHYS_UNIT "Enable bits" /end CHARACTERISTIC
/begin CHARACTERISTIC FPsw_ext1_MFG_intF_circ "FPrm_switches_ext1(588)" VALUE 0x001C7A16 /* @ECU_Address@FPrm_switches_ext1@0x023A5498@ */ ECIPP_ALIGNMENT_UWORD 65535 Compu_IDENTITY 0 65535 PHYS_UNIT "Enable bits" /end CHARACTERISTIC
/begin CHARACTERISTIC FPsw_ext1_MFG_intF_DP_V_max "FPrm_switches_ext1(605)" VALUE 0x001C7A38 /* @ECU_Address@FPrm_switches_ext1@0x023A54BA@ */ ECIPP_ALIGNMENT_UWORD 65535 Compu_IDENTITY 0 65535 PHYS_UNIT "Enable bits" /end CHARACTERISTIC
/begin CHARACTERISTIC FPsw_ext1_MFG_intF_DP_V_min "FPrm_switches_ext1(606)" VALUE 0x001C7A3A /* @ECU_Address@FPrm_switches_ext1@0x023A54BC@ */ ECIPP_ALIGNMENT_UWORD 65535 Compu_IDENTITY 0 65535 PHYS_UNIT "Enable bits" /end CHARACTERISTIC
/begin CHARACTERISTIC FPsw_ext1_MFG_intF_DPzVolt_V_max "FPrm_switches_ext1(603)" VALUE 0x001C7A34 /* @ECU_Address@FPrm_switches_ext1@0x023A54B6@ */ ECIPP_ALIGNMENT_UWORD 65535 Compu_IDENTITY 0 65535 PHYS_UNIT "Enable bits" /end CHARACTERISTIC
/begin CHARACTERISTIC FPsw_ext1_MFG_intF_DPzVolt_V_min "FPrm_switches_ext1(604)" VALUE 0x001C7A36 /* @ECU_Address@FPrm_switches_ext1@0x023A54B8@ */ ECIPP_ALIGNMENT_UWORD 65535 Compu_IDENTITY 0 65535 PHYS_UNIT "Enable bits" /end CHARACTERISTIC
/begin CHARACTERISTIC FPsw_ext1_MFG_intF_DSPress_V_max "FPrm_switches_ext1(601)" VALUE 0x001C7A30 /* @ECU_Address@FPrm_switches_ext1@0x023A54B2@ */ ECIPP_ALIGNMENT_UWORD 65535 Compu_IDENTITY 0 65535 PHYS_UNIT "Enable bits" /end CHARACTERISTIC
/begin CHARACTERISTIC FPsw_ext1_MFG_intF_DSPress_V_min "FPrm_switches_ext1(602)" VALUE 0x001C7A32 /* @ECU_Address@FPrm_switches_ext1@0x023A54B4@ */ ECIPP_ALIGNMENT_UWORD 65535 Compu_IDENTITY 0 65535 PHYS_UNIT "Enable bits" /end CHARACTERISTIC
/begin CHARACTERISTIC FPsw_ext1_MFG_intF_FTemp_V_max "FPrm_switches_ext1(597)" VALUE 0x001C7A28 /* @ECU_Address@FPrm_switches_ext1@0x023A54AA@ */ ECIPP_ALIGNMENT_UWORD 65535 Compu_IDENTITY 0 65535 PHYS_UNIT "Enable bits" /end CHARACTERISTIC
/begin CHARACTERISTIC FPsw_ext1_MFG_intF_FTemp_V_min "FPrm_switches_ext1(598)" VALUE 0x001C7A2A /* @ECU_Address@FPrm_switches_ext1@0x023A54AC@ */ ECIPP_ALIGNMENT_UWORD 65535 Compu_IDENTITY 0 65535 PHYS_UNIT "Enable bits" /end CHARACTERISTIC
/begin CHARACTERISTIC FPsw_ext1_MFG_intF_general "FPrm_switches_ext1(607)" VALUE 0x001C7A3C /* @ECU_Address@FPrm_switches_ext1@0x023A54BE@ */ ECIPP_ALIGNMENT_UWORD 65535 Compu_IDENTITY 0 65535 PHYS_UNIT "Enable bits" /end CHARACTERISTIC
/begin CHARACTERISTIC FPsw_ext1_MFG_intF_Tposerr_n "FPrm_switches_ext1(594)" VALUE 0x001C7A22 /* @ECU_Address@FPrm_switches_ext1@0x023A54A4@ */ ECIPP_ALIGNMENT_UWORD 65535 Compu_IDENTITY 0 65535 PHYS_UNIT "Enable bits" /end CHARACTERISTIC
/begin CHARACTERISTIC FPsw_ext1_MFG_intF_Tposerr_p "FPrm_switches_ext1(593)" VALUE 0x001C7A20 /* @ECU_Address@FPrm_switches_ext1@0x023A54A2@ */ ECIPP_ALIGNMENT_UWORD 65535 Compu_IDENTITY 0 65535 PHYS_UNIT "Enable bits" /end CHARACTERISTIC
/begin CHARACTERISTIC FPsw_ext1_MFG_intF_USPress_V_max "FPrm_switches_ext1(599)" VALUE 0x001C7A2C /* @ECU_Address@FPrm_switches_ext1@0x023A54AE@ */ ECIPP_ALIGNMENT_UWORD 65535 Compu_IDENTITY 0 65535 PHYS_UNIT "Enable bits" /end CHARACTERISTIC
/begin CHARACTERISTIC FPsw_ext1_MFG_intF_USPress_V_min "FPrm_switches_ext1(600)" VALUE 0x001C7A2E /* @ECU_Address@FPrm_switches_ext1@0x023A54B0@ */ ECIPP_ALIGNMENT_UWORD 65535 Compu_IDENTITY 0 65535 PHYS_UNIT "Enable bits" /end CHARACTERISTIC
/begin CHARACTERISTIC FPsw_ext1_MFG_intF_Vbat_max "FPrm_switches_ext1(595)" VALUE 0x001C7A24 /* @ECU_Address@FPrm_switches_ext1@0x023A54A6@ */ ECIPP_ALIGNMENT_UWORD 65535 Compu_IDENTITY 0 65535 PHYS_UNIT "Enable bits" /end CHARACTERISTIC
/begin CHARACTERISTIC FPsw_ext1_MFG_intF_Vbat_min "FPrm_switches_ext1(596)" VALUE 0x001C7A26 /* @ECU_Address@FPrm_switches_ext1@0x023A54A8@ */ ECIPP_ALIGNMENT_UWORD 65535 Compu_IDENTITY 0 65535 PHYS_UNIT "Enable bits" /end CHARACTERISTIC
/begin CHARACTERISTIC FPsw_ext1_MFG_lo_flow "FPrm_switches_ext1(685)" VALUE 0x001C7AD8 /* @ECU_Address@FPrm_switches_ext1@0x023A555A@ */ ECIPP_ALIGNMENT_UWORD 65535 Compu_IDENTITY 0 65535 PHYS_UNIT "Enable bits" /end CHARACTERISTIC
/begin CHARACTERISTIC FPsw_ext1_MFG_RLV_fail "FPrm_switches_ext1(630)" VALUE 0x001C7A6A /* @ECU_Address@FPrm_switches_ext1@0x023A54EC@ */ ECIPP_ALIGNMENT_UWORD 65535 Compu_IDENTITY 0 65535 PHYS_UNIT "Enable bits" /end CHARACTERISTIC
/begin CHARACTERISTIC FPsw_ext1_MIL_coilopen "FPrm_switches_ext1(131)" VALUE 0x001C7684 /* @ECU_Address@FPrm_switches_ext1@0x023A5106@ */ ECIPP_ALIGNMENT_UWORD 65535 Compu_IDENTITY 0 65535 PHYS_UNIT "Enable bits" /end CHARACTERISTIC
/begin CHARACTERISTIC FPsw_ext1_MIL_coilshort "FPrm_switches_ext1(132)" VALUE 0x001C7686 /* @ECU_Address@FPrm_switches_ext1@0x023A5108@ */ ECIPP_ALIGNMENT_UWORD 65535 Compu_IDENTITY 0 65535 PHYS_UNIT "Enable bits" /end CHARACTERISTIC
/begin CHARACTERISTIC FPsw_ext1_MIL_gndshort "FPrm_switches_ext1(130)" VALUE 0x001C7682 /* @ECU_Address@FPrm_switches_ext1@0x023A5104@ */ ECIPP_ALIGNMENT_UWORD 65535 Compu_IDENTITY 0 65535 PHYS_UNIT "Enable bits" /end CHARACTERISTIC
/begin CHARACTERISTIC FPsw_ext1_MJ_comm_tout "FPrm_switches_ext1(94)" VALUE 0x001C763A /* @ECU_Address@FPrm_switches_ext1@0x023A50BC@ */ ECIPP_ALIGNMENT_UWORD 65535 Compu_IDENTITY 0 65535 PHYS_UNIT "Enable bits" /end CHARACTERISTIC
/begin CHARACTERISTIC FPsw_ext1_MJ_intF_act "FPrm_switches_ext1(97)" VALUE 0x001C7640 /* @ECU_Address@FPrm_switches_ext1@0x023A50C2@ */ ECIPP_ALIGNMENT_UWORD 65535 Compu_IDENTITY 0 65535 PHYS_UNIT "Enable bits" /end CHARACTERISTIC
/begin CHARACTERISTIC FPsw_ext1_MJ_intF_az "FPrm_switches_ext1(209)" VALUE 0x001C7720 /* @ECU_Address@FPrm_switches_ext1@0x023A51A2@ */ ECIPP_ALIGNMENT_UWORD 65535 Compu_IDENTITY 0 65535 PHYS_UNIT "Enable bits" /end CHARACTERISTIC
/begin CHARACTERISTIC FPsw_J1939_TSC1_chksum "FPrm_switches(622)" VALUE 0x001C74B6 /* @ECU_Address@FPrm_switches@0x021B94DC@ */ ECIPP_ALIGNMENT_UWORD 65535 Compu_IDENTITY 0 65535 PHYS_UNIT "Enable bits" /end CHARACTERISTIC
/begin CHARACTERISTIC FPsw_J1939_TSC1_cntr "FPrm_switches(621)" VALUE 0x001C74B4 /* @ECU_Address@FPrm_switches@0x021B94DA@ */ ECIPP_ALIGNMENT_UWORD 65535 Compu_IDENTITY 0 65535 PHYS_UNIT "Enable bits" /end CHARACTERISTIC
/begin CHARACTERISTIC FPsw_J1939_TSC1_loss "FPrm_switches(173)" VALUE 0x001C7134 /* @ECU_Address@FPrm_switches@0x021B915A@ */ ECIPP_ALIGNMENT_UWORD 65535 Compu_IDENTITY 0 65535 PHYS_UNIT "Enable bits" /end CHARACTERISTIC
/begin CHARACTERISTIC FPsw_J1939_Tx2Fail "FPrm_switches(219)" VALUE 0x001C7190 /* @ECU_Address@FPrm_switches@0x021B91B6@ */ ECIPP_ALIGNMENT_UWORD 65535 Compu_IDENTITY 0 65535 PHYS_UNIT "Enable bits" /end CHARACTERISTIC
/begin CHARACTERISTIC FPsw_J1939_Tx3Fail "FPrm_switches(220)" VALUE 0x001C7192 /* @ECU_Address@FPrm_switches@0x021B91B8@ */ ECIPP_ALIGNMENT_UWORD 65535 Compu_IDENTITY 0 65535 PHYS_UNIT "Enable bits" /end CHARACTERISTIC
/begin CHARACTERISTIC FPsw_J1939_TxFail "FPrm_switches(114)" VALUE 0x001C70BE /* @ECU_Address@FPrm_switches@0x021B90E4@ */ ECIPP_ALIGNMENT_UWORD 65535 Compu_IDENTITY 0 65535 PHYS_UNIT "Enable bits" /end CHARACTERISTIC
/begin CHARACTERISTIC FPsw_KNK_max "FPrm_switches(13)" VALUE 0x001C6FF4 /* @ECU_Address@FPrm_switches@0x021B901A@ */ ECIPP_ALIGNMENT_UWORD 65535 Compu_IDENTITY 0 65535 PHYS_UNIT "Enable bits" /end CHARACTERISTIC
/begin CHARACTERISTIC FPsw_KNK_min "FPrm_switches(12)" VALUE 0x001C6FF2 /* @ECU_Address@FPrm_switches@0x021B9018@ */ ECIPP_ALIGNMENT_UWORD 65535 Compu_IDENTITY 0 65535 PHYS_UNIT "Enable bits" /end CHARACTERISTIC
/begin CHARACTERISTIC FPsw_KNK_retardlmt "FPrm_switches(383)" VALUE 0x001C72D8 /* @ECU_Address@FPrm_switches@0x021B92FE@ */ ECIPP_ALIGNMENT_UWORD 65535 Compu_IDENTITY 0 65535 PHYS_UNIT "Enable bits" /end CHARACTERISTIC
/begin CHARACTERISTIC FPsw_KNK_retardlmt2 "FPrm_switches(528)" VALUE 0x001C73FA /* @ECU_Address@FPrm_switches@0x021B9420@ */ ECIPP_ALIGNMENT_UWORD 65535 Compu_IDENTITY 0 65535 PHYS_UNIT "Enable bits" /end CHARACTERISTIC
/begin CHARACTERISTIC FPsw_KV1_deltaHi "FPrm_switches(708)" VALUE 0x001C7562 /* @ECU_Address@FPrm_switches@0x021B9588@ */ ECIPP_ALIGNMENT_UWORD 65535 Compu_IDENTITY 0 65535 PHYS_UNIT "Enable bits" /end CHARACTERISTIC
/begin CHARACTERISTIC FPsw_KV1_deltaLo "FPrm_switches(709)" VALUE 0x001C7564 /* @ECU_Address@FPrm_switches@0x021B958A@ */ ECIPP_ALIGNMENT_UWORD 65535 Compu_IDENTITY 0 65535 PHYS_UNIT "Enable bits" /end CHARACTERISTIC
/begin CHARACTERISTIC FPsw_KV1_high "FPrm_switches(701)" VALUE 0x001C7554 /* @ECU_Address@FPrm_switches@0x021B957A@ */ ECIPP_ALIGNMENT_UWORD 65535 Compu_IDENTITY 0 65535 PHYS_UNIT "Enable bits" /end CHARACTERISTIC
/begin CHARACTERISTIC FPsw_KV1_low "FPrm_switches(702)" VALUE 0x001C7556 /* @ECU_Address@FPrm_switches@0x021B957C@ */ ECIPP_ALIGNMENT_UWORD 65535 Compu_IDENTITY 0 65535 PHYS_UNIT "Enable bits" /end CHARACTERISTIC
/begin CHARACTERISTIC FPsw_LOD_flk "FPrm_switches(566)" VALUE 0x001C7446 /* @ECU_Address@FPrm_switches@0x021B946C@ */ ECIPP_ALIGNMENT_UWORD 65535 Compu_IDENTITY 0 65535 PHYS_UNIT "Enable bits" /end CHARACTERISTIC
/begin CHARACTERISTIC FPsw_LOD_FROmax "FPrm_switches(174)" VALUE 0x001C7136 /* @ECU_Address@FPrm_switches@0x021B915C@ */ ECIPP_ALIGNMENT_UWORD 65535 Compu_IDENTITY 0 65535 PHYS_UNIT "Enable bits" /end CHARACTERISTIC
/begin CHARACTERISTIC FPsw_LOD_slk "FPrm_switches(565)" VALUE 0x001C7444 /* @ECU_Address@FPrm_switches@0x021B946A@ */ ECIPP_ALIGNMENT_UWORD 65535 Compu_IDENTITY 0 65535 PHYS_UNIT "Enable bits" /end CHARACTERISTIC
/begin CHARACTERISTIC FPsw_low_fuel_mon "FPrm_switches(711)" VALUE 0x001C7568 /* @ECU_Address@FPrm_switches@0x021B958E@ */ ECIPP_ALIGNMENT_UWORD 65535 Compu_IDENTITY 0 65535 PHYS_UNIT "Enable bits" /end CHARACTERISTIC
/begin CHARACTERISTIC FPsw_LowCLTemp "FPrm_switches(480)" VALUE 0x001C739A /* @ECU_Address@FPrm_switches@0x021B93C0@ */ ECIPP_ALIGNMENT_UWORD 65535 Compu_IDENTITY 0 65535 PHYS_UNIT "Enable bits" /end CHARACTERISTIC
/begin CHARACTERISTIC FPsw_LowDiagTemp "FPrm_switches(481)" VALUE 0x001C739C /* @ECU_Address@FPrm_switches@0x021B93C2@ */ ECIPP_ALIGNMENT_UWORD 65535 Compu_IDENTITY 0 65535 PHYS_UNIT "Enable bits" /end CHARACTERISTIC
/begin CHARACTERISTIC FPsw_LowOperTemp "FPrm_switches(316)" VALUE 0x001C7252 /* @ECU_Address@FPrm_switches@0x021B9278@ */ ECIPP_ALIGNMENT_UWORD 65535 Compu_IDENTITY 0 65535 PHYS_UNIT "Enable bits" /end CHARACTERISTIC
/begin CHARACTERISTIC FPsw_MAP_HiExp "FPrm_switches(389)" VALUE 0x001C72E4 /* @ECU_Address@FPrm_switches@0x021B930A@ */ ECIPP_ALIGNMENT_UWORD 65535 Compu_IDENTITY 0 65535 PHYS_UNIT "Enable bits" /end CHARACTERISTIC
/begin CHARACTERISTIC FPsw_MAP_max "FPrm_switches(0)" VALUE 0x001C6FDA /* @ECU_Address@FPrm_switches@0x021B9000@ */ ECIPP_ALIGNMENT_UWORD 65535 Compu_IDENTITY 0 65535 PHYS_UNIT "Enable bits" /end CHARACTERISTIC
/begin CHARACTERISTIC FPsw_MAP_minv "FPrm_switches(1)" VALUE 0x001C6FDC /* @ECU_Address@FPrm_switches@0x021B9002@ */ ECIPP_ALIGNMENT_UWORD 65535 Compu_IDENTITY 0 65535 PHYS_UNIT "Enable bits" /end CHARACTERISTIC
/begin CHARACTERISTIC FPsw_MFA_ctout "FPrm_switches(589)" VALUE 0x001C7474 /* @ECU_Address@FPrm_switches@0x021B949A@ */ ECIPP_ALIGNMENT_UWORD 65535 Compu_IDENTITY 0 65535 PHYS_UNIT "Enable bits" /end CHARACTERISTIC
/begin CHARACTERISTIC FPsw_MFA_hi_flow "FPrm_switches(684)" VALUE 0x001C7532 /* @ECU_Address@FPrm_switches@0x021B9558@ */ ECIPP_ALIGNMENT_UWORD 65535 Compu_IDENTITY 0 65535 PHYS_UNIT "Enable bits" /end CHARACTERISTIC
/begin CHARACTERISTIC FPsw_MFA_hsd_comm "FPrm_switches(592)" VALUE 0x001C747A /* @ECU_Address@FPrm_switches@0x021B94A0@ */ ECIPP_ALIGNMENT_UWORD 65535 Compu_IDENTITY 0 65535 PHYS_UNIT "Enable bits" /end CHARACTERISTIC
/begin CHARACTERISTIC FPsw_MFA_intF_circ "FPrm_switches(590)" VALUE 0x001C7476 /* @ECU_Address@FPrm_switches@0x021B949C@ */ ECIPP_ALIGNMENT_UWORD 65535 Compu_IDENTITY 0 65535 PHYS_UNIT "Enable bits" /end CHARACTERISTIC
/begin CHARACTERISTIC FPsw_MFA_intF_DP_V_max "FPrm_switches(618)" VALUE 0x001C74AE /* @ECU_Address@FPrm_switches@0x021B94D4@ */ ECIPP_ALIGNMENT_UWORD 65535 Compu_IDENTITY 0 65535 PHYS_UNIT "Enable bits" /end CHARACTERISTIC
/begin CHARACTERISTIC FPsw_MFA_intF_DP_V_min "FPrm_switches(619)" VALUE 0x001C74B0 /* @ECU_Address@FPrm_switches@0x021B94D6@ */ ECIPP_ALIGNMENT_UWORD 65535 Compu_IDENTITY 0 65535 PHYS_UNIT "Enable bits" /end CHARACTERISTIC
/begin CHARACTERISTIC FPsw_MFA_intF_DSPress_V_max "FPrm_switches(616)" VALUE 0x001C74AA /* @ECU_Address@FPrm_switches@0x021B94D0@ */ ECIPP_ALIGNMENT_UWORD 65535 Compu_IDENTITY 0 65535 PHYS_UNIT "Enable bits" /end CHARACTERISTIC
/begin CHARACTERISTIC FPsw_MFA_intF_DSPress_V_min "FPrm_switches(617)" VALUE 0x001C74AC /* @ECU_Address@FPrm_switches@0x021B94D2@ */ ECIPP_ALIGNMENT_UWORD 65535 Compu_IDENTITY 0 65535 PHYS_UNIT "Enable bits" /end CHARACTERISTIC
/begin CHARACTERISTIC FPsw_MFA_intF_FTemp_V_max "FPrm_switches(612)" VALUE 0x001C74A2 /* @ECU_Address@FPrm_switches@0x021B94C8@ */ ECIPP_ALIGNMENT_UWORD 65535 Compu_IDENTITY 0 65535 PHYS_UNIT "Enable bits" /end CHARACTERISTIC
/begin CHARACTERISTIC FPsw_MFA_intF_FTemp_V_min "FPrm_switches(613)" VALUE 0x001C74A4 /* @ECU_Address@FPrm_switches@0x021B94CA@ */ ECIPP_ALIGNMENT_UWORD 65535 Compu_IDENTITY 0 65535 PHYS_UNIT "Enable bits" /end CHARACTERISTIC
/begin CHARACTERISTIC FPsw_MFA_intF_general "FPrm_switches(620)" VALUE 0x001C74B2 /* @ECU_Address@FPrm_switches@0x021B94D8@ */ ECIPP_ALIGNMENT_UWORD 65535 Compu_IDENTITY 0 65535 PHYS_UNIT "Enable bits" /end CHARACTERISTIC
/begin CHARACTERISTIC FPsw_MFA_intF_Tposerr_n "FPrm_switches(609)" VALUE 0x001C749C /* @ECU_Address@FPrm_switches@0x021B94C2@ */ ECIPP_ALIGNMENT_UWORD 65535 Compu_IDENTITY 0 65535 PHYS_UNIT "Enable bits" /end CHARACTERISTIC
/begin CHARACTERISTIC FPsw_MFA_intF_Tposerr_p "FPrm_switches(608)" VALUE 0x001C749A /* @ECU_Address@FPrm_switches@0x021B94C0@ */ ECIPP_ALIGNMENT_UWORD 65535 Compu_IDENTITY 0 65535 PHYS_UNIT "Enable bits" /end CHARACTERISTIC
/begin CHARACTERISTIC FPsw_MFA_intF_USPress_V_max "FPrm_switches(614)" VALUE 0x001C74A6 /* @ECU_Address@FPrm_switches@0x021B94CC@ */ ECIPP_ALIGNMENT_UWORD 65535 Compu_IDENTITY 0 65535 PHYS_UNIT "Enable bits" /end CHARACTERISTIC
/begin CHARACTERISTIC FPsw_MFA_intF_USPress_V_min "FPrm_switches(615)" VALUE 0x001C74A8 /* @ECU_Address@FPrm_switches@0x021B94CE@ */ ECIPP_ALIGNMENT_UWORD 65535 Compu_IDENTITY 0 65535 PHYS_UNIT "Enable bits" /end CHARACTERISTIC
/begin CHARACTERISTIC FPsw_MFA_intF_Vbat_max "FPrm_switches(610)" VALUE 0x001C749E /* @ECU_Address@FPrm_switches@0x021B94C4@ */ ECIPP_ALIGNMENT_UWORD 65535 Compu_IDENTITY 0 65535 PHYS_UNIT "Enable bits" /end CHARACTERISTIC
/begin CHARACTERISTIC FPsw_MFA_intF_Vbat_min "FPrm_switches(611)" VALUE 0x001C74A0 /* @ECU_Address@FPrm_switches@0x021B94C6@ */ ECIPP_ALIGNMENT_UWORD 65535 Compu_IDENTITY 0 65535 PHYS_UNIT "Enable bits" /end CHARACTERISTIC
/begin CHARACTERISTIC FPsw_MFA_lo_flow "FPrm_switches(683)" VALUE 0x001C7530 /* @ECU_Address@FPrm_switches@0x021B9556@ */ ECIPP_ALIGNMENT_UWORD 65535 Compu_IDENTITY 0 65535 PHYS_UNIT "Enable bits" /end CHARACTERISTIC
/begin CHARACTERISTIC FPsw_MFG_ctout "FPrm_switches(587)" VALUE 0x001C7470 /* @ECU_Address@FPrm_switches@0x021B9496@ */ ECIPP_ALIGNMENT_UWORD 65535 Compu_IDENTITY 0 65535 PHYS_UNIT "Enable bits" /end CHARACTERISTIC
/begin CHARACTERISTIC FPsw_MFG_hi_flow "FPrm_switches(686)" VALUE 0x001C7536 /* @ECU_Address@FPrm_switches@0x021B955C@ */ ECIPP_ALIGNMENT_UWORD 65535 Compu_IDENTITY 0 65535 PHYS_UNIT "Enable bits" /end CHARACTERISTIC
/begin CHARACTERISTIC FPsw_MFG_hsd_comm "FPrm_switches(591)" VALUE 0x001C7478 /* @ECU_Address@FPrm_switches@0x021B949E@ */ ECIPP_ALIGNMENT_UWORD 65535 Compu_IDENTITY 0 65535 PHYS_UNIT "Enable bits" /end CHARACTERISTIC
/begin CHARACTERISTIC FPsw_MFG_intF_circ "FPrm_switches(588)" VALUE 0x001C7472 /* @ECU_Address@FPrm_switches@0x021B9498@ */ ECIPP_ALIGNMENT_UWORD 65535 Compu_IDENTITY 0 65535 PHYS_UNIT "Enable bits" /end CHARACTERISTIC
/begin CHARACTERISTIC FPsw_MFG_intF_DP_V_max "FPrm_switches(605)" VALUE 0x001C7494 /* @ECU_Address@FPrm_switches@0x021B94BA@ */ ECIPP_ALIGNMENT_UWORD 65535 Compu_IDENTITY 0 65535 PHYS_UNIT "Enable bits" /end CHARACTERISTIC
/begin CHARACTERISTIC FPsw_MFG_intF_DP_V_min "FPrm_switches(606)" VALUE 0x001C7496 /* @ECU_Address@FPrm_switches@0x021B94BC@ */ ECIPP_ALIGNMENT_UWORD 65535 Compu_IDENTITY 0 65535 PHYS_UNIT "Enable bits" /end CHARACTERISTIC
/begin CHARACTERISTIC FPsw_MFG_intF_DPzVolt_V_max "FPrm_switches(603)" VALUE 0x001C7490 /* @ECU_Address@FPrm_switches@0x021B94B6@ */ ECIPP_ALIGNMENT_UWORD 65535 Compu_IDENTITY 0 65535 PHYS_UNIT "Enable bits" /end CHARACTERISTIC
/begin CHARACTERISTIC FPsw_MFG_intF_DPzVolt_V_min "FPrm_switches(604)" VALUE 0x001C7492 /* @ECU_Address@FPrm_switches@0x021B94B8@ */ ECIPP_ALIGNMENT_UWORD 65535 Compu_IDENTITY 0 65535 PHYS_UNIT "Enable bits" /end CHARACTERISTIC
/begin CHARACTERISTIC FPsw_MFG_intF_DSPress_V_max "FPrm_switches(601)" VALUE 0x001C748C /* @ECU_Address@FPrm_switches@0x021B94B2@ */ ECIPP_ALIGNMENT_UWORD 65535 Compu_IDENTITY 0 65535 PHYS_UNIT "Enable bits" /end CHARACTERISTIC
/begin CHARACTERISTIC FPsw_MFG_intF_DSPress_V_min "FPrm_switches(602)" VALUE 0x001C748E /* @ECU_Address@FPrm_switches@0x021B94B4@ */ ECIPP_ALIGNMENT_UWORD 65535 Compu_IDENTITY 0 65535 PHYS_UNIT "Enable bits" /end CHARACTERISTIC
/begin CHARACTERISTIC FPsw_MFG_intF_FTemp_V_max "FPrm_switches(597)" VALUE 0x001C7484 /* @ECU_Address@FPrm_switches@0x021B94AA@ */ ECIPP_ALIGNMENT_UWORD 65535 Compu_IDENTITY 0 65535 PHYS_UNIT "Enable bits" /end CHARACTERISTIC
/begin CHARACTERISTIC FPsw_MFG_intF_FTemp_V_min "FPrm_switches(598)" VALUE 0x001C7486 /* @ECU_Address@FPrm_switches@0x021B94AC@ */ ECIPP_ALIGNMENT_UWORD 65535 Compu_IDENTITY 0 65535 PHYS_UNIT "Enable bits" /end CHARACTERISTIC
/begin CHARACTERISTIC FPsw_MFG_intF_general "FPrm_switches(607)" VALUE 0x001C7498 /* @ECU_Address@FPrm_switches@0x021B94BE@ */ ECIPP_ALIGNMENT_UWORD 65535 Compu_IDENTITY 0 65535 PHYS_UNIT "Enable bits" /end CHARACTERISTIC
/begin CHARACTERISTIC FPsw_MFG_intF_Tposerr_n "FPrm_switches(594)" VALUE 0x001C747E /* @ECU_Address@FPrm_switches@0x021B94A4@ */ ECIPP_ALIGNMENT_UWORD 65535 Compu_IDENTITY 0 65535 PHYS_UNIT "Enable bits" /end CHARACTERISTIC
/begin CHARACTERISTIC FPsw_MFG_intF_Tposerr_p "FPrm_switches(593)" VALUE 0x001C747C /* @ECU_Address@FPrm_switches@0x021B94A2@ */ ECIPP_ALIGNMENT_UWORD 65535 Compu_IDENTITY 0 65535 PHYS_UNIT "Enable bits" /end CHARACTERISTIC
/begin CHARACTERISTIC FPsw_MFG_intF_USPress_V_max "FPrm_switches(599)" VALUE 0x001C7488 /* @ECU_Address@FPrm_switches@0x021B94AE@ */ ECIPP_ALIGNMENT_UWORD 65535 Compu_IDENTITY 0 65535 PHYS_UNIT "Enable bits" /end CHARACTERISTIC
/begin CHARACTERISTIC FPsw_MFG_intF_USPress_V_min "FPrm_switches(600)" VALUE 0x001C748A /* @ECU_Address@FPrm_switches@0x021B94B0@ */ ECIPP_ALIGNMENT_UWORD 65535 Compu_IDENTITY 0 65535 PHYS_UNIT "Enable bits" /end CHARACTERISTIC
/begin CHARACTERISTIC FPsw_MFG_intF_Vbat_max "FPrm_switches(595)" VALUE 0x001C7480 /* @ECU_Address@FPrm_switches@0x021B94A6@ */ ECIPP_ALIGNMENT_UWORD 65535 Compu_IDENTITY 0 65535 PHYS_UNIT "Enable bits" /end CHARACTERISTIC
/begin CHARACTERISTIC FPsw_MFG_intF_Vbat_min "FPrm_switches(596)" VALUE 0x001C7482 /* @ECU_Address@FPrm_switches@0x021B94A8@ */ ECIPP_ALIGNMENT_UWORD 65535 Compu_IDENTITY 0 65535 PHYS_UNIT "Enable bits" /end CHARACTERISTIC
/begin CHARACTERISTIC FPsw_MFG_lo_flow "FPrm_switches(685)" VALUE 0x001C7534 /* @ECU_Address@FPrm_switches@0x021B955A@ */ ECIPP_ALIGNMENT_UWORD 65535 Compu_IDENTITY 0 65535 PHYS_UNIT "Enable bits" /end CHARACTERISTIC
/begin CHARACTERISTIC FPsw_MFG_RLV_fail "FPrm_switches(630)" VALUE 0x001C74C6 /* @ECU_Address@FPrm_switches@0x021B94EC@ */ ECIPP_ALIGNMENT_UWORD 65535 Compu_IDENTITY 0 65535 PHYS_UNIT "Enable bits" /end CHARACTERISTIC
/begin CHARACTERISTIC FPsw_MIL_coilopen "FPrm_switches(131)" VALUE 0x001C70E0 /* @ECU_Address@FPrm_switches@0x021B9106@ */ ECIPP_ALIGNMENT_UWORD 65535 Compu_IDENTITY 0 65535 PHYS_UNIT "Enable bits" /end CHARACTERISTIC
/begin CHARACTERISTIC FPsw_MIL_coilshort "FPrm_switches(132)" VALUE 0x001C70E2 /* @ECU_Address@FPrm_switches@0x021B9108@ */ ECIPP_ALIGNMENT_UWORD 65535 Compu_IDENTITY 0 65535 PHYS_UNIT "Enable bits" /end CHARACTERISTIC
/begin CHARACTERISTIC FPsw_MIL_gndshort "FPrm_switches(130)" VALUE 0x001C70DE /* @ECU_Address@FPrm_switches@0x021B9104@ */ ECIPP_ALIGNMENT_UWORD 65535 Compu_IDENTITY 0 65535 PHYS_UNIT "Enable bits" /end CHARACTERISTIC
/begin CHARACTERISTIC FPsw_MJ_comm_tout "FPrm_switches(94)" VALUE 0x001C7096 /* @ECU_Address@FPrm_switches@0x021B90BC@ */ ECIPP_ALIGNMENT_UWORD 65535 Compu_IDENTITY 0 65535 PHYS_UNIT "Enable bits" /end CHARACTERISTIC
/begin CHARACTERISTIC FPsw_MJ_intF_act "FPrm_switches(97)" VALUE 0x001C709C /* @ECU_Address@FPrm_switches@0x021B90C2@ */ ECIPP_ALIGNMENT_UWORD 65535 Compu_IDENTITY 0 65535 PHYS_UNIT "Enable bits" /end CHARACTERISTIC
/begin CHARACTERISTIC FPsw_MJ_intF_az "FPrm_switches(209)" VALUE 0x001C717C /* @ECU_Address@FPrm_switches@0x021B91A2@ */ ECIPP_ALIGNMENT_UWORD 65535 Compu_IDENTITY 0 65535 PHYS_UNIT "Enable bits" /end CHARACTERISTIC
/begin CHARACTERISTIC FCdtc_J1939_TSC1_chksum "FCtl_DTC(792)" VALUE 0x001E3E9A /* @ECU_Address@FCtl_DTC@0x021B5630@ */ ECIPP_ALIGNMENT_UWORD 65535 Compu_IDENTITY 0 65535 PHYS_UNIT "DTC" /end CHARACTERISTIC
/begin CHARACTERISTIC FCdtc_J1939_TSC1_cntr "FCtl_DTC(791)" VALUE 0x001E3E98 /* @ECU_Address@FCtl_DTC@0x021B562E@ */ ECIPP_ALIGNMENT_UWORD 65535 Compu_IDENTITY 0 65535 PHYS_UNIT "DTC" /end CHARACTERISTIC
/begin CHARACTERISTIC FCdtc_J1939_TSC1_loss "FCtl_DTC(217)" VALUE 0x001E3A1C /* @ECU_Address@FCtl_DTC@0x021B51B2@ */ ECIPP_ALIGNMENT_UWORD 65535 Compu_IDENTITY 0 65535 PHYS_UNIT "DTC" /end CHARACTERISTIC
/begin CHARACTERISTIC FCdtc_J1939_Tx2Fail "FCtl_DTC(297)" VALUE 0x001E3ABC /* @ECU_Address@FCtl_DTC@0x021B5252@ */ ECIPP_ALIGNMENT_UWORD 65535 Compu_IDENTITY 0 65535 PHYS_UNIT "DTC" /end CHARACTERISTIC
/begin CHARACTERISTIC FCdtc_J1939_Tx3Fail "FCtl_DTC(298)" VALUE 0x001E3ABE /* @ECU_Address@FCtl_DTC@0x021B5254@ */ ECIPP_ALIGNMENT_UWORD 65535 Compu_IDENTITY 0 65535 PHYS_UNIT "DTC" /end CHARACTERISTIC
/begin CHARACTERISTIC FCdtc_J1939_TxFail "FCtl_DTC(154)" VALUE 0x001E399E /* @ECU_Address@FCtl_DTC@0x021B5134@ */ ECIPP_ALIGNMENT_UWORD 65535 Compu_IDENTITY 0 65535 PHYS_UNIT "DTC" /end CHARACTERISTIC
/begin CHARACTERISTIC FCdtc_KNK_max "FCtl_DTC(107)" VALUE 0x001E3940 /* @ECU_Address@FCtl_DTC@0x021B50D6@ */ ECIPP_ALIGNMENT_UWORD 65535 Compu_IDENTITY 0 65535 PHYS_UNIT "DTC" /end CHARACTERISTIC
/begin CHARACTERISTIC FCdtc_KNK_min "FCtl_DTC(89)" VALUE 0x001E391C /* @ECU_Address@FCtl_DTC@0x021B50B2@ */ ECIPP_ALIGNMENT_UWORD 65535 Compu_IDENTITY 0 65535 PHYS_UNIT "DTC" /end CHARACTERISTIC
/begin CHARACTERISTIC FCdtc_KNK_retardlmt "FCtl_DTC(504)" VALUE 0x001E3C5A /* @ECU_Address@FCtl_DTC@0x021B53F0@ */ ECIPP_ALIGNMENT_UWORD 65535 Compu_IDENTITY 0 65535 PHYS_UNIT "DTC" /end CHARACTERISTIC
/begin CHARACTERISTIC FCdtc_KNK_retardlmt2 "FCtl_DTC(698)" VALUE 0x001E3DDE /* @ECU_Address@FCtl_DTC@0x021B5574@ */ ECIPP_ALIGNMENT_UWORD 65535 Compu_IDENTITY 0 65535 PHYS_UNIT "DTC" /end CHARACTERISTIC
/begin CHARACTERISTIC FCdtc_KV1_deltaHi "FCtl_DTC(961)" VALUE 0x001E3FEC /* @ECU_Address@FCtl_DTC@0x021B5782@ */ ECIPP_ALIGNMENT_UWORD 65535 Compu_IDENTITY 0 65535 PHYS_UNIT "DTC" /end CHARACTERISTIC
/begin CHARACTERISTIC FCdtc_KV1_deltaLo "FCtl_DTC(973)" VALUE 0x001E4004 /* @ECU_Address@FCtl_DTC@0x021B579A@ */ ECIPP_ALIGNMENT_UWORD 65535 Compu_IDENTITY 0 65535 PHYS_UNIT "DTC" /end CHARACTERISTIC
/begin CHARACTERISTIC FCdtc_KV1_high "FCtl_DTC(877)" VALUE 0x001E3F44 /* @ECU_Address@FCtl_DTC@0x021B56DA@ */ ECIPP_ALIGNMENT_UWORD 65535 Compu_IDENTITY 0 65535 PHYS_UNIT "DTC" /end CHARACTERISTIC
/begin CHARACTERISTIC FCdtc_KV1_low "FCtl_DTC(889)" VALUE 0x001E3F5C /* @ECU_Address@FCtl_DTC@0x021B56F2@ */ ECIPP_ALIGNMENT_UWORD 65535 Compu_IDENTITY 0 65535 PHYS_UNIT "DTC" /end CHARACTERISTIC
/begin CHARACTERISTIC FCdtc_LOD_flk "FCtl_DTC(736)" VALUE 0x001E3E2A /* @ECU_Address@FCtl_DTC@0x021B55C0@ */ ECIPP_ALIGNMENT_UWORD 65535 Compu_IDENTITY 0 65535 PHYS_UNIT "DTC" /end CHARACTERISTIC
/begin CHARACTERISTIC FCdtc_LOD_FROmax "FCtl_DTC(218)" VALUE 0x001E3A1E /* @ECU_Address@FCtl_DTC@0x021B51B4@ */ ECIPP_ALIGNMENT_UWORD 65535 Compu_IDENTITY 0 65535 PHYS_UNIT "DTC" /end CHARACTERISTIC
/begin CHARACTERISTIC FCdtc_LOD_slk "FCtl_DTC(735)" VALUE 0x001E3E28 /* @ECU_Address@FCtl_DTC@0x021B55BE@ */ ECIPP_ALIGNMENT_UWORD 65535 Compu_IDENTITY 0 65535 PHYS_UNIT "DTC" /end CHARACTERISTIC
/begin CHARACTERISTIC FCdtc_low_fuel_mon "FCtl_DTC(1015)" VALUE 0x001E4058 /* @ECU_Address@FCtl_DTC@0x021B57EE@ */ ECIPP_ALIGNMENT_UWORD 65535 Compu_IDENTITY 0 65535 PHYS_UNIT "DTC" /end CHARACTERISTIC
/begin CHARACTERISTIC FCdtc_LowCLTemp "FCtl_DTC(650)" VALUE 0x001E3D7E /* @ECU_Address@FCtl_DTC@0x021B5514@ */ ECIPP_ALIGNMENT_UWORD 65535 Compu_IDENTITY 0 65535 PHYS_UNIT "DTC" /end CHARACTERISTIC
/begin CHARACTERISTIC FCdtc_LowDiagTemp "FCtl_DTC(651)" VALUE 0x001E3D80 /* @ECU_Address@FCtl_DTC@0x021B5516@ */ ECIPP_ALIGNMENT_UWORD 65535 Compu_IDENTITY 0 65535 PHYS_UNIT "DTC" /end CHARACTERISTIC
/begin CHARACTERISTIC FCdtc_LowOperTemp "FCtl_DTC(407)" VALUE 0x001E3B98 /* @ECU_Address@FCtl_DTC@0x021B532E@ */ ECIPP_ALIGNMENT_UWORD 65535 Compu_IDENTITY 0 65535 PHYS_UNIT "DTC" /end CHARACTERISTIC
/begin CHARACTERISTIC FCdtc_MAP_HiExp "FCtl_DTC(519)" VALUE 0x001E3C78 /* @ECU_Address@FCtl_DTC@0x021B540E@ */ ECIPP_ALIGNMENT_UWORD 65535 Compu_IDENTITY 0 65535 PHYS_UNIT "DTC" /end CHARACTERISTIC
/begin CHARACTERISTIC FCdtc_MAP_max "FCtl_DTC(0)" VALUE 0x001E386A /* @ECU_Address@FCtl_DTC@0x021B5000@ */ ECIPP_ALIGNMENT_UWORD 65535 Compu_IDENTITY 0 65535 PHYS_UNIT "DTC" /end CHARACTERISTIC
/begin CHARACTERISTIC FCdtc_MAP_minv "FCtl_DTC(1)" VALUE 0x001E386C /* @ECU_Address@FCtl_DTC@0x021B5002@ */ ECIPP_ALIGNMENT_UWORD 65535 Compu_IDENTITY 0 65535 PHYS_UNIT "DTC" /end CHARACTERISTIC
/begin CHARACTERISTIC FCdtc_MFA_ctout "FCtl_DTC(759)" VALUE 0x001E3E58 /* @ECU_Address@FCtl_DTC@0x021B55EE@ */ ECIPP_ALIGNMENT_UWORD 65535 Compu_IDENTITY 0 65535 PHYS_UNIT "DTC" /end CHARACTERISTIC
/begin CHARACTERISTIC FCdtc_MFA_hi_flow "FCtl_DTC(857)" VALUE 0x001E3F1C /* @ECU_Address@FCtl_DTC@0x021B56B2@ */ ECIPP_ALIGNMENT_UWORD 65535 Compu_IDENTITY 0 65535 PHYS_UNIT "DTC" /end CHARACTERISTIC
/begin CHARACTERISTIC FCdtc_MFA_hsd_comm "FCtl_DTC(762)" VALUE 0x001E3E5E /* @ECU_Address@FCtl_DTC@0x021B55F4@ */ ECIPP_ALIGNMENT_UWORD 65535 Compu_IDENTITY 0 65535 PHYS_UNIT "DTC" /end CHARACTERISTIC
/begin CHARACTERISTIC FCdtc_MFA_intF_circ "FCtl_DTC(760)" VALUE 0x001E3E5A /* @ECU_Address@FCtl_DTC@0x021B55F0@ */ ECIPP_ALIGNMENT_UWORD 65535 Compu_IDENTITY 0 65535 PHYS_UNIT "DTC" /end CHARACTERISTIC
/begin CHARACTERISTIC FCdtc_MFA_intF_DP_V_max "FCtl_DTC(788)" VALUE 0x001E3E92 /* @ECU_Address@FCtl_DTC@0x021B5628@ */ ECIPP_ALIGNMENT_UWORD 65535 Compu_IDENTITY 0 65535 PHYS_UNIT "DTC" /end CHARACTERISTIC
/begin CHARACTERISTIC FCdtc_MFA_intF_DP_V_min "FCtl_DTC(789)" VALUE 0x001E3E94 /* @ECU_Address@FCtl_DTC@0x021B562A@ */ ECIPP_ALIGNMENT_UWORD 65535 Compu_IDENTITY 0 65535 PHYS_UNIT "DTC" /end CHARACTERISTIC
/begin CHARACTERISTIC FCdtc_MFA_intF_DSPress_V_max "FCtl_DTC(786)" VALUE 0x001E3E8E /* @ECU_Address@FCtl_DTC@0x021B5624@ */ ECIPP_ALIGNMENT_UWORD 65535 Compu_IDENTITY 0 65535 PHYS_UNIT "DTC" /end CHARACTERISTIC
/begin CHARACTERISTIC FCdtc_MFA_intF_DSPress_V_min "FCtl_DTC(787)" VALUE 0x001E3E90 /* @ECU_Address@FCtl_DTC@0x021B5626@ */ ECIPP_ALIGNMENT_UWORD 65535 Compu_IDENTITY 0 65535 PHYS_UNIT "DTC" /end CHARACTERISTIC
/begin CHARACTERISTIC FCdtc_MFA_intF_FTemp_V_max "FCtl_DTC(782)" VALUE 0x001E3E86 /* @ECU_Address@FCtl_DTC@0x021B561C@ */ ECIPP_ALIGNMENT_UWORD 65535 Compu_IDENTITY 0 65535 PHYS_UNIT "DTC" /end CHARACTERISTIC
/begin CHARACTERISTIC FCdtc_MFA_intF_FTemp_V_min "FCtl_DTC(783)" VALUE 0x001E3E88 /* @ECU_Address@FCtl_DTC@0x021B561E@ */ ECIPP_ALIGNMENT_UWORD 65535 Compu_IDENTITY 0 65535 PHYS_UNIT "DTC" /end CHARACTERISTIC
/begin CHARACTERISTIC FCdtc_MFA_intF_general "FCtl_DTC(790)" VALUE 0x001E3E96 /* @ECU_Address@FCtl_DTC@0x021B562C@ */ ECIPP_ALIGNMENT_UWORD 65535 Compu_IDENTITY 0 65535 PHYS_UNIT "DTC" /end CHARACTERISTIC
/begin CHARACTERISTIC FCdtc_MFA_intF_Tposerr_n "FCtl_DTC(779)" VALUE 0x001E3E80 /* @ECU_Address@FCtl_DTC@0x021B5616@ */ ECIPP_ALIGNMENT_UWORD 65535 Compu_IDENTITY 0 65535 PHYS_UNIT "DTC" /end CHARACTERISTIC
/begin CHARACTERISTIC FCdtc_MFA_intF_Tposerr_p "FCtl_DTC(778)" VALUE 0x001E3E7E /* @ECU_Address@FCtl_DTC@0x021B5614@ */ ECIPP_ALIGNMENT_UWORD 65535 Compu_IDENTITY 0 65535 PHYS_UNIT "DTC" /end CHARACTERISTIC
/begin CHARACTERISTIC FCdtc_MFA_intF_USPress_V_max "FCtl_DTC(784)" VALUE 0x001E3E8A /* @ECU_Address@FCtl_DTC@0x021B5620@ */ ECIPP_ALIGNMENT_UWORD 65535 Compu_IDENTITY 0 65535 PHYS_UNIT "DTC" /end CHARACTERISTIC
/begin CHARACTERISTIC FCdtc_MFA_intF_USPress_V_min "FCtl_DTC(785)" VALUE 0x001E3E8C /* @ECU_Address@FCtl_DTC@0x021B5622@ */ ECIPP_ALIGNMENT_UWORD 65535 Compu_IDENTITY 0 65535 PHYS_UNIT "DTC" /end CHARACTERISTIC
/begin CHARACTERISTIC FCdtc_MFA_intF_Vbat_max "FCtl_DTC(780)" VALUE 0x001E3E82 /* @ECU_Address@FCtl_DTC@0x021B5618@ */ ECIPP_ALIGNMENT_UWORD 65535 Compu_IDENTITY 0 65535 PHYS_UNIT "DTC" /end CHARACTERISTIC
/begin CHARACTERISTIC FCdtc_MFA_intF_Vbat_min "FCtl_DTC(781)" VALUE 0x001E3E84 /* @ECU_Address@FCtl_DTC@0x021B561A@ */ ECIPP_ALIGNMENT_UWORD 65535 Compu_IDENTITY 0 65535 PHYS_UNIT "DTC" /end CHARACTERISTIC
/begin CHARACTERISTIC FCdtc_MFA_lo_flow "FCtl_DTC(856)" VALUE 0x001E3F1A /* @ECU_Address@FCtl_DTC@0x021B56B0@ */ ECIPP_ALIGNMENT_UWORD 65535 Compu_IDENTITY 0 65535 PHYS_UNIT "DTC" /end CHARACTERISTIC
/begin CHARACTERISTIC FCdtc_MFG_ctout "FCtl_DTC(757)" VALUE 0x001E3E54 /* @ECU_Address@FCtl_DTC@0x021B55EA@ */ ECIPP_ALIGNMENT_UWORD 65535 Compu_IDENTITY 0 65535 PHYS_UNIT "DTC" /end CHARACTERISTIC
/begin CHARACTERISTIC FCdtc_MFG_hi_flow "FCtl_DTC(859)" VALUE 0x001E3F20 /* @ECU_Address@FCtl_DTC@0x021B56B6@ */ ECIPP_ALIGNMENT_UWORD 65535 Compu_IDENTITY 0 65535 PHYS_UNIT "DTC" /end CHARACTERISTIC
/begin CHARACTERISTIC FCdtc_MFG_hsd_comm "FCtl_DTC(761)" VALUE 0x001E3E5C /* @ECU_Address@FCtl_DTC@0x021B55F2@ */ ECIPP_ALIGNMENT_UWORD 65535 Compu_IDENTITY 0 65535 PHYS_UNIT "DTC" /end CHARACTERISTIC
/begin CHARACTERISTIC FCdtc_MFG_intF_circ "FCtl_DTC(758)" VALUE 0x001E3E56 /* @ECU_Address@FCtl_DTC@0x021B55EC@ */ ECIPP_ALIGNMENT_UWORD 65535 Compu_IDENTITY 0 65535 PHYS_UNIT "DTC" /end CHARACTERISTIC
/begin CHARACTERISTIC FCdtc_MFG_intF_DP_V_max "FCtl_DTC(775)" VALUE 0x001E3E78 /* @ECU_Address@FCtl_DTC@0x021B560E@ */ ECIPP_ALIGNMENT_UWORD 65535 Compu_IDENTITY 0 65535 PHYS_UNIT "DTC" /end CHARACTERISTIC
/begin CHARACTERISTIC FCdtc_MFG_intF_DP_V_min "FCtl_DTC(776)" VALUE 0x001E3E7A /* @ECU_Address@FCtl_DTC@0x021B5610@ */ ECIPP_ALIGNMENT_UWORD 65535 Compu_IDENTITY 0 65535 PHYS_UNIT "DTC" /end CHARACTERISTIC
/begin CHARACTERISTIC FCdtc_MFG_intF_DPzVolt_V_max "FCtl_DTC(773)" VALUE 0x001E3E74 /* @ECU_Address@FCtl_DTC@0x021B560A@ */ ECIPP_ALIGNMENT_UWORD 65535 Compu_IDENTITY 0 65535 PHYS_UNIT "DTC" /end CHARACTERISTIC
/begin CHARACTERISTIC FCdtc_MFG_intF_DPzVolt_V_min "FCtl_DTC(774)" VALUE 0x001E3E76 /* @ECU_Address@FCtl_DTC@0x021B560C@ */ ECIPP_ALIGNMENT_UWORD 65535 Compu_IDENTITY 0 65535 PHYS_UNIT "DTC" /end CHARACTERISTIC
/begin CHARACTERISTIC FCdtc_MFG_intF_DSPress_V_max "FCtl_DTC(771)" VALUE 0x001E3E70 /* @ECU_Address@FCtl_DTC@0x021B5606@ */ ECIPP_ALIGNMENT_UWORD 65535 Compu_IDENTITY 0 65535 PHYS_UNIT "DTC" /end CHARACTERISTIC
/begin CHARACTERISTIC FCdtc_MFG_intF_DSPress_V_min "FCtl_DTC(772)" VALUE 0x001E3E72 /* @ECU_Address@FCtl_DTC@0x021B5608@ */ ECIPP_ALIGNMENT_UWORD 65535 Compu_IDENTITY 0 65535 PHYS_UNIT "DTC" /end CHARACTERISTIC
/begin CHARACTERISTIC FCdtc_MFG_intF_FTemp_V_max "FCtl_DTC(767)" VALUE 0x001E3E68 /* @ECU_Address@FCtl_DTC@0x021B55FE@ */ ECIPP_ALIGNMENT_UWORD 65535 Compu_IDENTITY 0 65535 PHYS_UNIT "DTC" /end CHARACTERISTIC
/begin CHARACTERISTIC FCdtc_MFG_intF_FTemp_V_min "FCtl_DTC(768)" VALUE 0x001E3E6A /* @ECU_Address@FCtl_DTC@0x021B5600@ */ ECIPP_ALIGNMENT_UWORD 65535 Compu_IDENTITY 0 65535 PHYS_UNIT "DTC" /end CHARACTERISTIC
/begin CHARACTERISTIC FCdtc_MFG_intF_general "FCtl_DTC(777)" VALUE 0x001E3E7C /* @ECU_Address@FCtl_DTC@0x021B5612@ */ ECIPP_ALIGNMENT_UWORD 65535 Compu_IDENTITY 0 65535 PHYS_UNIT "DTC" /end CHARACTERISTIC
/begin CHARACTERISTIC FCdtc_MFG_intF_Tposerr_n "FCtl_DTC(764)" VALUE 0x001E3E62 /* @ECU_Address@FCtl_DTC@0x021B55F8@ */ ECIPP_ALIGNMENT_UWORD 65535 Compu_IDENTITY 0 65535 PHYS_UNIT "DTC" /end CHARACTERISTIC
/begin CHARACTERISTIC FCdtc_MFG_intF_Tposerr_p "FCtl_DTC(763)" VALUE 0x001E3E60 /* @ECU_Address@FCtl_DTC@0x021B55F6@ */ ECIPP_ALIGNMENT_UWORD 65535 Compu_IDENTITY 0 65535 PHYS_UNIT "DTC" /end CHARACTERISTIC
/begin CHARACTERISTIC FCdtc_MFG_intF_USPress_V_max "FCtl_DTC(769)" VALUE 0x001E3E6C /* @ECU_Address@FCtl_DTC@0x021B5602@ */ ECIPP_ALIGNMENT_UWORD 65535 Compu_IDENTITY 0 65535 PHYS_UNIT "DTC" /end CHARACTERISTIC
/begin CHARACTERISTIC FCdtc_MFG_intF_USPress_V_min "FCtl_DTC(770)" VALUE 0x001E3E6E /* @ECU_Address@FCtl_DTC@0x021B5604@ */ ECIPP_ALIGNMENT_UWORD 65535 Compu_IDENTITY 0 65535 PHYS_UNIT "DTC" /end CHARACTERISTIC
/begin CHARACTERISTIC FCdtc_MFG_intF_Vbat_max "FCtl_DTC(765)" VALUE 0x001E3E64 /* @ECU_Address@FCtl_DTC@0x021B55FA@ */ ECIPP_ALIGNMENT_UWORD 65535 Compu_IDENTITY 0 65535 PHYS_UNIT "DTC" /end CHARACTERISTIC
/begin CHARACTERISTIC FCdtc_MFG_intF_Vbat_min "FCtl_DTC(766)" VALUE 0x001E3E66 /* @ECU_Address@FCtl_DTC@0x021B55FC@ */ ECIPP_ALIGNMENT_UWORD 65535 Compu_IDENTITY 0 65535 PHYS_UNIT "DTC" /end CHARACTERISTIC
/begin CHARACTERISTIC FCdtc_MFG_lo_flow "FCtl_DTC(858)" VALUE 0x001E3F1E /* @ECU_Address@FCtl_DTC@0x021B56B4@ */ ECIPP_ALIGNMENT_UWORD 65535 Compu_IDENTITY 0 65535 PHYS_UNIT "DTC" /end CHARACTERISTIC
/begin CHARACTERISTIC FCdtc_MFG_RLV_fail "FCtl_DTC(801)" VALUE 0x001E3EAC /* @ECU_Address@FCtl_DTC@0x021B5642@ */ ECIPP_ALIGNMENT_UWORD 65535 Compu_IDENTITY 0 65535 PHYS_UNIT "DTC" /end CHARACTERISTIC
/begin CHARACTERISTIC FCdtc_MIL_coilopen "FCtl_DTC(171)" VALUE 0x001E39C0 /* @ECU_Address@FCtl_DTC@0x021B5156@ */ ECIPP_ALIGNMENT_UWORD 65535 Compu_IDENTITY 0 65535 PHYS_UNIT "DTC" /end CHARACTERISTIC
/begin CHARACTERISTIC FCdtc_MIL_coilshort "FCtl_DTC(172)" VALUE 0x001E39C2 /* @ECU_Address@FCtl_DTC@0x021B5158@ */ ECIPP_ALIGNMENT_UWORD 65535 Compu_IDENTITY 0 65535 PHYS_UNIT "DTC" /end CHARACTERISTIC
/begin CHARACTERISTIC FCdtc_MIL_gndshort "FCtl_DTC(170)" VALUE 0x001E39BE /* @ECU_Address@FCtl_DTC@0x021B5154@ */ ECIPP_ALIGNMENT_UWORD 65535 Compu_IDENTITY 0 65535 PHYS_UNIT "DTC" /end CHARACTERISTIC
/begin CHARACTERISTIC FCdtc_MJ_comm_tout "FCtl_DTC(135)" VALUE 0x001E3978 /* @ECU_Address@FCtl_DTC@0x021B510E@ */ ECIPP_ALIGNMENT_UWORD 65535 Compu_IDENTITY 0 65535 PHYS_UNIT "DTC" /end CHARACTERISTIC
/begin CHARACTERISTIC FCdtc_MJ_intF_act "FCtl_DTC(138)" VALUE 0x001E397E /* @ECU_Address@FCtl_DTC@0x021B5114@ */ ECIPP_ALIGNMENT_UWORD 65535 Compu_IDENTITY 0 65535 PHYS_UNIT "DTC" /end CHARACTERISTIC
/begin CHARACTERISTIC FCdtc_MJ_intF_az "FCtl_DTC(287)" VALUE 0x001E3AA8 /* @ECU_Address@FCtl_DTC@0x021B523E@ */ ECIPP_ALIGNMENT_UWORD 65535 Compu_IDENTITY 0 65535 PHYS_UNIT "DTC" /end CHARACTERISTIC
/begin CHARACTERISTIC FCfmi_J1939_TSC1_chksum "FCtl_FMI(792)" VALUE 0x001E5C19 /* @ECU_Address@FCtl_FMI@0x021B7318@ */ ECIPP_ALIGNMENT_UBYTE 255 Compu_IDENTITY 0 255 PHYS_UNIT "FMI" /end CHARACTERISTIC
/begin CHARACTERISTIC FCfmi_J1939_TSC1_cntr "FCtl_FMI(791)" VALUE 0x001E5C18 /* @ECU_Address@FCtl_FMI@0x021B7317@ */ ECIPP_ALIGNMENT_UBYTE 255 Compu_IDENTITY 0 255 PHYS_UNIT "FMI" /end CHARACTERISTIC
/begin CHARACTERISTIC FCfmi_J1939_TSC1_loss "FCtl_FMI(217)" VALUE 0x001E59DA /* @ECU_Address@FCtl_FMI@0x021B70D9@ */ ECIPP_ALIGNMENT_UBYTE 255 Compu_IDENTITY 0 255 PHYS_UNIT "FMI" /end CHARACTERISTIC
/begin CHARACTERISTIC FCfmi_J1939_Tx2Fail "FCtl_FMI(297)" VALUE 0x001E5A2A /* @ECU_Address@FCtl_FMI@0x021B7129@ */ ECIPP_ALIGNMENT_UBYTE 255 Compu_IDENTITY 0 255 PHYS_UNIT "FMI" /end CHARACTERISTIC
/begin CHARACTERISTIC FCfmi_J1939_Tx3Fail "FCtl_FMI(298)" VALUE 0x001E5A2B /* @ECU_Address@FCtl_FMI@0x021B712A@ */ ECIPP_ALIGNMENT_UBYTE 255 Compu_IDENTITY 0 255 PHYS_UNIT "FMI" /end CHARACTERISTIC
/begin CHARACTERISTIC FCfmi_J1939_TxFail "FCtl_FMI(154)" VALUE 0x001E599B /* @ECU_Address@FCtl_FMI@0x021B709A@ */ ECIPP_ALIGNMENT_UBYTE 255 Compu_IDENTITY 0 255 PHYS_UNIT "FMI" /end CHARACTERISTIC
/begin CHARACTERISTIC FCfmi_KNK_max "FCtl_FMI(107)" VALUE 0x001E596C /* @ECU_Address@FCtl_FMI@0x021B706B@ */ ECIPP_ALIGNMENT_UBYTE 255 Compu_IDENTITY 0 255 PHYS_UNIT "FMI" /end CHARACTERISTIC
/begin CHARACTERISTIC FCfmi_KNK_min "FCtl_FMI(89)" VALUE 0x001E595A /* @ECU_Address@FCtl_FMI@0x021B7059@ */ ECIPP_ALIGNMENT_UBYTE 255 Compu_IDENTITY 0 255 PHYS_UNIT "FMI" /end CHARACTERISTIC
/begin CHARACTERISTIC FCfmi_KNK_retardlmt "FCtl_FMI(504)" VALUE 0x001E5AF9 /* @ECU_Address@FCtl_FMI@0x021B71F8@ */ ECIPP_ALIGNMENT_UBYTE 255 Compu_IDENTITY 0 255 PHYS_UNIT "FMI" /end CHARACTERISTIC
/begin CHARACTERISTIC FCfmi_KNK_retardlmt2 "FCtl_FMI(698)" VALUE 0x001E5BBB /* @ECU_Address@FCtl_FMI@0x021B72BA@ */ ECIPP_ALIGNMENT_UBYTE 255 Compu_IDENTITY 0 255 PHYS_UNIT "FMI" /end CHARACTERISTIC
/begin CHARACTERISTIC FCfmi_KV1_deltaHi "FCtl_FMI(961)" VALUE 0x001E5CC2 /* @ECU_Address@FCtl_FMI@0x021B73C1@ */ ECIPP_ALIGNMENT_UBYTE 255 Compu_IDENTITY 0 255 PHYS_UNIT "FMI" /end CHARACTERISTIC
/begin CHARACTERISTIC FCfmi_KV1_deltaLo "FCtl_FMI(973)" VALUE 0x001E5CCE /* @ECU_Address@FCtl_FMI@0x021B73CD@ */ ECIPP_ALIGNMENT_UBYTE 255 Compu_IDENTITY 0 255 PHYS_UNIT "FMI" /end CHARACTERISTIC
/begin CHARACTERISTIC FCfmi_KV1_high "FCtl_FMI(877)" VALUE 0x001E5C6E /* @ECU_Address@FCtl_FMI@0x021B736D@ */ ECIPP_ALIGNMENT_UBYTE 255 Compu_IDENTITY 0 255 PHYS_UNIT "FMI" /end CHARACTERISTIC
/begin CHARACTERISTIC FCfmi_KV1_low "FCtl_FMI(889)" VALUE 0x001E5C7A /* @ECU_Address@FCtl_FMI@0x021B7379@ */ ECIPP_ALIGNMENT_UBYTE 255 Compu_IDENTITY 0 255 PHYS_UNIT "FMI" /end CHARACTERISTIC
/begin CHARACTERISTIC FCfmi_LOD_flk "FCtl_FMI(736)" VALUE 0x001E5BE1 /* @ECU_Address@FCtl_FMI@0x021B72E0@ */ ECIPP_ALIGNMENT_UBYTE 255 Compu_IDENTITY 0 255 PHYS_UNIT "FMI" /end CHARACTERISTIC
/begin CHARACTERISTIC FCfmi_LOD_FROmax "FCtl_FMI(218)" VALUE 0x001E59DB /* @ECU_Address@FCtl_FMI@0x021B70DA@ */ ECIPP_ALIGNMENT_UBYTE 255 Compu_IDENTITY 0 255 PHYS_UNIT "FMI" /end CHARACTERISTIC
/begin CHARACTERISTIC FCfmi_LOD_slk "FCtl_FMI(735)" VALUE 0x001E5BE0 /* @ECU_Address@FCtl_FMI@0x021B72DF@ */ ECIPP_ALIGNMENT_UBYTE 255 Compu_IDENTITY 0 255 PHYS_UNIT "FMI" /end CHARACTERISTIC
/begin CHARACTERISTIC FCfmi_low_fuel_mon "FCtl_FMI(1015)" VALUE 0x001E5CF8 /* @ECU_Address@FCtl_FMI@0x021B73F7@ */ ECIPP_ALIGNMENT_UBYTE 255 Compu_IDENTITY 0 255 PHYS_UNIT "FMI" /end CHARACTERISTIC
/begin CHARACTERISTIC FCfmi_LowCLTemp "FCtl_FMI(650)" VALUE 0x001E5B8B /* @ECU_Address@FCtl_FMI@0x021B728A@ */ ECIPP_ALIGNMENT_UBYTE 255 Compu_IDENTITY 0 255 PHYS_UNIT "FMI" /end CHARACTERISTIC
/begin CHARACTERISTIC FCfmi_LowDiagTemp "FCtl_FMI(651)" VALUE 0x001E5B8C /* @ECU_Address@FCtl_FMI@0x021B728B@ */ ECIPP_ALIGNMENT_UBYTE 255 Compu_IDENTITY 0 255 PHYS_UNIT "FMI" /end CHARACTERISTIC
/begin CHARACTERISTIC FCfmi_LowOperTemp "FCtl_FMI(407)" VALUE 0x001E5A98 /* @ECU_Address@FCtl_FMI@0x021B7197@ */ ECIPP_ALIGNMENT_UBYTE 255 Compu_IDENTITY 0 255 PHYS_UNIT "FMI" /end CHARACTERISTIC
/begin CHARACTERISTIC FCfmi_MAP_HiExp "FCtl_FMI(519)" VALUE 0x001E5B08 /* @ECU_Address@FCtl_FMI@0x021B7207@ */ ECIPP_ALIGNMENT_UBYTE 255 Compu_IDENTITY 0 255 PHYS_UNIT "FMI" /end CHARACTERISTIC
/begin CHARACTERISTIC FCfmi_MAP_max "FCtl_FMI(0)" VALUE 0x001E5901 /* @ECU_Address@FCtl_FMI@0x021B7000@ */ ECIPP_ALIGNMENT_UBYTE 255 Compu_IDENTITY 0 255 PHYS_UNIT "FMI" /end CHARACTERISTIC
/begin CHARACTERISTIC FCfmi_MAP_minv "FCtl_FMI(1)" VALUE 0x001E5902 /* @ECU_Address@FCtl_FMI@0x021B7001@ */ ECIPP_ALIGNMENT_UBYTE 255 Compu_IDENTITY 0 255 PHYS_UNIT "FMI" /end CHARACTERISTIC
/begin CHARACTERISTIC FCfmi_MFA_ctout "FCtl_FMI(759)" VALUE 0x001E5BF8 /* @ECU_Address@FCtl_FMI@0x021B72F7@ */ ECIPP_ALIGNMENT_UBYTE 255 Compu_IDENTITY 0 255 PHYS_UNIT "FMI" /end CHARACTERISTIC
/begin CHARACTERISTIC FCfmi_MFA_hi_flow "FCtl_FMI(857)" VALUE 0x001E5C5A /* @ECU_Address@FCtl_FMI@0x021B7359@ */ ECIPP_ALIGNMENT_UBYTE 255 Compu_IDENTITY 0 255 PHYS_UNIT "FMI" /end CHARACTERISTIC
/begin CHARACTERISTIC FCfmi_MFA_hsd_comm "FCtl_FMI(762)" VALUE 0x001E5BFB /* @ECU_Address@FCtl_FMI@0x021B72FA@ */ ECIPP_ALIGNMENT_UBYTE 255 Compu_IDENTITY 0 255 PHYS_UNIT "FMI" /end CHARACTERISTIC
/begin CHARACTERISTIC FCfmi_MFA_intF_circ "FCtl_FMI(760)" VALUE 0x001E5BF9 /* @ECU_Address@FCtl_FMI@0x021B72F8@ */ ECIPP_ALIGNMENT_UBYTE 255 Compu_IDENTITY 0 255 PHYS_UNIT "FMI" /end CHARACTERISTIC
/begin CHARACTERISTIC FCfmi_MFA_intF_DP_V_max "FCtl_FMI(788)" VALUE 0x001E5C15 /* @ECU_Address@FCtl_FMI@0x021B7314@ */ ECIPP_ALIGNMENT_UBYTE 255 Compu_IDENTITY 0 255 PHYS_UNIT "FMI" /end CHARACTERISTIC
/begin CHARACTERISTIC FCfmi_MFA_intF_DP_V_min "FCtl_FMI(789)" VALUE 0x001E5C16 /* @ECU_Address@FCtl_FMI@0x021B7315@ */ ECIPP_ALIGNMENT_UBYTE 255 Compu_IDENTITY 0 255 PHYS_UNIT "FMI" /end CHARACTERISTIC
/begin CHARACTERISTIC FCfmi_MFA_intF_DSPress_V_max "FCtl_FMI(786)" VALUE 0x001E5C13 /* @ECU_Address@FCtl_FMI@0x021B7312@ */ ECIPP_ALIGNMENT_UBYTE 255 Compu_IDENTITY 0 255 PHYS_UNIT "FMI" /end CHARACTERISTIC
/begin CHARACTERISTIC FCfmi_MFA_intF_DSPress_V_min "FCtl_FMI(787)" VALUE 0x001E5C14 /* @ECU_Address@FCtl_FMI@0x021B7313@ */ ECIPP_ALIGNMENT_UBYTE 255 Compu_IDENTITY 0 255 PHYS_UNIT "FMI" /end CHARACTERISTIC
/begin CHARACTERISTIC FCfmi_MFA_intF_FTemp_V_max "FCtl_FMI(782)" VALUE 0x001E5C0F /* @ECU_Address@FCtl_FMI@0x021B730E@ */ ECIPP_ALIGNMENT_UBYTE 255 Compu_IDENTITY 0 255 PHYS_UNIT "FMI" /end CHARACTERISTIC
/begin CHARACTERISTIC FCfmi_MFA_intF_FTemp_V_min "FCtl_FMI(783)" VALUE 0x001E5C10 /* @ECU_Address@FCtl_FMI@0x021B730F@ */ ECIPP_ALIGNMENT_UBYTE 255 Compu_IDENTITY 0 255 PHYS_UNIT "FMI" /end CHARACTERISTIC
/begin CHARACTERISTIC FCfmi_MFA_intF_general "FCtl_FMI(790)" VALUE 0x001E5C17 /* @ECU_Address@FCtl_FMI@0x021B7316@ */ ECIPP_ALIGNMENT_UBYTE 255 Compu_IDENTITY 0 255 PHYS_UNIT "FMI" /end CHARACTERISTIC
/begin CHARACTERISTIC FCfmi_MFA_intF_Tposerr_n "FCtl_FMI(779)" VALUE 0x001E5C0C /* @ECU_Address@FCtl_FMI@0x021B730B@ */ ECIPP_ALIGNMENT_UBYTE 255 Compu_IDENTITY 0 255 PHYS_UNIT "FMI" /end CHARACTERISTIC
/begin CHARACTERISTIC FCfmi_MFA_intF_Tposerr_p "FCtl_FMI(778)" VALUE 0x001E5C0B /* @ECU_Address@FCtl_FMI@0x021B730A@ */ ECIPP_ALIGNMENT_UBYTE 255 Compu_IDENTITY 0 255 PHYS_UNIT "FMI" /end CHARACTERISTIC
/begin CHARACTERISTIC FCfmi_MFA_intF_USPress_V_max "FCtl_FMI(784)" VALUE 0x001E5C11 /* @ECU_Address@FCtl_FMI@0x021B7310@ */ ECIPP_ALIGNMENT_UBYTE 255 Compu_IDENTITY 0 255 PHYS_UNIT "FMI" /end CHARACTERISTIC
/begin CHARACTERISTIC FCfmi_MFA_intF_USPress_V_min "FCtl_FMI(785)" VALUE 0x001E5C12 /* @ECU_Address@FCtl_FMI@0x021B7311@ */ ECIPP_ALIGNMENT_UBYTE 255 Compu_IDENTITY 0 255 PHYS_UNIT "FMI" /end CHARACTERISTIC
/begin CHARACTERISTIC FCfmi_MFA_intF_Vbat_max "FCtl_FMI(780)" VALUE 0x001E5C0D /* @ECU_Address@FCtl_FMI@0x021B730C@ */ ECIPP_ALIGNMENT_UBYTE 255 Compu_IDENTITY 0 255 PHYS_UNIT "FMI" /end CHARACTERISTIC
/begin CHARACTERISTIC FCfmi_MFA_intF_Vbat_min "FCtl_FMI(781)" VALUE 0x001E5C0E /* @ECU_Address@FCtl_FMI@0x021B730D@ */ ECIPP_ALIGNMENT_UBYTE 255 Compu_IDENTITY 0 255 PHYS_UNIT "FMI" /end CHARACTERISTIC
/begin CHARACTERISTIC FCfmi_MFA_lo_flow "FCtl_FMI(856)" VALUE 0x001E5C59 /* @ECU_Address@FCtl_FMI@0x021B7358@ */ ECIPP_ALIGNMENT_UBYTE 255 Compu_IDENTITY 0 255 PHYS_UNIT "FMI" /end CHARACTERISTIC
/begin CHARACTERISTIC FCfmi_MFG_ctout "FCtl_FMI(757)" VALUE 0x001E5BF6 /* @ECU_Address@FCtl_FMI@0x021B72F5@ */ ECIPP_ALIGNMENT_UBYTE 255 Compu_IDENTITY 0 255 PHYS_UNIT "FMI" /end CHARACTERISTIC
/begin CHARACTERISTIC FCfmi_MFG_hi_flow "FCtl_FMI(859)" VALUE 0x001E5C5C /* @ECU_Address@FCtl_FMI@0x021B735B@ */ ECIPP_ALIGNMENT_UBYTE 255 Compu_IDENTITY 0 255 PHYS_UNIT "FMI" /end CHARACTERISTIC
/begin CHARACTERISTIC FCfmi_MFG_hsd_comm "FCtl_FMI(761)" VALUE 0x001E5BFA /* @ECU_Address@FCtl_FMI@0x021B72F9@ */ ECIPP_ALIGNMENT_UBYTE 255 Compu_IDENTITY 0 255 PHYS_UNIT "FMI" /end CHARACTERISTIC
/begin CHARACTERISTIC FCfmi_MFG_intF_circ "FCtl_FMI(758)" VALUE 0x001E5BF7 /* @ECU_Address@FCtl_FMI@0x021B72F6@ */ ECIPP_ALIGNMENT_UBYTE 255 Compu_IDENTITY 0 255 PHYS_UNIT "FMI" /end CHARACTERISTIC
/begin CHARACTERISTIC FCfmi_MFG_intF_DP_V_max "FCtl_FMI(775)" VALUE 0x001E5C08 /* @ECU_Address@FCtl_FMI@0x021B7307@ */ ECIPP_ALIGNMENT_UBYTE 255 Compu_IDENTITY 0 255 PHYS_UNIT "FMI" /end CHARACTERISTIC
/begin CHARACTERISTIC FCfmi_MFG_intF_DP_V_min "FCtl_FMI(776)" VALUE 0x001E5C09 /* @ECU_Address@FCtl_FMI@0x021B7308@ */ ECIPP_ALIGNMENT_UBYTE 255 Compu_IDENTITY 0 255 PHYS_UNIT "FMI" /end CHARACTERISTIC
/begin CHARACTERISTIC FCfmi_MFG_intF_DPzVolt_V_max "FCtl_FMI(773)" VALUE 0x001E5C06 /* @ECU_Address@FCtl_FMI@0x021B7305@ */ ECIPP_ALIGNMENT_UBYTE 255 Compu_IDENTITY 0 255 PHYS_UNIT "FMI" /end CHARACTERISTIC
/begin CHARACTERISTIC FCfmi_MFG_intF_DPzVolt_V_min "FCtl_FMI(774)" VALUE 0x001E5C07 /* @ECU_Address@FCtl_FMI@0x021B7306@ */ ECIPP_ALIGNMENT_UBYTE 255 Compu_IDENTITY 0 255 PHYS_UNIT "FMI" /end CHARACTERISTIC
/begin CHARACTERISTIC FCfmi_MFG_intF_DSPress_V_max "FCtl_FMI(771)" VALUE 0x001E5C04 /* @ECU_Address@FCtl_FMI@0x021B7303@ */ ECIPP_ALIGNMENT_UBYTE 255 Compu_IDENTITY 0 255 PHYS_UNIT "FMI" /end CHARACTERISTIC
/begin CHARACTERISTIC FCfmi_MFG_intF_DSPress_V_min "FCtl_FMI(772)" VALUE 0x001E5C05 /* @ECU_Address@FCtl_FMI@0x021B7304@ */ ECIPP_ALIGNMENT_UBYTE 255 Compu_IDENTITY 0 255 PHYS_UNIT "FMI" /end CHARACTERISTIC
/begin CHARACTERISTIC FCfmi_MFG_intF_FTemp_V_max "FCtl_FMI(767)" VALUE 0x001E5C00 /* @ECU_Address@FCtl_FMI@0x021B72FF@ */ ECIPP_ALIGNMENT_UBYTE 255 Compu_IDENTITY 0 255 PHYS_UNIT "FMI" /end CHARACTERISTIC
/begin CHARACTERISTIC FCfmi_MFG_intF_FTemp_V_min "FCtl_FMI(768)" VALUE 0x001E5C01 /* @ECU_Address@FCtl_FMI@0x021B7300@ */ ECIPP_ALIGNMENT_UBYTE 255 Compu_IDENTITY 0 255 PHYS_UNIT "FMI" /end CHARACTERISTIC
/begin CHARACTERISTIC FCfmi_MFG_intF_general "FCtl_FMI(777)" VALUE 0x001E5C0A /* @ECU_Address@FCtl_FMI@0x021B7309@ */ ECIPP_ALIGNMENT_UBYTE 255 Compu_IDENTITY 0 255 PHYS_UNIT "FMI" /end CHARACTERISTIC
/begin CHARACTERISTIC FCfmi_MFG_intF_Tposerr_n "FCtl_FMI(764)" VALUE 0x001E5BFD /* @ECU_Address@FCtl_FMI@0x021B72FC@ */ ECIPP_ALIGNMENT_UBYTE 255 Compu_IDENTITY 0 255 PHYS_UNIT "FMI" /end CHARACTERISTIC
/begin CHARACTERISTIC FCfmi_MFG_intF_Tposerr_p "FCtl_FMI(763)" VALUE 0x001E5BFC /* @ECU_Address@FCtl_FMI@0x021B72FB@ */ ECIPP_ALIGNMENT_UBYTE 255 Compu_IDENTITY 0 255 PHYS_UNIT "FMI" /end CHARACTERISTIC
/begin CHARACTERISTIC FCfmi_MFG_intF_USPress_V_max "FCtl_FMI(769)" VALUE 0x001E5C02 /* @ECU_Address@FCtl_FMI@0x021B7301@ */ ECIPP_ALIGNMENT_UBYTE 255 Compu_IDENTITY 0 255 PHYS_UNIT "FMI" /end CHARACTERISTIC
/begin CHARACTERISTIC FCfmi_MFG_intF_USPress_V_min "FCtl_FMI(770)" VALUE 0x001E5C03 /* @ECU_Address@FCtl_FMI@0x021B7302@ */ ECIPP_ALIGNMENT_UBYTE 255 Compu_IDENTITY 0 255 PHYS_UNIT "FMI" /end CHARACTERISTIC
/begin CHARACTERISTIC FCfmi_MFG_intF_Vbat_max "FCtl_FMI(765)" VALUE 0x001E5BFE /* @ECU_Address@FCtl_FMI@0x021B72FD@ */ ECIPP_ALIGNMENT_UBYTE 255 Compu_IDENTITY 0 255 PHYS_UNIT "FMI" /end CHARACTERISTIC
/begin CHARACTERISTIC FCfmi_MFG_intF_Vbat_min "FCtl_FMI(766)" VALUE 0x001E5BFF /* @ECU_Address@FCtl_FMI@0x021B72FE@ */ ECIPP_ALIGNMENT_UBYTE 255 Compu_IDENTITY 0 255 PHYS_UNIT "FMI" /end CHARACTERISTIC
/begin CHARACTERISTIC FCfmi_MFG_lo_flow "FCtl_FMI(858)" VALUE 0x001E5C5B /* @ECU_Address@FCtl_FMI@0x021B735A@ */ ECIPP_ALIGNMENT_UBYTE 255 Compu_IDENTITY 0 255 PHYS_UNIT "FMI" /end CHARACTERISTIC
/begin CHARACTERISTIC FCfmi_MFG_RLV_fail "FCtl_FMI(801)" VALUE 0x001E5C22 /* @ECU_Address@FCtl_FMI@0x021B7321@ */ ECIPP_ALIGNMENT_UBYTE 255 Compu_IDENTITY 0 255 PHYS_UNIT "FMI" /end CHARACTERISTIC
/begin CHARACTERISTIC FCfmi_MIL_coilopen "FCtl_FMI(171)" VALUE 0x001E59AC /* @ECU_Address@FCtl_FMI@0x021B70AB@ */ ECIPP_ALIGNMENT_UBYTE 255 Compu_IDENTITY 0 255 PHYS_UNIT "FMI" /end CHARACTERISTIC
/begin CHARACTERISTIC FCfmi_MIL_coilshort "FCtl_FMI(172)" VALUE 0x001E59AD /* @ECU_Address@FCtl_FMI@0x021B70AC@ */ ECIPP_ALIGNMENT_UBYTE 255 Compu_IDENTITY 0 255 PHYS_UNIT "FMI" /end CHARACTERISTIC
/begin CHARACTERISTIC FCfmi_MIL_gndshort "FCtl_FMI(170)" VALUE 0x001E59AB /* @ECU_Address@FCtl_FMI@0x021B70AA@ */ ECIPP_ALIGNMENT_UBYTE 255 Compu_IDENTITY 0 255 PHYS_UNIT "FMI" /end CHARACTERISTIC
/begin CHARACTERISTIC FCfmi_MJ_comm_tout "FCtl_FMI(135)" VALUE 0x001E5988 /* @ECU_Address@FCtl_FMI@0x021B7087@ */ ECIPP_ALIGNMENT_UBYTE 255 Compu_IDENTITY 0 255 PHYS_UNIT "FMI" /end CHARACTERISTIC
/begin CHARACTERISTIC FCfmi_MJ_intF_act "FCtl_FMI(138)" VALUE 0x001E598B /* @ECU_Address@FCtl_FMI@0x021B708A@ */ ECIPP_ALIGNMENT_UBYTE 255 Compu_IDENTITY 0 255 PHYS_UNIT "FMI" /end CHARACTERISTIC
/begin CHARACTERISTIC FCfmi_MJ_intF_az "FCtl_FMI(287)" VALUE 0x001E5A20 /* @ECU_Address@FCtl_FMI@0x021B711F@ */ ECIPP_ALIGNMENT_UBYTE 255 Compu_IDENTITY 0 255 PHYS_UNIT "FMI" /end CHARACTERISTIC
/begin CHARACTERISTIC FCftb_J1939_TSC1_chksum "FCtl_FTB_0x04(792)" VALUE 0x001E602F /* @ECU_Address@FCtl_FTB_0x04@0x024C5318@ */ ECIPP_ALIGNMENT_UBYTE 255 Compu_IDENTITY 0 255 PHYS_UNIT "FTB" /end CHARACTERISTIC
/begin CHARACTERISTIC FCftb_J1939_TSC1_cntr "FCtl_FTB_0x04(791)" VALUE 0x001E602E /* @ECU_Address@FCtl_FTB_0x04@0x024C5317@ */ ECIPP_ALIGNMENT_UBYTE 255 Compu_IDENTITY 0 255 PHYS_UNIT "FTB" /end CHARACTERISTIC
/begin CHARACTERISTIC FCftb_J1939_TSC1_loss "FCtl_FTB_0x04(217)" VALUE 0x001E5DF0 /* @ECU_Address@FCtl_FTB_0x04@0x024C50D9@ */ ECIPP_ALIGNMENT_UBYTE 255 Compu_IDENTITY 0 255 PHYS_UNIT "FTB" /end CHARACTERISTIC
/begin CHARACTERISTIC FCftb_J1939_Tx2Fail "FCtl_FTB_0x04(297)" VALUE 0x001E5E40 /* @ECU_Address@FCtl_FTB_0x04@0x024C5129@ */ ECIPP_ALIGNMENT_UBYTE 255 Compu_IDENTITY 0 255 PHYS_UNIT "FTB" /end CHARACTERISTIC
/begin CHARACTERISTIC FCftb_J1939_Tx3Fail "FCtl_FTB_0x04(298)" VALUE 0x001E5E41 /* @ECU_Address@FCtl_FTB_0x04@0x024C512A@ */ ECIPP_ALIGNMENT_UBYTE 255 Compu_IDENTITY 0 255 PHYS_UNIT "FTB" /end CHARACTERISTIC
/begin CHARACTERISTIC FCftb_J1939_TxFail "FCtl_FTB_0x04(154)" VALUE 0x001E5DB1 /* @ECU_Address@FCtl_FTB_0x04@0x024C509A@ */ ECIPP_ALIGNMENT_UBYTE 255 Compu_IDENTITY 0 255 PHYS_UNIT "FTB" /end CHARACTERISTIC
/begin CHARACTERISTIC FCftb_KNK_max "FCtl_FTB_0x04(107)" VALUE 0x001E5D82 /* @ECU_Address@FCtl_FTB_0x04@0x024C506B@ */ ECIPP_ALIGNMENT_UBYTE 255 Compu_IDENTITY 0 255 PHYS_UNIT "FTB" /end CHARACTERISTIC
/begin CHARACTERISTIC FCftb_KNK_min "FCtl_FTB_0x04(89)" VALUE 0x001E5D70 /* @ECU_Address@FCtl_FTB_0x04@0x024C5059@ */ ECIPP_ALIGNMENT_UBYTE 255 Compu_IDENTITY 0 255 PHYS_UNIT "FTB" /end CHARACTERISTIC
/begin CHARACTERISTIC FCftb_KNK_retardlmt "FCtl_FTB_0x04(504)" VALUE 0x001E5F0F /* @ECU_Address@FCtl_FTB_0x04@0x024C51F8@ */ ECIPP_ALIGNMENT_UBYTE 255 Compu_IDENTITY 0 255 PHYS_UNIT "FTB" /end CHARACTERISTIC
/begin CHARACTERISTIC FCftb_KNK_retardlmt2 "FCtl_FTB_0x04(698)" VALUE 0x001E5FD1 /* @ECU_Address@FCtl_FTB_0x04@0x024C52BA@ */ ECIPP_ALIGNMENT_UBYTE 255 Compu_IDENTITY 0 255 PHYS_UNIT "FTB" /end CHARACTERISTIC
/begin CHARACTERISTIC FCftb_KV1_deltaHi "FCtl_FTB_0x04(961)" VALUE 0x001E60D8 /* @ECU_Address@FCtl_FTB_0x04@0x024C53C1@ */ ECIPP_ALIGNMENT_UBYTE 255 Compu_IDENTITY 0 255 PHYS_UNIT "FTB" /end CHARACTERISTIC
/begin CHARACTERISTIC FCftb_KV1_deltaLo "FCtl_FTB_0x04(973)" VALUE 0x001E60E4 /* @ECU_Address@FCtl_FTB_0x04@0x024C53CD@ */ ECIPP_ALIGNMENT_UBYTE 255 Compu_IDENTITY 0 255 PHYS_UNIT "FTB" /end CHARACTERISTIC
/begin CHARACTERISTIC FCftb_KV1_high "FCtl_FTB_0x04(877)" VALUE 0x001E6084 /* @ECU_Address@FCtl_FTB_0x04@0x024C536D@ */ ECIPP_ALIGNMENT_UBYTE 255 Compu_IDENTITY 0 255 PHYS_UNIT "FTB" /end CHARACTERISTIC
/begin CHARACTERISTIC FCftb_KV1_low "FCtl_FTB_0x04(889)" VALUE 0x001E6090 /* @ECU_Address@FCtl_FTB_0x04@0x024C5379@ */ ECIPP_ALIGNMENT_UBYTE 255 Compu_IDENTITY 0 255 PHYS_UNIT "FTB" /end CHARACTERISTIC
/begin CHARACTERISTIC FCftb_LOD_flk "FCtl_FTB_0x04(736)" VALUE 0x001E5FF7 /* @ECU_Address@FCtl_FTB_0x04@0x024C52E0@ */ ECIPP_ALIGNMENT_UBYTE 255 Compu_IDENTITY 0 255 PHYS_UNIT "FTB" /end CHARACTERISTIC
/begin CHARACTERISTIC FCftb_LOD_FROmax "FCtl_FTB_0x04(218)" VALUE 0x001E5DF1 /* @ECU_Address@FCtl_FTB_0x04@0x024C50DA@ */ ECIPP_ALIGNMENT_UBYTE 255 Compu_IDENTITY 0 255 PHYS_UNIT "FTB" /end CHARACTERISTIC
/begin CHARACTERISTIC FCftb_LOD_slk "FCtl_FTB_0x04(735)" VALUE 0x001E5FF6 /* @ECU_Address@FCtl_FTB_0x04@0x024C52DF@ */ ECIPP_ALIGNMENT_UBYTE 255 Compu_IDENTITY 0 255 PHYS_UNIT "FTB" /end CHARACTERISTIC
/begin CHARACTERISTIC FCftb_low_fuel_mon "FCtl_FTB_0x04(1015)" VALUE 0x001E610E /* @ECU_Address@FCtl_FTB_0x04@0x024C53F7@ */ ECIPP_ALIGNMENT_UBYTE 255 Compu_IDENTITY 0 255 PHYS_UNIT "FTB" /end CHARACTERISTIC
/begin CHARACTERISTIC FCftb_LowCLTemp "FCtl_FTB_0x04(650)" VALUE 0x001E5FA1 /* @ECU_Address@FCtl_FTB_0x04@0x024C528A@ */ ECIPP_ALIGNMENT_UBYTE 255 Compu_IDENTITY 0 255 PHYS_UNIT "FTB" /end CHARACTERISTIC
/begin CHARACTERISTIC FCftb_LowDiagTemp "FCtl_FTB_0x04(651)" VALUE 0x001E5FA2 /* @ECU_Address@FCtl_FTB_0x04@0x024C528B@ */ ECIPP_ALIGNMENT_UBYTE 255 Compu_IDENTITY 0 255 PHYS_UNIT "FTB" /end CHARACTERISTIC
/begin CHARACTERISTIC FCftb_LowOperTemp "FCtl_FTB_0x04(407)" VALUE 0x001E5EAE /* @ECU_Address@FCtl_FTB_0x04@0x024C5197@ */ ECIPP_ALIGNMENT_UBYTE 255 Compu_IDENTITY 0 255 PHYS_UNIT "FTB" /end CHARACTERISTIC
/begin CHARACTERISTIC FCftb_MAP_HiExp "FCtl_FTB_0x04(519)" VALUE 0x001E5F1E /* @ECU_Address@FCtl_FTB_0x04@0x024C5207@ */ ECIPP_ALIGNMENT_UBYTE 255 Compu_IDENTITY 0 255 PHYS_UNIT "FTB" /end CHARACTERISTIC
/begin CHARACTERISTIC FCftb_MAP_max "FCtl_FTB_0x04(0)" VALUE 0x001E5D17 /* @ECU_Address@FCtl_FTB_0x04@0x024C5000@ */ ECIPP_ALIGNMENT_UBYTE 255 Compu_IDENTITY 0 255 PHYS_UNIT "FTB" /end CHARACTERISTIC
/begin CHARACTERISTIC FCftb_MAP_minv "FCtl_FTB_0x04(1)" VALUE 0x001E5D18 /* @ECU_Address@FCtl_FTB_0x04@0x024C5001@ */ ECIPP_ALIGNMENT_UBYTE 255 Compu_IDENTITY 0 255 PHYS_UNIT "FTB" /end CHARACTERISTIC
/begin CHARACTERISTIC FCftb_MFA_ctout "FCtl_FTB_0x04(759)" VALUE 0x001E600E /* @ECU_Address@FCtl_FTB_0x04@0x024C52F7@ */ ECIPP_ALIGNMENT_UBYTE 255 Compu_IDENTITY 0 255 PHYS_UNIT "FTB" /end CHARACTERISTIC
/begin CHARACTERISTIC FCftb_MFA_hi_flow "FCtl_FTB_0x04(857)" VALUE 0x001E6070 /* @ECU_Address@FCtl_FTB_0x04@0x024C5359@ */ ECIPP_ALIGNMENT_UBYTE 255 Compu_IDENTITY 0 255 PHYS_UNIT "FTB" /end CHARACTERISTIC
/begin CHARACTERISTIC FCftb_MFA_hsd_comm "FCtl_FTB_0x04(762)" VALUE 0x001E6011 /* @ECU_Address@FCtl_FTB_0x04@0x024C52FA@ */ ECIPP_ALIGNMENT_UBYTE 255 Compu_IDENTITY 0 255 PHYS_UNIT "FTB" /end CHARACTERISTIC
/begin CHARACTERISTIC FCftb_MFA_intF_circ "FCtl_FTB_0x04(760)" VALUE 0x001E600F /* @ECU_Address@FCtl_FTB_0x04@0x024C52F8@ */ ECIPP_ALIGNMENT_UBYTE 255 Compu_IDENTITY 0 255 PHYS_UNIT "FTB" /end CHARACTERISTIC
/begin CHARACTERISTIC FCftb_MFA_intF_DP_V_max "FCtl_FTB_0x04(788)" VALUE 0x001E602B /* @ECU_Address@FCtl_FTB_0x04@0x024C5314@ */ ECIPP_ALIGNMENT_UBYTE 255 Compu_IDENTITY 0 255 PHYS_UNIT "FTB" /end CHARACTERISTIC
/begin CHARACTERISTIC FCftb_MFA_intF_DP_V_min "FCtl_FTB_0x04(789)" VALUE 0x001E602C /* @ECU_Address@FCtl_FTB_0x04@0x024C5315@ */ ECIPP_ALIGNMENT_UBYTE 255 Compu_IDENTITY 0 255 PHYS_UNIT "FTB" /end CHARACTERISTIC
/begin CHARACTERISTIC FCftb_MFA_intF_DSPress_V_max "FCtl_FTB_0x04(786)" VALUE 0x001E6029 /* @ECU_Address@FCtl_FTB_0x04@0x024C5312@ */ ECIPP_ALIGNMENT_UBYTE 255 Compu_IDENTITY 0 255 PHYS_UNIT "FTB" /end CHARACTERISTIC
/begin CHARACTERISTIC FCftb_MFA_intF_DSPress_V_min "FCtl_FTB_0x04(787)" VALUE 0x001E602A /* @ECU_Address@FCtl_FTB_0x04@0x024C5313@ */ ECIPP_ALIGNMENT_UBYTE 255 Compu_IDENTITY 0 255 PHYS_UNIT "FTB" /end CHARACTERISTIC
/begin CHARACTERISTIC FCftb_MFA_intF_FTemp_V_max "FCtl_FTB_0x04(782)" VALUE 0x001E6025 /* @ECU_Address@FCtl_FTB_0x04@0x024C530E@ */ ECIPP_ALIGNMENT_UBYTE 255 Compu_IDENTITY 0 255 PHYS_UNIT "FTB" /end CHARACTERISTIC
/begin CHARACTERISTIC FCftb_MFA_intF_FTemp_V_min "FCtl_FTB_0x04(783)" VALUE 0x001E6026 /* @ECU_Address@FCtl_FTB_0x04@0x024C530F@ */ ECIPP_ALIGNMENT_UBYTE 255 Compu_IDENTITY 0 255 PHYS_UNIT "FTB" /end CHARACTERISTIC
/begin CHARACTERISTIC FCftb_MFA_intF_general "FCtl_FTB_0x04(790)" VALUE 0x001E602D /* @ECU_Address@FCtl_FTB_0x04@0x024C5316@ */ ECIPP_ALIGNMENT_UBYTE 255 Compu_IDENTITY 0 255 PHYS_UNIT "FTB" /end CHARACTERISTIC
/begin CHARACTERISTIC FCftb_MFA_intF_Tposerr_n "FCtl_FTB_0x04(779)" VALUE 0x001E6022 /* @ECU_Address@FCtl_FTB_0x04@0x024C530B@ */ ECIPP_ALIGNMENT_UBYTE 255 Compu_IDENTITY 0 255 PHYS_UNIT "FTB" /end CHARACTERISTIC
/begin CHARACTERISTIC FCftb_MFA_intF_Tposerr_p "FCtl_FTB_0x04(778)" VALUE 0x001E6021 /* @ECU_Address@FCtl_FTB_0x04@0x024C530A@ */ ECIPP_ALIGNMENT_UBYTE 255 Compu_IDENTITY 0 255 PHYS_UNIT "FTB" /end CHARACTERISTIC
/begin CHARACTERISTIC FCftb_MFA_intF_USPress_V_max "FCtl_FTB_0x04(784)" VALUE 0x001E6027 /* @ECU_Address@FCtl_FTB_0x04@0x024C5310@ */ ECIPP_ALIGNMENT_UBYTE 255 Compu_IDENTITY 0 255 PHYS_UNIT "FTB" /end CHARACTERISTIC
/begin CHARACTERISTIC FCftb_MFA_intF_USPress_V_min "FCtl_FTB_0x04(785)" VALUE 0x001E6028 /* @ECU_Address@FCtl_FTB_0x04@0x024C5311@ */ ECIPP_ALIGNMENT_UBYTE 255 Compu_IDENTITY 0 255 PHYS_UNIT "FTB" /end CHARACTERISTIC
/begin CHARACTERISTIC FCftb_MFA_intF_Vbat_max "FCtl_FTB_0x04(780)" VALUE 0x001E6023 /* @ECU_Address@FCtl_FTB_0x04@0x024C530C@ */ ECIPP_ALIGNMENT_UBYTE 255 Compu_IDENTITY 0 255 PHYS_UNIT "FTB" /end CHARACTERISTIC
/begin CHARACTERISTIC FCftb_MFA_intF_Vbat_min "FCtl_FTB_0x04(781)" VALUE 0x001E6024 /* @ECU_Address@FCtl_FTB_0x04@0x024C530D@ */ ECIPP_ALIGNMENT_UBYTE 255 Compu_IDENTITY 0 255 PHYS_UNIT "FTB" /end CHARACTERISTIC
/begin CHARACTERISTIC FCftb_MFA_lo_flow "FCtl_FTB_0x04(856)" VALUE 0x001E606F /* @ECU_Address@FCtl_FTB_0x04@0x024C5358@ */ ECIPP_ALIGNMENT_UBYTE 255 Compu_IDENTITY 0 255 PHYS_UNIT "FTB" /end CHARACTERISTIC
/begin CHARACTERISTIC FCftb_MFG_ctout "FCtl_FTB_0x04(757)" VALUE 0x001E600C /* @ECU_Address@FCtl_FTB_0x04@0x024C52F5@ */ ECIPP_ALIGNMENT_UBYTE 255 Compu_IDENTITY 0 255 PHYS_UNIT "FTB" /end CHARACTERISTIC
/begin CHARACTERISTIC FCftb_MFG_hi_flow "FCtl_FTB_0x04(859)" VALUE 0x001E6072 /* @ECU_Address@FCtl_FTB_0x04@0x024C535B@ */ ECIPP_ALIGNMENT_UBYTE 255 Compu_IDENTITY 0 255 PHYS_UNIT "FTB" /end CHARACTERISTIC
/begin CHARACTERISTIC FCftb_MFG_hsd_comm "FCtl_FTB_0x04(761)" VALUE 0x001E6010 /* @ECU_Address@FCtl_FTB_0x04@0x024C52F9@ */ ECIPP_ALIGNMENT_UBYTE 255 Compu_IDENTITY 0 255 PHYS_UNIT "FTB" /end CHARACTERISTIC
/begin CHARACTERISTIC FCftb_MFG_intF_circ "FCtl_FTB_0x04(758)" VALUE 0x001E600D /* @ECU_Address@FCtl_FTB_0x04@0x024C52F6@ */ ECIPP_ALIGNMENT_UBYTE 255 Compu_IDENTITY 0 255 PHYS_UNIT "FTB" /end CHARACTERISTIC
/begin CHARACTERISTIC FCftb_MFG_intF_DP_V_max "FCtl_FTB_0x04(775)" VALUE 0x001E601E /* @ECU_Address@FCtl_FTB_0x04@0x024C5307@ */ ECIPP_ALIGNMENT_UBYTE 255 Compu_IDENTITY 0 255 PHYS_UNIT "FTB" /end CHARACTERISTIC
/begin CHARACTERISTIC FCftb_MFG_intF_DP_V_min "FCtl_FTB_0x04(776)" VALUE 0x001E601F /* @ECU_Address@FCtl_FTB_0x04@0x024C5308@ */ ECIPP_ALIGNMENT_UBYTE 255 Compu_IDENTITY 0 255 PHYS_UNIT "FTB" /end CHARACTERISTIC
/begin CHARACTERISTIC FCftb_MFG_intF_DPzVolt_V_max "FCtl_FTB_0x04(773)" VALUE 0x001E601C /* @ECU_Address@FCtl_FTB_0x04@0x024C5305@ */ ECIPP_ALIGNMENT_UBYTE 255 Compu_IDENTITY 0 255 PHYS_UNIT "FTB" /end CHARACTERISTIC
/begin CHARACTERISTIC FCftb_MFG_intF_DPzVolt_V_min "FCtl_FTB_0x04(774)" VALUE 0x001E601D /* @ECU_Address@FCtl_FTB_0x04@0x024C5306@ */ ECIPP_ALIGNMENT_UBYTE 255 Compu_IDENTITY 0 255 PHYS_UNIT "FTB" /end CHARACTERISTIC
/begin CHARACTERISTIC FCftb_MFG_intF_DSPress_V_max "FCtl_FTB_0x04(771)" VALUE 0x001E601A /* @ECU_Address@FCtl_FTB_0x04@0x024C5303@ */ ECIPP_ALIGNMENT_UBYTE 255 Compu_IDENTITY 0 255 PHYS_UNIT "FTB" /end CHARACTERISTIC
/begin CHARACTERISTIC FCftb_MFG_intF_DSPress_V_min "FCtl_FTB_0x04(772)" VALUE 0x001E601B /* @ECU_Address@FCtl_FTB_0x04@0x024C5304@ */ ECIPP_ALIGNMENT_UBYTE 255 Compu_IDENTITY 0 255 PHYS_UNIT "FTB" /end CHARACTERISTIC
/begin CHARACTERISTIC FCftb_MFG_intF_FTemp_V_max "FCtl_FTB_0x04(767)" VALUE 0x001E6016 /* @ECU_Address@FCtl_FTB_0x04@0x024C52FF@ */ ECIPP_ALIGNMENT_UBYTE 255 Compu_IDENTITY 0 255 PHYS_UNIT "FTB" /end CHARACTERISTIC
/begin CHARACTERISTIC FCftb_MFG_intF_FTemp_V_min "FCtl_FTB_0x04(768)" VALUE 0x001E6017 /* @ECU_Address@FCtl_FTB_0x04@0x024C5300@ */ ECIPP_ALIGNMENT_UBYTE 255 Compu_IDENTITY 0 255 PHYS_UNIT "FTB" /end CHARACTERISTIC
/begin CHARACTERISTIC FCftb_MFG_intF_general "FCtl_FTB_0x04(777)" VALUE 0x001E6020 /* @ECU_Address@FCtl_FTB_0x04@0x024C5309@ */ ECIPP_ALIGNMENT_UBYTE 255 Compu_IDENTITY 0 255 PHYS_UNIT "FTB" /end CHARACTERISTIC
/begin CHARACTERISTIC FCftb_MFG_intF_Tposerr_n "FCtl_FTB_0x04(764)" VALUE 0x001E6013 /* @ECU_Address@FCtl_FTB_0x04@0x024C52FC@ */ ECIPP_ALIGNMENT_UBYTE 255 Compu_IDENTITY 0 255 PHYS_UNIT "FTB" /end CHARACTERISTIC
/begin CHARACTERISTIC FCftb_MFG_intF_Tposerr_p "FCtl_FTB_0x04(763)" VALUE 0x001E6012 /* @ECU_Address@FCtl_FTB_0x04@0x024C52FB@ */ ECIPP_ALIGNMENT_UBYTE 255 Compu_IDENTITY 0 255 PHYS_UNIT "FTB" /end CHARACTERISTIC
/begin CHARACTERISTIC FCftb_MFG_intF_USPress_V_max "FCtl_FTB_0x04(769)" VALUE 0x001E6018 /* @ECU_Address@FCtl_FTB_0x04@0x024C5301@ */ ECIPP_ALIGNMENT_UBYTE 255 Compu_IDENTITY 0 255 PHYS_UNIT "FTB" /end CHARACTERISTIC
/begin CHARACTERISTIC FCftb_MFG_intF_USPress_V_min "FCtl_FTB_0x04(770)" VALUE 0x001E6019 /* @ECU_Address@FCtl_FTB_0x04@0x024C5302@ */ ECIPP_ALIGNMENT_UBYTE 255 Compu_IDENTITY 0 255 PHYS_UNIT "FTB" /end CHARACTERISTIC
/begin CHARACTERISTIC FCftb_MFG_intF_Vbat_max "FCtl_FTB_0x04(765)" VALUE 0x001E6014 /* @ECU_Address@FCtl_FTB_0x04@0x024C52FD@ */ ECIPP_ALIGNMENT_UBYTE 255 Compu_IDENTITY 0 255 PHYS_UNIT "FTB" /end CHARACTERISTIC
/begin CHARACTERISTIC FCftb_MFG_intF_Vbat_min "FCtl_FTB_0x04(766)" VALUE 0x001E6015 /* @ECU_Address@FCtl_FTB_0x04@0x024C52FE@ */ ECIPP_ALIGNMENT_UBYTE 255 Compu_IDENTITY 0 255 PHYS_UNIT "FTB" /end CHARACTERISTIC
/begin CHARACTERISTIC FCftb_MFG_lo_flow "FCtl_FTB_0x04(858)" VALUE 0x001E6071 /* @ECU_Address@FCtl_FTB_0x04@0x024C535A@ */ ECIPP_ALIGNMENT_UBYTE 255 Compu_IDENTITY 0 255 PHYS_UNIT "FTB" /end CHARACTERISTIC
/begin CHARACTERISTIC FCftb_MFG_RLV_fail "FCtl_FTB_0x04(801)" VALUE 0x001E6038 /* @ECU_Address@FCtl_FTB_0x04@0x024C5321@ */ ECIPP_ALIGNMENT_UBYTE 255 Compu_IDENTITY 0 255 PHYS_UNIT "FTB" /end CHARACTERISTIC
/begin CHARACTERISTIC FCftb_MIL_coilopen "FCtl_FTB_0x04(171)" VALUE 0x001E5DC2 /* @ECU_Address@FCtl_FTB_0x04@0x024C50AB@ */ ECIPP_ALIGNMENT_UBYTE 255 Compu_IDENTITY 0 255 PHYS_UNIT "FTB" /end CHARACTERISTIC
/begin CHARACTERISTIC FCftb_MIL_coilshort "FCtl_FTB_0x04(172)" VALUE 0x001E5DC3 /* @ECU_Address@FCtl_FTB_0x04@0x024C50AC@ */ ECIPP_ALIGNMENT_UBYTE 255 Compu_IDENTITY 0 255 PHYS_UNIT "FTB" /end CHARACTERISTIC
/begin CHARACTERISTIC FCftb_MIL_gndshort "FCtl_FTB_0x04(170)" VALUE 0x001E5DC1 /* @ECU_Address@FCtl_FTB_0x04@0x024C50AA@ */ ECIPP_ALIGNMENT_UBYTE 255 Compu_IDENTITY 0 255 PHYS_UNIT "FTB" /end CHARACTERISTIC
/begin CHARACTERISTIC FCftb_MJ_comm_tout "FCtl_FTB_0x04(135)" VALUE 0x001E5D9E /* @ECU_Address@FCtl_FTB_0x04@0x024C5087@ */ ECIPP_ALIGNMENT_UBYTE 255 Compu_IDENTITY 0 255 PHYS_UNIT "FTB" /end CHARACTERISTIC
/begin CHARACTERISTIC FCftb_MJ_intF_act "FCtl_FTB_0x04(138)" VALUE 0x001E5DA1 /* @ECU_Address@FCtl_FTB_0x04@0x024C508A@ */ ECIPP_ALIGNMENT_UBYTE 255 Compu_IDENTITY 0 255 PHYS_UNIT "FTB" /end CHARACTERISTIC
/begin CHARACTERISTIC FCftb_MJ_intF_az "FCtl_FTB_0x04(287)" VALUE 0x001E5E36 /* @ECU_Address@FCtl_FTB_0x04@0x024C511F@ */ ECIPP_ALIGNMENT_UBYTE 255 Compu_IDENTITY 0 255 PHYS_UNIT "FTB" /end CHARACTERISTIC
/begin CHARACTERISTIC FCspn_J1939_TSC1_chksum "FCtl_SPN(792)" VALUE 0x001E29C4 /* @ECU_Address@FCtl_SPN@0x21B60C60@ */ ECIPP_ALIGNMENT_ULONG 4294967295 Compu_IDENTITY 0 4294967295 PHYS_UNIT "SPN" /end CHARACTERISTIC
/begin CHARACTERISTIC FCspn_J1939_TSC1_cntr "FCtl_SPN(791)" VALUE 0x001E29C0 /* @ECU_Address@FCtl_SPN@0x21B60C5C@ */ ECIPP_ALIGNMENT_ULONG 4294967295 Compu_IDENTITY 0 4294967295 PHYS_UNIT "SPN" /end CHARACTERISTIC
/begin CHARACTERISTIC FCspn_J1939_TSC1_loss "FCtl_SPN(217)" VALUE 0x001E20C8 /* @ECU_Address@FCtl_SPN@0x21B60364@ */ ECIPP_ALIGNMENT_ULONG 4294967295 Compu_IDENTITY 0 4294967295 PHYS_UNIT "SPN" /end CHARACTERISTIC
/begin CHARACTERISTIC FCspn_J1939_Tx2Fail "FCtl_SPN(297)" VALUE 0x001E2208 /* @ECU_Address@FCtl_SPN@0x21B604A4@ */ ECIPP_ALIGNMENT_ULONG 4294967295 Compu_IDENTITY 0 4294967295 PHYS_UNIT "SPN" /end CHARACTERISTIC
/begin CHARACTERISTIC FCspn_J1939_Tx3Fail "FCtl_SPN(298)" VALUE 0x001E220C /* @ECU_Address@FCtl_SPN@0x21B604A8@ */ ECIPP_ALIGNMENT_ULONG 4294967295 Compu_IDENTITY 0 4294967295 PHYS_UNIT "SPN" /end CHARACTERISTIC
/begin CHARACTERISTIC FCspn_J1939_TxFail "FCtl_SPN(154)" VALUE 0x001E1FCC /* @ECU_Address@FCtl_SPN@0x21B60268@ */ ECIPP_ALIGNMENT_ULONG 4294967295 Compu_IDENTITY 0 4294967295 PHYS_UNIT "SPN" /end CHARACTERISTIC
/begin CHARACTERISTIC FCspn_KNK_max "FCtl_SPN(107)" VALUE 0x001E1F10 /* @ECU_Address@FCtl_SPN@0x21B601AC@ */ ECIPP_ALIGNMENT_ULONG 4294967295 Compu_IDENTITY 0 4294967295 PHYS_UNIT "SPN" /end CHARACTERISTIC
/begin CHARACTERISTIC FCspn_KNK_min "FCtl_SPN(89)" VALUE 0x001E1EC8 /* @ECU_Address@FCtl_SPN@0x21B60164@ */ ECIPP_ALIGNMENT_ULONG 4294967295 Compu_IDENTITY 0 4294967295 PHYS_UNIT "SPN" /end CHARACTERISTIC
/begin CHARACTERISTIC FCspn_KNK_retardlmt "FCtl_SPN(504)" VALUE 0x001E2544 /* @ECU_Address@FCtl_SPN@0x21B607E0@ */ ECIPP_ALIGNMENT_ULONG 4294967295 Compu_IDENTITY 0 4294967295 PHYS_UNIT "SPN" /end CHARACTERISTIC
/begin CHARACTERISTIC FCspn_KNK_retardlmt2 "FCtl_SPN(698)" VALUE 0x001E284C /* @ECU_Address@FCtl_SPN@0x21B60AE8@ */ ECIPP_ALIGNMENT_ULONG 4294967295 Compu_IDENTITY 0 4294967295 PHYS_UNIT "SPN" /end CHARACTERISTIC
/begin CHARACTERISTIC FCspn_KV1_deltaHi "FCtl_SPN(961)" VALUE 0x001E2C68 /* @ECU_Address@FCtl_SPN@0x21B60F04@ */ ECIPP_ALIGNMENT_ULONG 4294967295 Compu_IDENTITY 0 4294967295 PHYS_UNIT "SPN" /end CHARACTERISTIC
/begin CHARACTERISTIC FCspn_KV1_deltaLo "FCtl_SPN(973)" VALUE 0x001E2C98 /* @ECU_Address@FCtl_SPN@0x21B60F34@ */ ECIPP_ALIGNMENT_ULONG 4294967295 Compu_IDENTITY 0 4294967295 PHYS_UNIT "SPN" /end CHARACTERISTIC
/begin CHARACTERISTIC FCspn_KV1_high "FCtl_SPN(877)" VALUE 0x001E2B18 /* @ECU_Address@FCtl_SPN@0x21B60DB4@ */ ECIPP_ALIGNMENT_ULONG 4294967295 Compu_IDENTITY 0 4294967295 PHYS_UNIT "SPN" /end CHARACTERISTIC
/begin CHARACTERISTIC FCspn_KV1_low "FCtl_SPN(889)" VALUE 0x001E2B48 /* @ECU_Address@FCtl_SPN@0x21B60DE4@ */ ECIPP_ALIGNMENT_ULONG 4294967295 Compu_IDENTITY 0 4294967295 PHYS_UNIT "SPN" /end CHARACTERISTIC
/begin CHARACTERISTIC FCspn_LOD_flk "FCtl_SPN(736)" VALUE 0x001E28E4 /* @ECU_Address@FCtl_SPN@0x21B60B80@ */ ECIPP_ALIGNMENT_ULONG 4294967295 Compu_IDENTITY 0 4294967295 PHYS_UNIT "SPN" /end CHARACTERISTIC
/begin CHARACTERISTIC FCspn_LOD_FROmax "FCtl_SPN(218)" VALUE 0x001E20CC /* @ECU_Address@FCtl_SPN@0x21B60368@ */ ECIPP_ALIGNMENT_ULONG 4294967295 Compu_IDENTITY 0 4294967295 PHYS_UNIT "SPN" /end CHARACTERISTIC
/begin CHARACTERISTIC FCspn_LOD_slk "FCtl_SPN(735)" VALUE 0x001E28E0 /* @ECU_Address@FCtl_SPN@0x21B60B7C@ */ ECIPP_ALIGNMENT_ULONG 4294967295 Compu_IDENTITY 0 4294967295 PHYS_UNIT "SPN" /end CHARACTERISTIC
/begin CHARACTERISTIC FCspn_low_fuel_mon "FCtl_SPN(1015)" VALUE 0x001E2D40 /* @ECU_Address@FCtl_SPN@0x21B60FDC@ */ ECIPP_ALIGNMENT_ULONG 4294967295 Compu_IDENTITY 0 4294967295 PHYS_UNIT "SPN" /end CHARACTERISTIC
/begin CHARACTERISTIC FCspn_LowCLTemp "FCtl_SPN(650)" VALUE 0x001E278C /* @ECU_Address@FCtl_SPN@0x21B60A28@ */ ECIPP_ALIGNMENT_ULONG 4294967295 Compu_IDENTITY 0 4294967295 PHYS_UNIT "SPN" /end CHARACTERISTIC
/begin CHARACTERISTIC FCspn_LowDiagTemp "FCtl_SPN(651)" VALUE 0x001E2790 /* @ECU_Address@FCtl_SPN@0x21B60A2C@ */ ECIPP_ALIGNMENT_ULONG 4294967295 Compu_IDENTITY 0 4294967295 PHYS_UNIT "SPN" /end CHARACTERISTIC
/begin CHARACTERISTIC FCspn_LowOperTemp "FCtl_SPN(407)" VALUE 0x001E23C0 /* @ECU_Address@FCtl_SPN@0x21B6065C@ */ ECIPP_ALIGNMENT_ULONG 4294967295 Compu_IDENTITY 0 4294967295 PHYS_UNIT "SPN" /end CHARACTERISTIC
/begin CHARACTERISTIC FCspn_MAP_HiExp "FCtl_SPN(519)" VALUE 0x001E2580 /* @ECU_Address@FCtl_SPN@0x21B6081C@ */ ECIPP_ALIGNMENT_ULONG 4294967295 Compu_IDENTITY 0 4294967295 PHYS_UNIT "SPN" /end CHARACTERISTIC
/begin CHARACTERISTIC FCspn_MAP_max "FCtl_SPN(0)" VALUE 0x001E1D64 /* @ECU_Address@FCtl_SPN@0x21B60000@ */ ECIPP_ALIGNMENT_ULONG 4294967295 Compu_IDENTITY 0 4294967295 PHYS_UNIT "SPN" /end CHARACTERISTIC
/begin CHARACTERISTIC FCspn_MAP_minv "FCtl_SPN(1)" VALUE 0x001E1D68 /* @ECU_Address@FCtl_SPN@0x21B60004@ */ ECIPP_ALIGNMENT_ULONG 4294967295 Compu_IDENTITY 0 4294967295 PHYS_UNIT "SPN" /end CHARACTERISTIC
/begin CHARACTERISTIC FCspn_MFA_ctout "FCtl_SPN(759)" VALUE 0x001E2940 /* @ECU_Address@FCtl_SPN@0x21B60BDC@ */ ECIPP_ALIGNMENT_ULONG 4294967295 Compu_IDENTITY 0 4294967295 PHYS_UNIT "SPN" /end CHARACTERISTIC
/begin CHARACTERISTIC FCspn_MFA_hi_flow "FCtl_SPN(857)" VALUE 0x001E2AC8 /* @ECU_Address@FCtl_SPN@0x21B60D64@ */ ECIPP_ALIGNMENT_ULONG 4294967295 Compu_IDENTITY 0 4294967295 PHYS_UNIT "SPN" /end CHARACTERISTIC
/begin CHARACTERISTIC FCspn_MFA_hsd_comm "FCtl_SPN(762)" VALUE 0x001E294C /* @ECU_Address@FCtl_SPN@0x21B60BE8@ */ ECIPP_ALIGNMENT_ULONG 4294967295 Compu_IDENTITY 0 4294967295 PHYS_UNIT "SPN" /end CHARACTERISTIC
/begin CHARACTERISTIC FCspn_MFA_intF_circ "FCtl_SPN(760)" VALUE 0x001E2944 /* @ECU_Address@FCtl_SPN@0x21B60BE0@ */ ECIPP_ALIGNMENT_ULONG 4294967295 Compu_IDENTITY 0 4294967295 PHYS_UNIT "SPN" /end CHARACTERISTIC
/begin CHARACTERISTIC FCspn_MFA_intF_DP_V_max "FCtl_SPN(788)" VALUE 0x001E29B4 /* @ECU_Address@FCtl_SPN@0x21B60C50@ */ ECIPP_ALIGNMENT_ULONG 4294967295 Compu_IDENTITY 0 4294967295 PHYS_UNIT "SPN" /end CHARACTERISTIC
/begin CHARACTERISTIC FCspn_MFA_intF_DP_V_min "FCtl_SPN(789)" VALUE 0x001E29B8 /* @ECU_Address@FCtl_SPN@0x21B60C54@ */ ECIPP_ALIGNMENT_ULONG 4294967295 Compu_IDENTITY 0 4294967295 PHYS_UNIT "SPN" /end CHARACTERISTIC
/begin CHARACTERISTIC FCspn_MFA_intF_DSPress_V_max "FCtl_SPN(786)" VALUE 0x001E29AC /* @ECU_Address@FCtl_SPN@0x21B60C48@ */ ECIPP_ALIGNMENT_ULONG 4294967295 Compu_IDENTITY 0 4294967295 PHYS_UNIT "SPN" /end CHARACTERISTIC
/begin CHARACTERISTIC FCspn_MFA_intF_DSPress_V_min "FCtl_SPN(787)" VALUE 0x001E29B0 /* @ECU_Address@FCtl_SPN@0x21B60C4C@ */ ECIPP_ALIGNMENT_ULONG 4294967295 Compu_IDENTITY 0 4294967295 PHYS_UNIT "SPN" /end CHARACTERISTIC
/begin CHARACTERISTIC FCspn_MFA_intF_FTemp_V_max "FCtl_SPN(782)" VALUE 0x001E299C /* @ECU_Address@FCtl_SPN@0x21B60C38@ */ ECIPP_ALIGNMENT_ULONG 4294967295 Compu_IDENTITY 0 4294967295 PHYS_UNIT "SPN" /end CHARACTERISTIC
/begin CHARACTERISTIC FCspn_MFA_intF_FTemp_V_min "FCtl_SPN(783)" VALUE 0x001E29A0 /* @ECU_Address@FCtl_SPN@0x21B60C3C@ */ ECIPP_ALIGNMENT_ULONG 4294967295 Compu_IDENTITY 0 4294967295 PHYS_UNIT "SPN" /end CHARACTERISTIC
/begin CHARACTERISTIC FCspn_MFA_intF_general "FCtl_SPN(790)" VALUE 0x001E29BC /* @ECU_Address@FCtl_SPN@0x21B60C58@ */ ECIPP_ALIGNMENT_ULONG 4294967295 Compu_IDENTITY 0 4294967295 PHYS_UNIT "SPN" /end CHARACTERISTIC
/begin CHARACTERISTIC FCspn_MFA_intF_Tposerr_n "FCtl_SPN(779)" VALUE 0x001E2990 /* @ECU_Address@FCtl_SPN@0x21B60C2C@ */ ECIPP_ALIGNMENT_ULONG 4294967295 Compu_IDENTITY 0 4294967295 PHYS_UNIT "SPN" /end CHARACTERISTIC
/begin CHARACTERISTIC FCspn_MFA_intF_Tposerr_p "FCtl_SPN(778)" VALUE 0x001E298C /* @ECU_Address@FCtl_SPN@0x21B60C28@ */ ECIPP_ALIGNMENT_ULONG 4294967295 Compu_IDENTITY 0 4294967295 PHYS_UNIT "SPN" /end CHARACTERISTIC
/begin CHARACTERISTIC FCspn_MFA_intF_USPress_V_max "FCtl_SPN(784)" VALUE 0x001E29A4 /* @ECU_Address@FCtl_SPN@0x21B60C40@ */ ECIPP_ALIGNMENT_ULONG 4294967295 Compu_IDENTITY 0 4294967295 PHYS_UNIT "SPN" /end CHARACTERISTIC
/begin CHARACTERISTIC FCspn_MFA_intF_USPress_V_min "FCtl_SPN(785)" VALUE 0x001E29A8 /* @ECU_Address@FCtl_SPN@0x21B60C44@ */ ECIPP_ALIGNMENT_ULONG 4294967295 Compu_IDENTITY 0 4294967295 PHYS_UNIT "SPN" /end CHARACTERISTIC
/begin CHARACTERISTIC FCspn_MFA_intF_Vbat_max "FCtl_SPN(780)" VALUE 0x001E2994 /* @ECU_Address@FCtl_SPN@0x21B60C30@ */ ECIPP_ALIGNMENT_ULONG 4294967295 Compu_IDENTITY 0 4294967295 PHYS_UNIT "SPN" /end CHARACTERISTIC
/begin CHARACTERISTIC FCspn_MFA_intF_Vbat_min "FCtl_SPN(781)" VALUE 0x001E2998 /* @ECU_Address@FCtl_SPN@0x21B60C34@ */ ECIPP_ALIGNMENT_ULONG 4294967295 Compu_IDENTITY 0 4294967295 PHYS_UNIT "SPN" /end CHARACTERISTIC
/begin CHARACTERISTIC FCspn_MFA_lo_flow "FCtl_SPN(856)" VALUE 0x001E2AC4 /* @ECU_Address@FCtl_SPN@0x21B60D60@ */ ECIPP_ALIGNMENT_ULONG 4294967295 Compu_IDENTITY 0 4294967295 PHYS_UNIT "SPN" /end CHARACTERISTIC
/begin CHARACTERISTIC FCspn_MFG_ctout "FCtl_SPN(757)" VALUE 0x001E2938 /* @ECU_Address@FCtl_SPN@0x21B60BD4@ */ ECIPP_ALIGNMENT_ULONG 4294967295 Compu_IDENTITY 0 4294967295 PHYS_UNIT "SPN" /end CHARACTERISTIC
/begin CHARACTERISTIC FCspn_MFG_hi_flow "FCtl_SPN(859)" VALUE 0x001E2AD0 /* @ECU_Address@FCtl_SPN@0x21B60D6C@ */ ECIPP_ALIGNMENT_ULONG 4294967295 Compu_IDENTITY 0 4294967295 PHYS_UNIT "SPN" /end CHARACTERISTIC
/begin CHARACTERISTIC FCspn_MFG_hsd_comm "FCtl_SPN(761)" VALUE 0x001E2948 /* @ECU_Address@FCtl_SPN@0x21B60BE4@ */ ECIPP_ALIGNMENT_ULONG 4294967295 Compu_IDENTITY 0 4294967295 PHYS_UNIT "SPN" /end CHARACTERISTIC
/begin CHARACTERISTIC FCspn_MFG_intF_circ "FCtl_SPN(758)" VALUE 0x001E293C /* @ECU_Address@FCtl_SPN@0x21B60BD8@ */ ECIPP_ALIGNMENT_ULONG 4294967295 Compu_IDENTITY 0 4294967295 PHYS_UNIT "SPN" /end CHARACTERISTIC
/begin CHARACTERISTIC FCspn_MFG_intF_DP_V_max "FCtl_SPN(775)" VALUE 0x001E2980 /* @ECU_Address@FCtl_SPN@0x21B60C1C@ */ ECIPP_ALIGNMENT_ULONG 4294967295 Compu_IDENTITY 0 4294967295 PHYS_UNIT "SPN" /end CHARACTERISTIC
/begin CHARACTERISTIC FCspn_MFG_intF_DP_V_min "FCtl_SPN(776)" VALUE 0x001E2984 /* @ECU_Address@FCtl_SPN@0x21B60C20@ */ ECIPP_ALIGNMENT_ULONG 4294967295 Compu_IDENTITY 0 4294967295 PHYS_UNIT "SPN" /end CHARACTERISTIC
/begin CHARACTERISTIC FCspn_MFG_intF_DPzVolt_V_max "FCtl_SPN(773)" VALUE 0x001E2978 /* @ECU_Address@FCtl_SPN@0x21B60C14@ */ ECIPP_ALIGNMENT_ULONG 4294967295 Compu_IDENTITY 0 4294967295 PHYS_UNIT "SPN" /end CHARACTERISTIC
/begin CHARACTERISTIC FCspn_MFG_intF_DPzVolt_V_min "FCtl_SPN(774)" VALUE 0x001E297C /* @ECU_Address@FCtl_SPN@0x21B60C18@ */ ECIPP_ALIGNMENT_ULONG 4294967295 Compu_IDENTITY 0 4294967295 PHYS_UNIT "SPN" /end CHARACTERISTIC
/begin CHARACTERISTIC FCspn_MFG_intF_DSPress_V_max "FCtl_SPN(771)" VALUE 0x001E2970 /* @ECU_Address@FCtl_SPN@0x21B60C0C@ */ ECIPP_ALIGNMENT_ULONG 4294967295 Compu_IDENTITY 0 4294967295 PHYS_UNIT "SPN" /end CHARACTERISTIC
/begin CHARACTERISTIC FCspn_MFG_intF_DSPress_V_min "FCtl_SPN(772)" VALUE 0x001E2974 /* @ECU_Address@FCtl_SPN@0x21B60C10@ */ ECIPP_ALIGNMENT_ULONG 4294967295 Compu_IDENTITY 0 4294967295 PHYS_UNIT "SPN" /end CHARACTERISTIC
/begin CHARACTERISTIC FCspn_MFG_intF_FTemp_V_max "FCtl_SPN(767)" VALUE 0x001E2960 /* @ECU_Address@FCtl_SPN@0x21B60BFC@ */ ECIPP_ALIGNMENT_ULONG 4294967295 Compu_IDENTITY 0 4294967295 PHYS_UNIT "SPN" /end CHARACTERISTIC
/begin CHARACTERISTIC FCspn_MFG_intF_FTemp_V_min "FCtl_SPN(768)" VALUE 0x001E2964 /* @ECU_Address@FCtl_SPN@0x21B60C00@ */ ECIPP_ALIGNMENT_ULONG 4294967295 Compu_IDENTITY 0 4294967295 PHYS_UNIT "SPN" /end CHARACTERISTIC
/begin CHARACTERISTIC FCspn_MFG_intF_general "FCtl_SPN(777)" VALUE 0x001E2988 /* @ECU_Address@FCtl_SPN@0x21B60C24@ */ ECIPP_ALIGNMENT_ULONG 4294967295 Compu_IDENTITY 0 4294967295 PHYS_UNIT "SPN" /end CHARACTERISTIC
/begin CHARACTERISTIC FCspn_MFG_intF_Tposerr_n "FCtl_SPN(764)" VALUE 0x001E2954 /* @ECU_Address@FCtl_SPN@0x21B60BF0@ */ ECIPP_ALIGNMENT_ULONG 4294967295 Compu_IDENTITY 0 4294967295 PHYS_UNIT "SPN" /end CHARACTERISTIC
/begin CHARACTERISTIC FCspn_MFG_intF_Tposerr_p "FCtl_SPN(763)" VALUE 0x001E2950 /* @ECU_Address@FCtl_SPN@0x21B60BEC@ */ ECIPP_ALIGNMENT_ULONG 4294967295 Compu_IDENTITY 0 4294967295 PHYS_UNIT "SPN" /end CHARACTERISTIC
/begin CHARACTERISTIC FCspn_MFG_intF_USPress_V_max "FCtl_SPN(769)" VALUE 0x001E2968 /* @ECU_Address@FCtl_SPN@0x21B60C04@ */ ECIPP_ALIGNMENT_ULONG 4294967295 Compu_IDENTITY 0 4294967295 PHYS_UNIT "SPN" /end CHARACTERISTIC
/begin CHARACTERISTIC FCspn_MFG_intF_USPress_V_min "FCtl_SPN(770)" VALUE 0x001E296C /* @ECU_Address@FCtl_SPN@0x21B60C08@ */ ECIPP_ALIGNMENT_ULONG 4294967295 Compu_IDENTITY 0 4294967295 PHYS_UNIT "SPN" /end CHARACTERISTIC
/begin CHARACTERISTIC FCspn_MFG_intF_Vbat_max "FCtl_SPN(765)" VALUE 0x001E2958 /* @ECU_Address@FCtl_SPN@0x21B60BF4@ */ ECIPP_ALIGNMENT_ULONG 4294967295 Compu_IDENTITY 0 4294967295 PHYS_UNIT "SPN" /end CHARACTERISTIC
/begin CHARACTERISTIC FCspn_MFG_intF_Vbat_min "FCtl_SPN(766)" VALUE 0x001E295C /* @ECU_Address@FCtl_SPN@0x21B60BF8@ */ ECIPP_ALIGNMENT_ULONG 4294967295 Compu_IDENTITY 0 4294967295 PHYS_UNIT "SPN" /end CHARACTERISTIC
/begin CHARACTERISTIC FCspn_MFG_lo_flow "FCtl_SPN(858)" VALUE 0x001E2ACC /* @ECU_Address@FCtl_SPN@0x21B60D68@ */ ECIPP_ALIGNMENT_ULONG 4294967295 Compu_IDENTITY 0 4294967295 PHYS_UNIT "SPN" /end CHARACTERISTIC
/begin CHARACTERISTIC FCspn_MFG_RLV_fail "FCtl_SPN(801)" VALUE 0x001E29E8 /* @ECU_Address@FCtl_SPN@0x21B60C84@ */ ECIPP_ALIGNMENT_ULONG 4294967295 Compu_IDENTITY 0 4294967295 PHYS_UNIT "SPN" /end CHARACTERISTIC
/begin CHARACTERISTIC FCspn_MIL_coilopen "FCtl_SPN(171)" VALUE 0x001E2010 /* @ECU_Address@FCtl_SPN@0x21B602AC@ */ ECIPP_ALIGNMENT_ULONG 4294967295 Compu_IDENTITY 0 4294967295 PHYS_UNIT "SPN" /end CHARACTERISTIC
/begin CHARACTERISTIC FCspn_MIL_coilshort "FCtl_SPN(172)" VALUE 0x001E2014 /* @ECU_Address@FCtl_SPN@0x21B602B0@ */ ECIPP_ALIGNMENT_ULONG 4294967295 Compu_IDENTITY 0 4294967295 PHYS_UNIT "SPN" /end CHARACTERISTIC
/begin CHARACTERISTIC FCspn_MIL_gndshort "FCtl_SPN(170)" VALUE 0x001E200C /* @ECU_Address@FCtl_SPN@0x21B602A8@ */ ECIPP_ALIGNMENT_ULONG 4294967295 Compu_IDENTITY 0 4294967295 PHYS_UNIT "SPN" /end CHARACTERISTIC
/begin CHARACTERISTIC FCspn_MJ_comm_tout "FCtl_SPN(135)" VALUE 0x001E1F80 /* @ECU_Address@FCtl_SPN@0x21B6021C@ */ ECIPP_ALIGNMENT_ULONG 4294967295 Compu_IDENTITY 0 4294967295 PHYS_UNIT "SPN" /end CHARACTERISTIC
/begin CHARACTERISTIC FCspn_MJ_intF_act "FCtl_SPN(138)" VALUE 0x001E1F8C /* @ECU_Address@FCtl_SPN@0x21B60228@ */ ECIPP_ALIGNMENT_ULONG 4294967295 Compu_IDENTITY 0 4294967295 PHYS_UNIT "SPN" /end CHARACTERISTIC
/begin CHARACTERISTIC FCspn_MJ_intF_az "FCtl_SPN(287)" VALUE 0x001E21E0 /* @ECU_Address@FCtl_SPN@0x21B6047C@ */ ECIPP_ALIGNMENT_ULONG 4294967295 Compu_IDENTITY 0 4294967295 PHYS_UNIT "SPN" /end CHARACTERISTIC
/begin CHARACTERISTIC FPfl_J1939_TSC1_chksum "FPrm_latch(622)" VALUE 0x001E09D0 /* @ECU_Address@FPrm_latch@0x021BB9B8@ */ ECIPP_ALIGNMENT_FLOAT32_IEEE 10000000000 Compu_IDENTITY -10000000000 10000000000 PHYS_UNIT "ms" /end CHARACTERISTIC
/begin CHARACTERISTIC FPfl_J1939_TSC1_cntr "FPrm_latch(621)" VALUE 0x001E09CC /* @ECU_Address@FPrm_latch@0x021BB9B4@ */ ECIPP_ALIGNMENT_FLOAT32_IEEE 10000000000 Compu_IDENTITY -10000000000 10000000000 PHYS_UNIT "ms" /end CHARACTERISTIC
/begin CHARACTERISTIC FPfl_J1939_TSC1_loss "FPrm_latch(173)" VALUE 0x001E02CC /* @ECU_Address@FPrm_latch@0x021BB2B4@ */ ECIPP_ALIGNMENT_FLOAT32_IEEE 10000000000 Compu_IDENTITY -10000000000 10000000000 PHYS_UNIT "ms" /end CHARACTERISTIC
/begin CHARACTERISTIC FPfl_J1939_Tx2Fail "FPrm_latch(219)" VALUE 0x001E0384 /* @ECU_Address@FPrm_latch@0x021BB36C@ */ ECIPP_ALIGNMENT_FLOAT32_IEEE 10000000000 Compu_IDENTITY -10000000000 10000000000 PHYS_UNIT "ms" /end CHARACTERISTIC
/begin CHARACTERISTIC FPfl_J1939_Tx3Fail "FPrm_latch(220)" VALUE 0x001E0388 /* @ECU_Address@FPrm_latch@0x021BB370@ */ ECIPP_ALIGNMENT_FLOAT32_IEEE 10000000000 Compu_IDENTITY -10000000000 10000000000 PHYS_UNIT "ms" /end CHARACTERISTIC
/begin CHARACTERISTIC FPfl_J1939_TxFail "FPrm_latch(114)" VALUE 0x001E01E0 /* @ECU_Address@FPrm_latch@0x021BB1C8@ */ ECIPP_ALIGNMENT_FLOAT32_IEEE 10000000000 Compu_IDENTITY -10000000000 10000000000 PHYS_UNIT "ms" /end CHARACTERISTIC
/begin CHARACTERISTIC FPfl_KNK_max "FPrm_latch(13)" VALUE 0x001E004C /* @ECU_Address@FPrm_latch@0x021BB034@ */ ECIPP_ALIGNMENT_FLOAT32_IEEE 10000000000 Compu_IDENTITY -10000000000 10000000000 PHYS_UNIT "updates" /end CHARACTERISTIC
/begin CHARACTERISTIC FPfl_KNK_min "FPrm_latch(12)" VALUE 0x001E0048 /* @ECU_Address@FPrm_latch@0x021BB030@ */ ECIPP_ALIGNMENT_FLOAT32_IEEE 10000000000 Compu_IDENTITY -10000000000 10000000000 PHYS_UNIT "updates" /end CHARACTERISTIC
/begin CHARACTERISTIC FPfl_KNK_retardlmt "FPrm_latch(383)" VALUE 0x001E0614 /* @ECU_Address@FPrm_latch@0x021BB5FC@ */ ECIPP_ALIGNMENT_FLOAT32_IEEE 10000000000 Compu_IDENTITY -10000000000 10000000000 PHYS_UNIT "updates" /end CHARACTERISTIC
/begin CHARACTERISTIC FPfl_KNK_retardlmt2 "FPrm_latch(528)" VALUE 0x001E0858 /* @ECU_Address@FPrm_latch@0x021BB840@ */ ECIPP_ALIGNMENT_FLOAT32_IEEE 10000000000 Compu_IDENTITY -10000000000 10000000000 PHYS_UNIT "updates" /end CHARACTERISTIC
/begin CHARACTERISTIC FPfl_KV1_deltaHi "FPrm_latch(708)" VALUE 0x001E0B28 /* @ECU_Address@FPrm_latch@0x021BBB10@ */ ECIPP_ALIGNMENT_FLOAT32_IEEE 10000000000 Compu_IDENTITY -10000000000 10000000000 PHYS_UNIT "ms" /end CHARACTERISTIC
/begin CHARACTERISTIC FPfl_KV1_deltaLo "FPrm_latch(709)" VALUE 0x001E0B2C /* @ECU_Address@FPrm_latch@0x021BBB14@ */ ECIPP_ALIGNMENT_FLOAT32_IEEE 10000000000 Compu_IDENTITY -10000000000 10000000000 PHYS_UNIT "ms" /end CHARACTERISTIC
/begin CHARACTERISTIC FPfl_KV1_high "FPrm_latch(701)" VALUE 0x001E0B0C /* @ECU_Address@FPrm_latch@0x021BBAF4@ */ ECIPP_ALIGNMENT_FLOAT32_IEEE 10000000000 Compu_IDENTITY -10000000000 10000000000 PHYS_UNIT "ms" /end CHARACTERISTIC
/begin CHARACTERISTIC FPfl_KV1_low "FPrm_latch(702)" VALUE 0x001E0B10 /* @ECU_Address@FPrm_latch@0x021BBAF8@ */ ECIPP_ALIGNMENT_FLOAT32_IEEE 10000000000 Compu_IDENTITY -10000000000 10000000000 PHYS_UNIT "ms" /end CHARACTERISTIC
/begin CHARACTERISTIC FPfl_LOD_flk "FPrm_latch(566)" VALUE 0x001E08F0 /* @ECU_Address@FPrm_latch@0x021BB8D8@ */ ECIPP_ALIGNMENT_FLOAT32_IEEE 10000000000 Compu_IDENTITY -10000000000 10000000000 PHYS_UNIT "samples" /end CHARACTERISTIC
/begin CHARACTERISTIC FPfl_LOD_FROmax "FPrm_latch(174)" VALUE 0x001E02D0 /* @ECU_Address@FPrm_latch@0x021BB2B8@ */ ECIPP_ALIGNMENT_FLOAT32_IEEE 10000000000 Compu_IDENTITY -10000000000 10000000000 PHYS_UNIT "ms" /end CHARACTERISTIC
/begin CHARACTERISTIC FPfl_LOD_slk "FPrm_latch(565)" VALUE 0x001E08EC /* @ECU_Address@FPrm_latch@0x021BB8D4@ */ ECIPP_ALIGNMENT_FLOAT32_IEEE 10000000000 Compu_IDENTITY -10000000000 10000000000 PHYS_UNIT "samples" /end CHARACTERISTIC
/begin CHARACTERISTIC FPfl_low_fuel_mon "FPrm_latch(711)" VALUE 0x001E0B34 /* @ECU_Address@FPrm_latch@0x021BBB1C@ */ ECIPP_ALIGNMENT_FLOAT32_IEEE 10000000000 Compu_IDENTITY -10000000000 10000000000 PHYS_UNIT "ms" /end CHARACTERISTIC
/begin CHARACTERISTIC FPfl_LowCLTemp "FPrm_latch(480)" VALUE 0x001E0798 /* @ECU_Address@FPrm_latch@0x021BB780@ */ ECIPP_ALIGNMENT_FLOAT32_IEEE 10000000000 Compu_IDENTITY -10000000000 10000000000 PHYS_UNIT "ms" /end CHARACTERISTIC
/begin CHARACTERISTIC FPfl_LowDiagTemp "FPrm_latch(481)" VALUE 0x001E079C /* @ECU_Address@FPrm_latch@0x021BB784@ */ ECIPP_ALIGNMENT_FLOAT32_IEEE 10000000000 Compu_IDENTITY -10000000000 10000000000 PHYS_UNIT "ms" /end CHARACTERISTIC
/begin CHARACTERISTIC FPfl_LowOperTemp "FPrm_latch(316)" VALUE 0x001E0508 /* @ECU_Address@FPrm_latch@0x021BB4F0@ */ ECIPP_ALIGNMENT_FLOAT32_IEEE 10000000000 Compu_IDENTITY -10000000000 10000000000 PHYS_UNIT "ms" /end CHARACTERISTIC
/begin CHARACTERISTIC FPfl_MAP_HiExp "FPrm_latch(389)" VALUE 0x001E062C /* @ECU_Address@FPrm_latch@0x021BB614@ */ ECIPP_ALIGNMENT_FLOAT32_IEEE 10000000000 Compu_IDENTITY -10000000000 10000000000 PHYS_UNIT "ms" /end CHARACTERISTIC
/begin CHARACTERISTIC FPfl_MAP_max "FPrm_latch(0)" VALUE 0x001E0018 /* @ECU_Address@FPrm_latch@0x021BB000@ */ ECIPP_ALIGNMENT_FLOAT32_IEEE 10000000000 Compu_IDENTITY -10000000000 10000000000 PHYS_UNIT "ms" /end CHARACTERISTIC
/begin CHARACTERISTIC FPfl_MAP_minv "FPrm_latch(1)" VALUE 0x001E001C /* @ECU_Address@FPrm_latch@0x021BB004@ */ ECIPP_ALIGNMENT_FLOAT32_IEEE 10000000000 Compu_IDENTITY -10000000000 10000000000 PHYS_UNIT "ms" /end CHARACTERISTIC
/begin CHARACTERISTIC FPfl_MFA_ctout "FPrm_latch(589)" VALUE 0x001E094C /* @ECU_Address@FPrm_latch@0x021BB934@ */ ECIPP_ALIGNMENT_FLOAT32_IEEE 10000000000 Compu_IDENTITY -10000000000 10000000000 PHYS_UNIT "ms" /end CHARACTERISTIC
/begin CHARACTERISTIC FPfl_MFA_hi_flow "FPrm_latch(684)" VALUE 0x001E0AC8 /* @ECU_Address@FPrm_latch@0x021BBAB0@ */ ECIPP_ALIGNMENT_FLOAT32_IEEE 10000000000 Compu_IDENTITY -10000000000 10000000000 PHYS_UNIT "ms" /end CHARACTERISTIC
/begin CHARACTERISTIC FPfl_MFA_hsd_comm "FPrm_latch(592)" VALUE 0x001E0958 /* @ECU_Address@FPrm_latch@0x021BB940@ */ ECIPP_ALIGNMENT_FLOAT32_IEEE 10000000000 Compu_IDENTITY -10000000000 10000000000 PHYS_UNIT "ms" /end CHARACTERISTIC
/begin CHARACTERISTIC FPfl_MFA_intF_circ "FPrm_latch(590)" VALUE 0x001E0950 /* @ECU_Address@FPrm_latch@0x021BB938@ */ ECIPP_ALIGNMENT_FLOAT32_IEEE 10000000000 Compu_IDENTITY -10000000000 10000000000 PHYS_UNIT "ms" /end CHARACTERISTIC
/begin CHARACTERISTIC FPfl_MFA_intF_DP_V_max "FPrm_latch(618)" VALUE 0x001E09C0 /* @ECU_Address@FPrm_latch@0x021BB9A8@ */ ECIPP_ALIGNMENT_FLOAT32_IEEE 10000000000 Compu_IDENTITY -10000000000 10000000000 PHYS_UNIT "ms" /end CHARACTERISTIC
/begin CHARACTERISTIC FPfl_MFA_intF_DP_V_min "FPrm_latch(619)" VALUE 0x001E09C4 /* @ECU_Address@FPrm_latch@0x021BB9AC@ */ ECIPP_ALIGNMENT_FLOAT32_IEEE 10000000000 Compu_IDENTITY -10000000000 10000000000 PHYS_UNIT "ms" /end CHARACTERISTIC
/begin CHARACTERISTIC FPfl_MFA_intF_DSPress_V_max "FPrm_latch(616)" VALUE 0x001E09B8 /* @ECU_Address@FPrm_latch@0x021BB9A0@ */ ECIPP_ALIGNMENT_FLOAT32_IEEE 10000000000 Compu_IDENTITY -10000000000 10000000000 PHYS_UNIT "ms" /end CHARACTERISTIC
/begin CHARACTERISTIC FPfl_MFA_intF_DSPress_V_min "FPrm_latch(617)" VALUE 0x001E09BC /* @ECU_Address@FPrm_latch@0x021BB9A4@ */ ECIPP_ALIGNMENT_FLOAT32_IEEE 10000000000 Compu_IDENTITY -10000000000 10000000000 PHYS_UNIT "ms" /end CHARACTERISTIC
/begin CHARACTERISTIC FPfl_MFA_intF_FTemp_V_max "FPrm_latch(612)" VALUE 0x001E09A8 /* @ECU_Address@FPrm_latch@0x021BB990@ */ ECIPP_ALIGNMENT_FLOAT32_IEEE 10000000000 Compu_IDENTITY -10000000000 10000000000 PHYS_UNIT "ms" /end CHARACTERISTIC
/begin CHARACTERISTIC FPfl_MFA_intF_FTemp_V_min "FPrm_latch(613)" VALUE 0x001E09AC /* @ECU_Address@FPrm_latch@0x021BB994@ */ ECIPP_ALIGNMENT_FLOAT32_IEEE 10000000000 Compu_IDENTITY -10000000000 10000000000 PHYS_UNIT "ms" /end CHARACTERISTIC
/begin CHARACTERISTIC FPfl_MFA_intF_general "FPrm_latch(620)" VALUE 0x001E09C8 /* @ECU_Address@FPrm_latch@0x021BB9B0@ */ ECIPP_ALIGNMENT_FLOAT32_IEEE 10000000000 Compu_IDENTITY -10000000000 10000000000 PHYS_UNIT "ms" /end CHARACTERISTIC
/begin CHARACTERISTIC FPfl_MFA_intF_Tposerr_n "FPrm_latch(609)" VALUE 0x001E099C /* @ECU_Address@FPrm_latch@0x021BB984@ */ ECIPP_ALIGNMENT_FLOAT32_IEEE 10000000000 Compu_IDENTITY -10000000000 10000000000 PHYS_UNIT "ms" /end CHARACTERISTIC
/begin CHARACTERISTIC FPfl_MFA_intF_Tposerr_p "FPrm_latch(608)" VALUE 0x001E0998 /* @ECU_Address@FPrm_latch@0x021BB980@ */ ECIPP_ALIGNMENT_FLOAT32_IEEE 10000000000 Compu_IDENTITY -10000000000 10000000000 PHYS_UNIT "ms" /end CHARACTERISTIC
/begin CHARACTERISTIC FPfl_MFA_intF_USPress_V_max "FPrm_latch(614)" VALUE 0x001E09B0 /* @ECU_Address@FPrm_latch@0x021BB998@ */ ECIPP_ALIGNMENT_FLOAT32_IEEE 10000000000 Compu_IDENTITY -10000000000 10000000000 PHYS_UNIT "ms" /end CHARACTERISTIC
/begin CHARACTERISTIC FPfl_MFA_intF_USPress_V_min "FPrm_latch(615)" VALUE 0x001E09B4 /* @ECU_Address@FPrm_latch@0x021BB99C@ */ ECIPP_ALIGNMENT_FLOAT32_IEEE 10000000000 Compu_IDENTITY -10000000000 10000000000 PHYS_UNIT "ms" /end CHARACTERISTIC
/begin CHARACTERISTIC FPfl_MFA_intF_Vbat_max "FPrm_latch(610)" VALUE 0x001E09A0 /* @ECU_Address@FPrm_latch@0x021BB988@ */ ECIPP_ALIGNMENT_FLOAT32_IEEE 10000000000 Compu_IDENTITY -10000000000 10000000000 PHYS_UNIT "ms" /end CHARACTERISTIC
/begin CHARACTERISTIC FPfl_MFA_intF_Vbat_min "FPrm_latch(611)" VALUE 0x001E09A4 /* @ECU_Address@FPrm_latch@0x021BB98C@ */ ECIPP_ALIGNMENT_FLOAT32_IEEE 10000000000 Compu_IDENTITY -10000000000 10000000000 PHYS_UNIT "ms" /end CHARACTERISTIC
/begin CHARACTERISTIC FPfl_MFA_lo_flow "FPrm_latch(683)" VALUE 0x001E0AC4 /* @ECU_Address@FPrm_latch@0x021BBAAC@ */ ECIPP_ALIGNMENT_FLOAT32_IEEE 10000000000 Compu_IDENTITY -10000000000 10000000000 PHYS_UNIT "ms" /end CHARACTERISTIC
/begin CHARACTERISTIC FPfl_MFG_ctout "FPrm_latch(587)" VALUE 0x001E0944 /* @ECU_Address@FPrm_latch@0x021BB92C@ */ ECIPP_ALIGNMENT_FLOAT32_IEEE 10000000000 Compu_IDENTITY -10000000000 10000000000 PHYS_UNIT "ms" /end CHARACTERISTIC
/begin CHARACTERISTIC FPfl_MFG_hi_flow "FPrm_latch(686)" VALUE 0x001E0AD0 /* @ECU_Address@FPrm_latch@0x021BBAB8@ */ ECIPP_ALIGNMENT_FLOAT32_IEEE 10000000000 Compu_IDENTITY -10000000000 10000000000 PHYS_UNIT "ms" /end CHARACTERISTIC
/begin CHARACTERISTIC FPfl_MFG_hsd_comm "FPrm_latch(591)" VALUE 0x001E0954 /* @ECU_Address@FPrm_latch@0x021BB93C@ */ ECIPP_ALIGNMENT_FLOAT32_IEEE 10000000000 Compu_IDENTITY -10000000000 10000000000 PHYS_UNIT "ms" /end CHARACTERISTIC
/begin CHARACTERISTIC FPfl_MFG_intF_circ "FPrm_latch(588)" VALUE 0x001E0948 /* @ECU_Address@FPrm_latch@0x021BB930@ */ ECIPP_ALIGNMENT_FLOAT32_IEEE 10000000000 Compu_IDENTITY -10000000000 10000000000 PHYS_UNIT "ms" /end CHARACTERISTIC
/begin CHARACTERISTIC FPfl_MFG_intF_DP_V_max "FPrm_latch(605)" VALUE 0x001E098C /* @ECU_Address@FPrm_latch@0x021BB974@ */ ECIPP_ALIGNMENT_FLOAT32_IEEE 10000000000 Compu_IDENTITY -10000000000 10000000000 PHYS_UNIT "ms" /end CHARACTERISTIC
/begin CHARACTERISTIC FPfl_MFG_intF_DP_V_min "FPrm_latch(606)" VALUE 0x001E0990 /* @ECU_Address@FPrm_latch@0x021BB978@ */ ECIPP_ALIGNMENT_FLOAT32_IEEE 10000000000 Compu_IDENTITY -10000000000 10000000000 PHYS_UNIT "ms" /end CHARACTERISTIC
/begin CHARACTERISTIC FPfl_MFG_intF_DPzVolt_V_max "FPrm_latch(603)" VALUE 0x001E0984 /* @ECU_Address@FPrm_latch@0x021BB96C@ */ ECIPP_ALIGNMENT_FLOAT32_IEEE 10000000000 Compu_IDENTITY -10000000000 10000000000 PHYS_UNIT "ms" /end CHARACTERISTIC
/begin CHARACTERISTIC FPfl_MFG_intF_DPzVolt_V_min "FPrm_latch(604)" VALUE 0x001E0988 /* @ECU_Address@FPrm_latch@0x021BB970@ */ ECIPP_ALIGNMENT_FLOAT32_IEEE 10000000000 Compu_IDENTITY -10000000000 10000000000 PHYS_UNIT "ms" /end CHARACTERISTIC
/begin CHARACTERISTIC FPfl_MFG_intF_DSPress_V_max "FPrm_latch(601)" VALUE 0x001E097C /* @ECU_Address@FPrm_latch@0x021BB964@ */ ECIPP_ALIGNMENT_FLOAT32_IEEE 10000000000 Compu_IDENTITY -10000000000 10000000000 PHYS_UNIT "ms" /end CHARACTERISTIC
/begin CHARACTERISTIC FPfl_MFG_intF_DSPress_V_min "FPrm_latch(602)" VALUE 0x001E0980 /* @ECU_Address@FPrm_latch@0x021BB968@ */ ECIPP_ALIGNMENT_FLOAT32_IEEE 10000000000 Compu_IDENTITY -10000000000 10000000000 PHYS_UNIT "ms" /end CHARACTERISTIC
/begin CHARACTERISTIC FPfl_MFG_intF_FTemp_V_max "FPrm_latch(597)" VALUE 0x001E096C /* @ECU_Address@FPrm_latch@0x021BB954@ */ ECIPP_ALIGNMENT_FLOAT32_IEEE 10000000000 Compu_IDENTITY -10000000000 10000000000 PHYS_UNIT "ms" /end CHARACTERISTIC
/begin CHARACTERISTIC FPfl_MFG_intF_FTemp_V_min "FPrm_latch(598)" VALUE 0x001E0970 /* @ECU_Address@FPrm_latch@0x021BB958@ */ ECIPP_ALIGNMENT_FLOAT32_IEEE 10000000000 Compu_IDENTITY -10000000000 10000000000 PHYS_UNIT "ms" /end CHARACTERISTIC
/begin CHARACTERISTIC FPfl_MFG_intF_general "FPrm_latch(607)" VALUE 0x001E0994 /* @ECU_Address@FPrm_latch@0x021BB97C@ */ ECIPP_ALIGNMENT_FLOAT32_IEEE 10000000000 Compu_IDENTITY -10000000000 10000000000 PHYS_UNIT "ms" /end CHARACTERISTIC
/begin CHARACTERISTIC FPfl_MFG_intF_Tposerr_n "FPrm_latch(594)" VALUE 0x001E0960 /* @ECU_Address@FPrm_latch@0x021BB948@ */ ECIPP_ALIGNMENT_FLOAT32_IEEE 10000000000 Compu_IDENTITY -10000000000 10000000000 PHYS_UNIT "ms" /end CHARACTERISTIC
/begin CHARACTERISTIC FPfl_MFG_intF_Tposerr_p "FPrm_latch(593)" VALUE 0x001E095C /* @ECU_Address@FPrm_latch@0x021BB944@ */ ECIPP_ALIGNMENT_FLOAT32_IEEE 10000000000 Compu_IDENTITY -10000000000 10000000000 PHYS_UNIT "ms" /end CHARACTERISTIC
/begin CHARACTERISTIC FPfl_MFG_intF_USPress_V_max "FPrm_latch(599)" VALUE 0x001E0974 /* @ECU_Address@FPrm_latch@0x021BB95C@ */ ECIPP_ALIGNMENT_FLOAT32_IEEE 10000000000 Compu_IDENTITY -10000000000 10000000000 PHYS_UNIT "ms" /end CHARACTERISTIC
/begin CHARACTERISTIC FPfl_MFG_intF_USPress_V_min "FPrm_latch(600)" VALUE 0x001E0978 /* @ECU_Address@FPrm_latch@0x021BB960@ */ ECIPP_ALIGNMENT_FLOAT32_IEEE 10000000000 Compu_IDENTITY -10000000000 10000000000 PHYS_UNIT "ms" /end CHARACTERISTIC
/begin CHARACTERISTIC FPfl_MFG_intF_Vbat_max "FPrm_latch(595)" VALUE 0x001E0964 /* @ECU_Address@FPrm_latch@0x021BB94C@ */ ECIPP_ALIGNMENT_FLOAT32_IEEE 10000000000 Compu_IDENTITY -10000000000 10000000000 PHYS_UNIT "ms" /end CHARACTERISTIC
/begin CHARACTERISTIC FPfl_MFG_intF_Vbat_min "FPrm_latch(596)" VALUE 0x001E0968 /* @ECU_Address@FPrm_latch@0x021BB950@ */ ECIPP_ALIGNMENT_FLOAT32_IEEE 10000000000 Compu_IDENTITY -10000000000 10000000000 PHYS_UNIT "ms" /end CHARACTERISTIC
/begin CHARACTERISTIC FPfl_MFG_lo_flow "FPrm_latch(685)" VALUE 0x001E0ACC /* @ECU_Address@FPrm_latch@0x021BBAB4@ */ ECIPP_ALIGNMENT_FLOAT32_IEEE 10000000000 Compu_IDENTITY -10000000000 10000000000 PHYS_UNIT "ms" /end CHARACTERISTIC
/begin CHARACTERISTIC FPfl_MFG_RLV_fail "FPrm_latch(630)" VALUE 0x001E09F0 /* @ECU_Address@FPrm_latch@0x021BB9D8@ */ ECIPP_ALIGNMENT_FLOAT32_IEEE 10000000000 Compu_IDENTITY -10000000000 10000000000 PHYS_UNIT "ms" /end CHARACTERISTIC
/begin CHARACTERISTIC FPfl_MIL_coilopen "FPrm_latch(131)" VALUE 0x001E0224 /* @ECU_Address@FPrm_latch@0x021BB20C@ */ ECIPP_ALIGNMENT_FLOAT32_IEEE 10000000000 Compu_IDENTITY -10000000000 10000000000 PHYS_UNIT "samples" /end CHARACTERISTIC
/begin CHARACTERISTIC FPfl_MIL_coilshort "FPrm_latch(132)" VALUE 0x001E0228 /* @ECU_Address@FPrm_latch@0x021BB210@ */ ECIPP_ALIGNMENT_FLOAT32_IEEE 10000000000 Compu_IDENTITY -10000000000 10000000000 PHYS_UNIT "samples" /end CHARACTERISTIC
/begin CHARACTERISTIC FPfl_MIL_gndshort "FPrm_latch(130)" VALUE 0x001E0220 /* @ECU_Address@FPrm_latch@0x021BB208@ */ ECIPP_ALIGNMENT_FLOAT32_IEEE 10000000000 Compu_IDENTITY -10000000000 10000000000 PHYS_UNIT "samples" /end CHARACTERISTIC
/begin CHARACTERISTIC FPfl_MJ_comm_tout "FPrm_latch(94)" VALUE 0x001E0190 /* @ECU_Address@FPrm_latch@0x021BB178@ */ ECIPP_ALIGNMENT_FLOAT32_IEEE 10000000000 Compu_IDENTITY -10000000000 10000000000 PHYS_UNIT "ms" /end CHARACTERISTIC
/begin CHARACTERISTIC FPfl_MJ_intF_act "FPrm_latch(97)" VALUE 0x001E019C /* @ECU_Address@FPrm_latch@0x021BB184@ */ ECIPP_ALIGNMENT_FLOAT32_IEEE 10000000000 Compu_IDENTITY -10000000000 10000000000 PHYS_UNIT "ms" /end CHARACTERISTIC
/begin CHARACTERISTIC FPfl_MJ_intF_az "FPrm_latch(209)" VALUE 0x001E035C /* @ECU_Address@FPrm_latch@0x021BB344@ */ ECIPP_ALIGNMENT_FLOAT32_IEEE 10000000000 Compu_IDENTITY -10000000000 10000000000 PHYS_UNIT "ms" /end CHARACTERISTIC
/begin CHARACTERISTIC FPfu_J1939_TSC1_chksum "FPrm_unlatch(622)" VALUE 0x001E1518 /* @ECU_Address@FPrm_unlatch@0x021BD9B8@ */ ECIPP_ALIGNMENT_FLOAT32_IEEE 10000000000 Compu_IDENTITY -10000000000 10000000000 PHYS_UNIT "ms" /end CHARACTERISTIC
/begin CHARACTERISTIC FPfu_J1939_TSC1_cntr "FPrm_unlatch(621)" VALUE 0x001E1514 /* @ECU_Address@FPrm_unlatch@0x021BD9B4@ */ ECIPP_ALIGNMENT_FLOAT32_IEEE 10000000000 Compu_IDENTITY -10000000000 10000000000 PHYS_UNIT "ms" /end CHARACTERISTIC
/begin CHARACTERISTIC FPfu_J1939_TSC1_loss "FPrm_unlatch(173)" VALUE 0x001E0E14 /* @ECU_Address@FPrm_unlatch@0x021BD2B4@ */ ECIPP_ALIGNMENT_FLOAT32_IEEE 10000000000 Compu_IDENTITY -10000000000 10000000000 PHYS_UNIT "ms" /end CHARACTERISTIC
/begin CHARACTERISTIC FPfu_J1939_Tx2Fail "FPrm_unlatch(219)" VALUE 0x001E0ECC /* @ECU_Address@FPrm_unlatch@0x021BD36C@ */ ECIPP_ALIGNMENT_FLOAT32_IEEE 10000000000 Compu_IDENTITY -10000000000 10000000000 PHYS_UNIT "ms" /end CHARACTERISTIC
/begin CHARACTERISTIC FPfu_J1939_Tx3Fail "FPrm_unlatch(220)" VALUE 0x001E0ED0 /* @ECU_Address@FPrm_unlatch@0x021BD370@ */ ECIPP_ALIGNMENT_FLOAT32_IEEE 10000000000 Compu_IDENTITY -10000000000 10000000000 PHYS_UNIT "ms" /end CHARACTERISTIC
/begin CHARACTERISTIC FPfu_J1939_TxFail "FPrm_unlatch(114)" VALUE 0x001E0D28 /* @ECU_Address@FPrm_unlatch@0x021BD1C8@ */ ECIPP_ALIGNMENT_FLOAT32_IEEE 10000000000 Compu_IDENTITY -10000000000 10000000000 PHYS_UNIT "ms" /end CHARACTERISTIC
/begin CHARACTERISTIC FPfu_KNK_max "FPrm_unlatch(13)" VALUE 0x001E0B94 /* @ECU_Address@FPrm_unlatch@0x021BD034@ */ ECIPP_ALIGNMENT_FLOAT32_IEEE 10000000000 Compu_IDENTITY -10000000000 10000000000 PHYS_UNIT "updates" /end CHARACTERISTIC
/begin CHARACTERISTIC FPfu_KNK_min "FPrm_unlatch(12)" VALUE 0x001E0B90 /* @ECU_Address@FPrm_unlatch@0x021BD030@ */ ECIPP_ALIGNMENT_FLOAT32_IEEE 10000000000 Compu_IDENTITY -10000000000 10000000000 PHYS_UNIT "updates" /end CHARACTERISTIC
/begin CHARACTERISTIC FPfu_KNK_retardlmt "FPrm_unlatch(383)" VALUE 0x001E115C /* @ECU_Address@FPrm_unlatch@0x021BD5FC@ */ ECIPP_ALIGNMENT_FLOAT32_IEEE 10000000000 Compu_IDENTITY -10000000000 10000000000 PHYS_UNIT "updates" /end CHARACTERISTIC
/begin CHARACTERISTIC FPfu_KNK_retardlmt2 "FPrm_unlatch(528)" VALUE 0x001E13A0 /* @ECU_Address@FPrm_unlatch@0x021BD840@ */ ECIPP_ALIGNMENT_FLOAT32_IEEE 10000000000 Compu_IDENTITY -10000000000 10000000000 PHYS_UNIT "updates" /end CHARACTERISTIC
/begin CHARACTERISTIC FPfu_KV1_deltaHi "FPrm_unlatch(708)" VALUE 0x001E1670 /* @ECU_Address@FPrm_unlatch@0x021BDB10@ */ ECIPP_ALIGNMENT_FLOAT32_IEEE 10000000000 Compu_IDENTITY -10000000000 10000000000 PHYS_UNIT "ms" /end CHARACTERISTIC
/begin CHARACTERISTIC FPfu_KV1_deltaLo "FPrm_unlatch(709)" VALUE 0x001E1674 /* @ECU_Address@FPrm_unlatch@0x021BDB14@ */ ECIPP_ALIGNMENT_FLOAT32_IEEE 10000000000 Compu_IDENTITY -10000000000 10000000000 PHYS_UNIT "ms" /end CHARACTERISTIC
/begin CHARACTERISTIC FPfu_KV1_high "FPrm_unlatch(701)" VALUE 0x001E1654 /* @ECU_Address@FPrm_unlatch@0x021BDAF4@ */ ECIPP_ALIGNMENT_FLOAT32_IEEE 10000000000 Compu_IDENTITY -10000000000 10000000000 PHYS_UNIT "ms" /end CHARACTERISTIC
/begin CHARACTERISTIC FPfu_KV1_low "FPrm_unlatch(702)" VALUE 0x001E1658 /* @ECU_Address@FPrm_unlatch@0x021BDAF8@ */ ECIPP_ALIGNMENT_FLOAT32_IEEE 10000000000 Compu_IDENTITY -10000000000 10000000000 PHYS_UNIT "ms" /end CHARACTERISTIC
/begin CHARACTERISTIC FPfu_LOD_flk "FPrm_unlatch(566)" VALUE 0x001E1438 /* @ECU_Address@FPrm_unlatch@0x021BD8D8@ */ ECIPP_ALIGNMENT_FLOAT32_IEEE 10000000000 Compu_IDENTITY -10000000000 10000000000 PHYS_UNIT "samples" /end CHARACTERISTIC
/begin CHARACTERISTIC FPfu_LOD_FROmax "FPrm_unlatch(174)" VALUE 0x001E0E18 /* @ECU_Address@FPrm_unlatch@0x021BD2B8@ */ ECIPP_ALIGNMENT_FLOAT32_IEEE 10000000000 Compu_IDENTITY -10000000000 10000000000 PHYS_UNIT "ms" /end CHARACTERISTIC
/begin CHARACTERISTIC FPfu_LOD_slk "FPrm_unlatch(565)" VALUE 0x001E1434 /* @ECU_Address@FPrm_unlatch@0x021BD8D4@ */ ECIPP_ALIGNMENT_FLOAT32_IEEE 10000000000 Compu_IDENTITY -10000000000 10000000000 PHYS_UNIT "samples" /end CHARACTERISTIC
/begin CHARACTERISTIC FPfu_low_fuel_mon "FPrm_unlatch(711)" VALUE 0x001E167C /* @ECU_Address@FPrm_unlatch@0x021BDB1C@ */ ECIPP_ALIGNMENT_FLOAT32_IEEE 10000000000 Compu_IDENTITY -10000000000 10000000000 PHYS_UNIT "ms" /end CHARACTERISTIC
/begin CHARACTERISTIC FPfu_LowCLTemp "FPrm_unlatch(480)" VALUE 0x001E12E0 /* @ECU_Address@FPrm_unlatch@0x021BD780@ */ ECIPP_ALIGNMENT_FLOAT32_IEEE 10000000000 Compu_IDENTITY -10000000000 10000000000 PHYS_UNIT "ms" /end CHARACTERISTIC
/begin CHARACTERISTIC FPfu_LowDiagTemp "FPrm_unlatch(481)" VALUE 0x001E12E4 /* @ECU_Address@FPrm_unlatch@0x021BD784@ */ ECIPP_ALIGNMENT_FLOAT32_IEEE 10000000000 Compu_IDENTITY -10000000000 10000000000 PHYS_UNIT "ms" /end CHARACTERISTIC
/begin CHARACTERISTIC FPfu_LowOperTemp "FPrm_unlatch(316)" VALUE 0x001E1050 /* @ECU_Address@FPrm_unlatch@0x021BD4F0@ */ ECIPP_ALIGNMENT_FLOAT32_IEEE 10000000000 Compu_IDENTITY -10000000000 10000000000 PHYS_UNIT "ms" /end CHARACTERISTIC
/begin CHARACTERISTIC FPfu_MAP_HiExp "FPrm_unlatch(389)" VALUE 0x001E1174 /* @ECU_Address@FPrm_unlatch@0x021BD614@ */ ECIPP_ALIGNMENT_FLOAT32_IEEE 10000000000 Compu_IDENTITY -10000000000 10000000000 PHYS_UNIT "ms" /end CHARACTERISTIC
/begin CHARACTERISTIC FPfu_MAP_max "FPrm_unlatch(0)" VALUE 0x001E0B60 /* @ECU_Address@FPrm_unlatch@0x021BD000@ */ ECIPP_ALIGNMENT_FLOAT32_IEEE 10000000000 Compu_IDENTITY -10000000000 10000000000 PHYS_UNIT "ms" /end CHARACTERISTIC
/begin CHARACTERISTIC FPfu_MAP_minv "FPrm_unlatch(1)" VALUE 0x001E0B64 /* @ECU_Address@FPrm_unlatch@0x021BD004@ */ ECIPP_ALIGNMENT_FLOAT32_IEEE 10000000000 Compu_IDENTITY -10000000000 10000000000 PHYS_UNIT "ms" /end CHARACTERISTIC
/begin CHARACTERISTIC FPfu_MFA_ctout "FPrm_unlatch(589)" VALUE 0x001E1494 /* @ECU_Address@FPrm_unlatch@0x021BD934@ */ ECIPP_ALIGNMENT_FLOAT32_IEEE 10000000000 Compu_IDENTITY -10000000000 10000000000 PHYS_UNIT "ms" /end CHARACTERISTIC
/begin CHARACTERISTIC FPfu_MFA_hi_flow "FPrm_unlatch(684)" VALUE 0x001E1610 /* @ECU_Address@FPrm_unlatch@0x021BDAB0@ */ ECIPP_ALIGNMENT_FLOAT32_IEEE 10000000000 Compu_IDENTITY -10000000000 10000000000 PHYS_UNIT "ms" /end CHARACTERISTIC
/begin CHARACTERISTIC FPfu_MFA_hsd_comm "FPrm_unlatch(592)" VALUE 0x001E14A0 /* @ECU_Address@FPrm_unlatch@0x021BD940@ */ ECIPP_ALIGNMENT_FLOAT32_IEEE 10000000000 Compu_IDENTITY -10000000000 10000000000 PHYS_UNIT "ms" /end CHARACTERISTIC
/begin CHARACTERISTIC FPfu_MFA_intF_circ "FPrm_unlatch(590)" VALUE 0x001E1498 /* @ECU_Address@FPrm_unlatch@0x021BD938@ */ ECIPP_ALIGNMENT_FLOAT32_IEEE 10000000000 Compu_IDENTITY -10000000000 10000000000 PHYS_UNIT "ms" /end CHARACTERISTIC
/begin CHARACTERISTIC FPfu_MFA_intF_DP_V_max "FPrm_unlatch(618)" VALUE 0x001E1508 /* @ECU_Address@FPrm_unlatch@0x021BD9A8@ */ ECIPP_ALIGNMENT_FLOAT32_IEEE 10000000000 Compu_IDENTITY -10000000000 10000000000 PHYS_UNIT "ms" /end CHARACTERISTIC
/begin CHARACTERISTIC FPfu_MFA_intF_DP_V_min "FPrm_unlatch(619)" VALUE 0x001E150C /* @ECU_Address@FPrm_unlatch@0x021BD9AC@ */ ECIPP_ALIGNMENT_FLOAT32_IEEE 10000000000 Compu_IDENTITY -10000000000 10000000000 PHYS_UNIT "ms" /end CHARACTERISTIC
/begin CHARACTERISTIC FPfu_MFA_intF_DSPress_V_max "FPrm_unlatch(616)" VALUE 0x001E1500 /* @ECU_Address@FPrm_unlatch@0x021BD9A0@ */ ECIPP_ALIGNMENT_FLOAT32_IEEE 10000000000 Compu_IDENTITY -10000000000 10000000000 PHYS_UNIT "ms" /end CHARACTERISTIC
/begin CHARACTERISTIC FPfu_MFA_intF_DSPress_V_min "FPrm_unlatch(617)" VALUE 0x001E1504 /* @ECU_Address@FPrm_unlatch@0x021BD9A4@ */ ECIPP_ALIGNMENT_FLOAT32_IEEE 10000000000 Compu_IDENTITY -10000000000 10000000000 PHYS_UNIT "ms" /end CHARACTERISTIC
/begin CHARACTERISTIC FPfu_MFA_intF_FTemp_V_max "FPrm_unlatch(612)" VALUE 0x001E14F0 /* @ECU_Address@FPrm_unlatch@0x021BD990@ */ ECIPP_ALIGNMENT_FLOAT32_IEEE 10000000000 Compu_IDENTITY -10000000000 10000000000 PHYS_UNIT "ms" /end CHARACTERISTIC
/begin CHARACTERISTIC FPfu_MFA_intF_FTemp_V_min "FPrm_unlatch(613)" VALUE 0x001E14F4 /* @ECU_Address@FPrm_unlatch@0x021BD994@ */ ECIPP_ALIGNMENT_FLOAT32_IEEE 10000000000 Compu_IDENTITY -10000000000 10000000000 PHYS_UNIT "ms" /end CHARACTERISTIC
/begin CHARACTERISTIC FPfu_MFA_intF_general "FPrm_unlatch(620)" VALUE 0x001E1510 /* @ECU_Address@FPrm_unlatch@0x021BD9B0@ */ ECIPP_ALIGNMENT_FLOAT32_IEEE 10000000000 Compu_IDENTITY -10000000000 10000000000 PHYS_UNIT "ms" /end CHARACTERISTIC
/begin CHARACTERISTIC FPfu_MFA_intF_Tposerr_n "FPrm_unlatch(609)" VALUE 0x001E14E4 /* @ECU_Address@FPrm_unlatch@0x021BD984@ */ ECIPP_ALIGNMENT_FLOAT32_IEEE 10000000000 Compu_IDENTITY -10000000000 10000000000 PHYS_UNIT "ms" /end CHARACTERISTIC
/begin CHARACTERISTIC FPfu_MFA_intF_Tposerr_p "FPrm_unlatch(608)" VALUE 0x001E14E0 /* @ECU_Address@FPrm_unlatch@0x021BD980@ */ ECIPP_ALIGNMENT_FLOAT32_IEEE 10000000000 Compu_IDENTITY -10000000000 10000000000 PHYS_UNIT "ms" /end CHARACTERISTIC
/begin CHARACTERISTIC FPfu_MFA_intF_USPress_V_max "FPrm_unlatch(614)" VALUE 0x001E14F8 /* @ECU_Address@FPrm_unlatch@0x021BD998@ */ ECIPP_ALIGNMENT_FLOAT32_IEEE 10000000000 Compu_IDENTITY -10000000000 10000000000 PHYS_UNIT "ms" /end CHARACTERISTIC
/begin CHARACTERISTIC FPfu_MFA_intF_USPress_V_min "FPrm_unlatch(615)" VALUE 0x001E14FC /* @ECU_Address@FPrm_unlatch@0x021BD99C@ */ ECIPP_ALIGNMENT_FLOAT32_IEEE 10000000000 Compu_IDENTITY -10000000000 10000000000 PHYS_UNIT "ms" /end CHARACTERISTIC
/begin CHARACTERISTIC FPfu_MFA_intF_Vbat_max "FPrm_unlatch(610)" VALUE 0x001E14E8 /* @ECU_Address@FPrm_unlatch@0x021BD988@ */ ECIPP_ALIGNMENT_FLOAT32_IEEE 10000000000 Compu_IDENTITY -10000000000 10000000000 PHYS_UNIT "ms" /end CHARACTERISTIC
/begin CHARACTERISTIC FPfu_MFA_intF_Vbat_min "FPrm_unlatch(611)" VALUE 0x001E14EC /* @ECU_Address@FPrm_unlatch@0x021BD98C@ */ ECIPP_ALIGNMENT_FLOAT32_IEEE 10000000000 Compu_IDENTITY -10000000000 10000000000 PHYS_UNIT "ms" /end CHARACTERISTIC
/begin CHARACTERISTIC FPfu_MFA_lo_flow "FPrm_unlatch(683)" VALUE 0x001E160C /* @ECU_Address@FPrm_unlatch@0x021BDAAC@ */ ECIPP_ALIGNMENT_FLOAT32_IEEE 10000000000 Compu_IDENTITY -10000000000 10000000000 PHYS_UNIT "ms" /end CHARACTERISTIC
/begin CHARACTERISTIC FPfu_MFG_ctout "FPrm_unlatch(587)" VALUE 0x001E148C /* @ECU_Address@FPrm_unlatch@0x021BD92C@ */ ECIPP_ALIGNMENT_FLOAT32_IEEE 10000000000 Compu_IDENTITY -10000000000 10000000000 PHYS_UNIT "ms" /end CHARACTERISTIC
/begin CHARACTERISTIC FPfu_MFG_hi_flow "FPrm_unlatch(686)" VALUE 0x001E1618 /* @ECU_Address@FPrm_unlatch@0x021BDAB8@ */ ECIPP_ALIGNMENT_FLOAT32_IEEE 10000000000 Compu_IDENTITY -10000000000 10000000000 PHYS_UNIT "ms" /end CHARACTERISTIC
/begin CHARACTERISTIC FPfu_MFG_hsd_comm "FPrm_unlatch(591)" VALUE 0x001E149C /* @ECU_Address@FPrm_unlatch@0x021BD93C@ */ ECIPP_ALIGNMENT_FLOAT32_IEEE 10000000000 Compu_IDENTITY -10000000000 10000000000 PHYS_UNIT "ms" /end CHARACTERISTIC
/begin CHARACTERISTIC FPfu_MFG_intF_circ "FPrm_unlatch(588)" VALUE 0x001E1490 /* @ECU_Address@FPrm_unlatch@0x021BD930@ */ ECIPP_ALIGNMENT_FLOAT32_IEEE 10000000000 Compu_IDENTITY -10000000000 10000000000 PHYS_UNIT "ms" /end CHARACTERISTIC
/begin CHARACTERISTIC FPfu_MFG_intF_DP_V_max "FPrm_unlatch(605)" VALUE 0x001E14D4 /* @ECU_Address@FPrm_unlatch@0x021BD974@ */ ECIPP_ALIGNMENT_FLOAT32_IEEE 10000000000 Compu_IDENTITY -10000000000 10000000000 PHYS_UNIT "ms" /end CHARACTERISTIC
/begin CHARACTERISTIC FPfu_MFG_intF_DP_V_min "FPrm_unlatch(606)" VALUE 0x001E14D8 /* @ECU_Address@FPrm_unlatch@0x021BD978@ */ ECIPP_ALIGNMENT_FLOAT32_IEEE 10000000000 Compu_IDENTITY -10000000000 10000000000 PHYS_UNIT "ms" /end CHARACTERISTIC
/begin CHARACTERISTIC FPfu_MFG_intF_DPzVolt_V_max "FPrm_unlatch(603)" VALUE 0x001E14CC /* @ECU_Address@FPrm_unlatch@0x021BD96C@ */ ECIPP_ALIGNMENT_FLOAT32_IEEE 10000000000 Compu_IDENTITY -10000000000 10000000000 PHYS_UNIT "ms" /end CHARACTERISTIC
/begin CHARACTERISTIC FPfu_MFG_intF_DPzVolt_V_min "FPrm_unlatch(604)" VALUE 0x001E14D0 /* @ECU_Address@FPrm_unlatch@0x021BD970@ */ ECIPP_ALIGNMENT_FLOAT32_IEEE 10000000000 Compu_IDENTITY -10000000000 10000000000 PHYS_UNIT "ms" /end CHARACTERISTIC
/begin CHARACTERISTIC FPfu_MFG_intF_DSPress_V_max "FPrm_unlatch(601)" VALUE 0x001E14C4 /* @ECU_Address@FPrm_unlatch@0x021BD964@ */ ECIPP_ALIGNMENT_FLOAT32_IEEE 10000000000 Compu_IDENTITY -10000000000 10000000000 PHYS_UNIT "ms" /end CHARACTERISTIC
/begin CHARACTERISTIC FPfu_MFG_intF_DSPress_V_min "FPrm_unlatch(602)" VALUE 0x001E14C8 /* @ECU_Address@FPrm_unlatch@0x021BD968@ */ ECIPP_ALIGNMENT_FLOAT32_IEEE 10000000000 Compu_IDENTITY -10000000000 10000000000 PHYS_UNIT "ms" /end CHARACTERISTIC
/begin CHARACTERISTIC FPfu_MFG_intF_FTemp_V_max "FPrm_unlatch(597)" VALUE 0x001E14B4 /* @ECU_Address@FPrm_unlatch@0x021BD954@ */ ECIPP_ALIGNMENT_FLOAT32_IEEE 10000000000 Compu_IDENTITY -10000000000 10000000000 PHYS_UNIT "ms" /end CHARACTERISTIC
/begin CHARACTERISTIC FPfu_MFG_intF_FTemp_V_min "FPrm_unlatch(598)" VALUE 0x001E14B8 /* @ECU_Address@FPrm_unlatch@0x021BD958@ */ ECIPP_ALIGNMENT_FLOAT32_IEEE 10000000000 Compu_IDENTITY -10000000000 10000000000 PHYS_UNIT "ms" /end CHARACTERISTIC
/begin CHARACTERISTIC FPfu_MFG_intF_general "FPrm_unlatch(607)" VALUE 0x001E14DC /* @ECU_Address@FPrm_unlatch@0x021BD97C@ */ ECIPP_ALIGNMENT_FLOAT32_IEEE 10000000000 Compu_IDENTITY -10000000000 10000000000 PHYS_UNIT "ms" /end CHARACTERISTIC
/begin CHARACTERISTIC FPfu_MFG_intF_Tposerr_n "FPrm_unlatch(594)" VALUE 0x001E14A8 /* @ECU_Address@FPrm_unlatch@0x021BD948@ */ ECIPP_ALIGNMENT_FLOAT32_IEEE 10000000000 Compu_IDENTITY -10000000000 10000000000 PHYS_UNIT "ms" /end CHARACTERISTIC
/begin CHARACTERISTIC FPfu_MFG_intF_Tposerr_p "FPrm_unlatch(593)" VALUE 0x001E14A4 /* @ECU_Address@FPrm_unlatch@0x021BD944@ */ ECIPP_ALIGNMENT_FLOAT32_IEEE 10000000000 Compu_IDENTITY -10000000000 10000000000 PHYS_UNIT "ms" /end CHARACTERISTIC
/begin CHARACTERISTIC FPfu_MFG_intF_USPress_V_max "FPrm_unlatch(599)" VALUE 0x001E14BC /* @ECU_Address@FPrm_unlatch@0x021BD95C@ */ ECIPP_ALIGNMENT_FLOAT32_IEEE 10000000000 Compu_IDENTITY -10000000000 10000000000 PHYS_UNIT "ms" /end CHARACTERISTIC
/begin CHARACTERISTIC FPfu_MFG_intF_USPress_V_min "FPrm_unlatch(600)" VALUE 0x001E14C0 /* @ECU_Address@FPrm_unlatch@0x021BD960@ */ ECIPP_ALIGNMENT_FLOAT32_IEEE 10000000000 Compu_IDENTITY -10000000000 10000000000 PHYS_UNIT "ms" /end CHARACTERISTIC
/begin CHARACTERISTIC FPfu_MFG_intF_Vbat_max "FPrm_unlatch(595)" VALUE 0x001E14AC /* @ECU_Address@FPrm_unlatch@0x021BD94C@ */ ECIPP_ALIGNMENT_FLOAT32_IEEE 10000000000 Compu_IDENTITY -10000000000 10000000000 PHYS_UNIT "ms" /end CHARACTERISTIC
/begin CHARACTERISTIC FPfu_MFG_intF_Vbat_min "FPrm_unlatch(596)" VALUE 0x001E14B0 /* @ECU_Address@FPrm_unlatch@0x021BD950@ */ ECIPP_ALIGNMENT_FLOAT32_IEEE 10000000000 Compu_IDENTITY -10000000000 10000000000 PHYS_UNIT "ms" /end CHARACTERISTIC
/begin CHARACTERISTIC FPfu_MFG_lo_flow "FPrm_unlatch(685)" VALUE 0x001E1614 /* @ECU_Address@FPrm_unlatch@0x021BDAB4@ */ ECIPP_ALIGNMENT_FLOAT32_IEEE 10000000000 Compu_IDENTITY -10000000000 10000000000 PHYS_UNIT "ms" /end CHARACTERISTIC
/begin CHARACTERISTIC FPfu_MFG_RLV_fail "FPrm_unlatch(630)" VALUE 0x001E1538 /* @ECU_Address@FPrm_unlatch@0x021BD9D8@ */ ECIPP_ALIGNMENT_FLOAT32_IEEE 10000000000 Compu_IDENTITY -10000000000 10000000000 PHYS_UNIT "ms" /end CHARACTERISTIC
/begin CHARACTERISTIC FPfu_MIL_coilopen "FPrm_unlatch(131)" VALUE 0x001E0D6C /* @ECU_Address@FPrm_unlatch@0x021BD20C@ */ ECIPP_ALIGNMENT_FLOAT32_IEEE 10000000000 Compu_IDENTITY -10000000000 10000000000 PHYS_UNIT "samples" /end CHARACTERISTIC
/begin CHARACTERISTIC FPfu_MIL_coilshort "FPrm_unlatch(132)" VALUE 0x001E0D70 /* @ECU_Address@FPrm_unlatch@0x021BD210@ */ ECIPP_ALIGNMENT_FLOAT32_IEEE 10000000000 Compu_IDENTITY -10000000000 10000000000 PHYS_UNIT "samples" /end CHARACTERISTIC
/begin CHARACTERISTIC FPfu_MIL_gndshort "FPrm_unlatch(130)" VALUE 0x001E0D68 /* @ECU_Address@FPrm_unlatch@0x021BD208@ */ ECIPP_ALIGNMENT_FLOAT32_IEEE 10000000000 Compu_IDENTITY -10000000000 10000000000 PHYS_UNIT "samples" /end CHARACTERISTIC
/begin CHARACTERISTIC FPfu_MJ_comm_tout "FPrm_unlatch(94)" VALUE 0x001E0CD8 /* @ECU_Address@FPrm_unlatch@0x021BD178@ */ ECIPP_ALIGNMENT_FLOAT32_IEEE 10000000000 Compu_IDENTITY -10000000000 10000000000 PHYS_UNIT "ms" /end CHARACTERISTIC
/begin CHARACTERISTIC FPfu_MJ_intF_act "FPrm_unlatch(97)" VALUE 0x001E0CE4 /* @ECU_Address@FPrm_unlatch@0x021BD184@ */ ECIPP_ALIGNMENT_FLOAT32_IEEE 10000000000 Compu_IDENTITY -10000000000 10000000000 PHYS_UNIT "ms" /end CHARACTERISTIC
/begin CHARACTERISTIC FPfu_MJ_intF_az "FPrm_unlatch(209)" VALUE 0x001E0EA4 /* @ECU_Address@FPrm_unlatch@0x021BD344@ */ ECIPP_ALIGNMENT_FLOAT32_IEEE 10000000000 Compu_IDENTITY -10000000000 10000000000 PHYS_UNIT "ms" /end CHARACTERISTIC
/begin GROUP J1939_TSC1_chksum_EC_Fault "J1939 TSC1 message checksum"
 /begin REF_CHARACTERISTIC FCdc4_J1939_TSC1_chksum FCdtc_J1939_TSC1_chksum FCfmi_J1939_TSC1_chksum FCftb_J1939_TSC1_chksum FCspn_J1939_TSC1_chksum FPfl_J1939_TSC1_chksum FPfu_J1939_TSC1_chksum FPnd_J1939_TSC1_chksum FPsvr_J1939_TSC1_chksum FPsw_ext1_J1939_TSC1_chksum FPsw_J1939_TSC1_chksum /end REF_CHARACTERISTIC
/end GROUP
/begin GROUP J1939_TSC1_cntr_EC_Fault "J1939 TSC1 message counter"
 /begin REF_CHARACTERISTIC FCdc4_J1939_TSC1_cntr FCdtc_J1939_TSC1_cntr FCfmi_J1939_TSC1_cntr FCftb_J1939_TSC1_cntr FCspn_J1939_TSC1_cntr FPfl_J1939_TSC1_cntr FPfu_J1939_TSC1_cntr FPnd_J1939_TSC1_cntr FPsvr_J1939_TSC1_cntr FPsw_ext1_J1939_TSC1_cntr FPsw_J1939_TSC1_cntr /end REF_CHARACTERISTIC
/end GROUP
/begin GROUP J1939_TSC1_loss_EC_Fault "J1939 TSC1 message receipt lost"
 /begin REF_CHARACTERISTIC FCdc4_J1939_TSC1_loss FCdtc_J1939_TSC1_loss FCfmi_J1939_TSC1_loss FCftb_J1939_TSC1_loss FCspn_J1939_TSC1_loss FPfl_J1939_TSC1_loss FPfu_J1939_TSC1_loss FPnd_J1939_TSC1_loss FPsvr_J1939_TSC1_loss FPsw_ext1_J1939_TSC1_loss FPsw_J1939_TSC1_loss /end REF_CHARACTERISTIC
/end GROUP
/begin GROUP J1939_Tx2Fail_EC_Fault "CAN2 Tx failure"
 /begin REF_CHARACTERISTIC FCdc4_J1939_Tx2Fail FCdtc_J1939_Tx2Fail FCfmi_J1939_Tx2Fail FCftb_J1939_Tx2Fail FCspn_J1939_Tx2Fail FPfl_J1939_Tx2Fail FPfu_J1939_Tx2Fail FPnd_J1939_Tx2Fail FPsvr_J1939_Tx2Fail FPsw_ext1_J1939_Tx2Fail FPsw_J1939_Tx2Fail /end REF_CHARACTERISTIC
/end GROUP
/begin GROUP J1939_Tx3Fail_EC_Fault "CAN3 Tx failure"
 /begin REF_CHARACTERISTIC FCdc4_J1939_Tx3Fail FCdtc_J1939_Tx3Fail FCfmi_J1939_Tx3Fail FCftb_J1939_Tx3Fail FCspn_J1939_Tx3Fail FPfl_J1939_Tx3Fail FPfu_J1939_Tx3Fail FPnd_J1939_Tx3Fail FPsvr_J1939_Tx3Fail FPsw_ext1_J1939_Tx3Fail FPsw_J1939_Tx3Fail /end REF_CHARACTERISTIC
/end GROUP
/begin GROUP J1939_TxFail_EC_Fault "CAN1 Tx failure"
 /begin REF_CHARACTERISTIC FCdc4_J1939_TxFail FCdtc_J1939_TxFail FCfmi_J1939_TxFail FCftb_J1939_TxFail FCspn_J1939_TxFail FPfl_J1939_TxFail FPfu_J1939_TxFail FPnd_J1939_TxFail FPsvr_J1939_TxFail FPsw_ext1_J1939_TxFail FPsw_J1939_TxFail /end REF_CHARACTERISTIC
/end GROUP
/begin GROUP KNK_max_EC_Fault "Knock excessive signal"
 /begin REF_CHARACTERISTIC FCdc4_KNK_max FCdtc_KNK_max FCfmi_KNK_max FCftb_KNK_max FCspn_KNK_max FPfl_KNK_max FPfu_KNK_max FPnd_KNK_max FPsvr_KNK_max FPsw_ext1_KNK_max FPsw_KNK_max /end REF_CHARACTERISTIC
/end GROUP
/begin GROUP KNK_min_EC_Fault "Knock sensor open"
 /begin REF_CHARACTERISTIC FCdc4_KNK_min FCdtc_KNK_min FCfmi_KNK_min FCftb_KNK_min FCspn_KNK_min FPfl_KNK_min FPfu_KNK_min FPnd_KNK_min FPsvr_KNK_min FPsw_ext1_KNK_min FPsw_KNK_min /end REF_CHARACTERISTIC
/end GROUP
/begin GROUP KNK_retardlmt_EC_Fault "Knock retard at limit"
 /begin REF_CHARACTERISTIC FCdc4_KNK_retardlmt FCdtc_KNK_retardlmt FCfmi_KNK_retardlmt FCftb_KNK_retardlmt FCspn_KNK_retardlmt FPfl_KNK_retardlmt FPfu_KNK_retardlmt FPnd_KNK_retardlmt FPsvr_KNK_retardlmt FPsw_ext1_KNK_retardlmt FPsw_KNK_retardlmt /end REF_CHARACTERISTIC
/end GROUP
/begin GROUP KNK_retardlmt2_EC_Fault "Knock retard above threshold"
 /begin REF_CHARACTERISTIC FCdc4_KNK_retardlmt2 FCdtc_KNK_retardlmt2 FCfmi_KNK_retardlmt2 FCftb_KNK_retardlmt2 FCspn_KNK_retardlmt2 FPfl_KNK_retardlmt2 FPfu_KNK_retardlmt2 FPnd_KNK_retardlmt2 FPsvr_KNK_retardlmt2 FPsw_ext1_KNK_retardlmt2 FPsw_KNK_retardlmt2 /end REF_CHARACTERISTIC
/end GROUP
/begin GROUP KV1_deltaHi_EC_Fault "Spark 1 Above Average"
 /begin REF_CHARACTERISTIC FCdc4_KV1_deltaHi FCdtc_KV1_deltaHi FCfmi_KV1_deltaHi FCftb_KV1_deltaHi FCspn_KV1_deltaHi FPfl_KV1_deltaHi FPfu_KV1_deltaHi FPnd_KV1_deltaHi FPsvr_KV1_deltaHi FPsw_ext1_KV1_deltaHi FPsw_KV1_deltaHi /end REF_CHARACTERISTIC
/end GROUP
/begin GROUP KV1_deltaLo_EC_Fault "Spark 1 Below Average"
 /begin REF_CHARACTERISTIC FCdc4_KV1_deltaLo FCdtc_KV1_deltaLo FCfmi_KV1_deltaLo FCftb_KV1_deltaLo FCspn_KV1_deltaLo FPfl_KV1_deltaLo FPfu_KV1_deltaLo FPnd_KV1_deltaLo FPsvr_KV1_deltaLo FPsw_ext1_KV1_deltaLo FPsw_KV1_deltaLo /end REF_CHARACTERISTIC
/end GROUP
/begin GROUP KV1_high_EC_Fault "Spark 1 KV High"
 /begin REF_CHARACTERISTIC FCdc4_KV1_high FCdtc_KV1_high FCfmi_KV1_high FCftb_KV1_high FCspn_KV1_high FPfl_KV1_high FPfu_KV1_high FPnd_KV1_high FPsvr_KV1_high FPsw_ext1_KV1_high FPsw_KV1_high /end REF_CHARACTERISTIC
/end GROUP
/begin GROUP KV1_low_EC_Fault "Spark 1 KV Low"
 /begin REF_CHARACTERISTIC FCdc4_KV1_low FCdtc_KV1_low FCfmi_KV1_low FCftb_KV1_low FCspn_KV1_low FPfl_KV1_low FPfu_KV1_low FPnd_KV1_low FPsvr_KV1_low FPsw_ext1_KV1_low FPsw_KV1_low /end REF_CHARACTERISTIC
/end GROUP
/begin GROUP LOD_flk_EC_Fault "Fuel leak (regulator to mixer)"
 /begin REF_CHARACTERISTIC FCdc4_LOD_flk FCdtc_LOD_flk FCfmi_LOD_flk FCftb_LOD_flk FCspn_LOD_flk FPfl_LOD_flk FPfu_LOD_flk FPnd_LOD_flk FPsvr_LOD_flk FPsw_ext1_LOD_flk FPsw_LOD_flk /end REF_CHARACTERISTIC
/end GROUP
/begin GROUP LOD_FROmax_EC_Fault "Fuel run-out longer than expected"
 /begin REF_CHARACTERISTIC FCdc4_LOD_FROmax FCdtc_LOD_FROmax FCfmi_LOD_FROmax FCftb_LOD_FROmax FCspn_LOD_FROmax FPfl_LOD_FROmax FPfu_LOD_FROmax FPnd_LOD_FROmax FPsvr_LOD_FROmax FPsw_ext1_LOD_FROmax FPsw_LOD_FROmax /end REF_CHARACTERISTIC
/end GROUP
/begin GROUP LOD_slk_EC_Fault "Lockoff slow leak"
 /begin REF_CHARACTERISTIC FCdc4_LOD_slk FCdtc_LOD_slk FCfmi_LOD_slk FCftb_LOD_slk FCspn_LOD_slk FPfl_LOD_slk FPfu_LOD_slk FPnd_LOD_slk FPsvr_LOD_slk FPsw_ext1_LOD_slk FPsw_LOD_slk /end REF_CHARACTERISTIC
/end GROUP
/begin GROUP low_fuel_mon_EC_Fault "Fuel is low"
 /begin REF_CHARACTERISTIC FCdc4_low_fuel_mon FCdtc_low_fuel_mon FCfmi_low_fuel_mon FCftb_low_fuel_mon FCspn_low_fuel_mon FPfl_low_fuel_mon FPfu_low_fuel_mon FPnd_low_fuel_mon FPsvr_low_fuel_mon FPsw_ext1_low_fuel_mon FPsw_low_fuel_mon /end REF_CHARACTERISTIC
/end GROUP
/begin GROUP LowCLTemp_EC_Fault "Failed to reach closed loop temperature"
 /begin REF_CHARACTERISTIC FCdc4_LowCLTemp FCdtc_LowCLTemp FCfmi_LowCLTemp FCftb_LowCLTemp FCspn_LowCLTemp FPfl_LowCLTemp FPfu_LowCLTemp FPnd_LowCLTemp FPsvr_LowCLTemp FPsw_ext1_LowCLTemp FPsw_LowCLTemp /end REF_CHARACTERISTIC
/end GROUP
/begin GROUP LowDiagTemp_EC_Fault "Failed to reach diagnostics temperature"
 /begin REF_CHARACTERISTIC FCdc4_LowDiagTemp FCdtc_LowDiagTemp FCfmi_LowDiagTemp FCftb_LowDiagTemp FCspn_LowDiagTemp FPfl_LowDiagTemp FPfu_LowDiagTemp FPnd_LowDiagTemp FPsvr_LowDiagTemp FPsw_ext1_LowDiagTemp FPsw_LowDiagTemp /end REF_CHARACTERISTIC
/end GROUP
/begin GROUP LowOperTemp_EC_Fault "Failed to reach operating temperature"
 /begin REF_CHARACTERISTIC FCdc4_LowOperTemp FCdtc_LowOperTemp FCfmi_LowOperTemp FCftb_LowOperTemp FCspn_LowOperTemp FPfl_LowOperTemp FPfu_LowOperTemp FPnd_LowOperTemp FPsvr_LowOperTemp FPsw_ext1_LowOperTemp FPsw_LowOperTemp /end REF_CHARACTERISTIC
/end GROUP
/begin GROUP MAP_HiExp_EC_Fault "MAP higher than expected"
 /begin REF_CHARACTERISTIC FCdc4_MAP_HiExp FCdtc_MAP_HiExp FCfmi_MAP_HiExp FCftb_MAP_HiExp FCspn_MAP_HiExp FPfl_MAP_HiExp FPfu_MAP_HiExp FPnd_MAP_HiExp FPsvr_MAP_HiExp FPsw_ext1_MAP_HiExp FPsw_MAP_HiExp /end REF_CHARACTERISTIC
/end GROUP
/begin GROUP MAP_max_EC_Fault "MAP high pressure"
 /begin REF_CHARACTERISTIC FCdc4_MAP_max FCdtc_MAP_max FCfmi_MAP_max FCftb_MAP_max FCspn_MAP_max FPfl_MAP_max FPfu_MAP_max FPnd_MAP_max FPsvr_MAP_max FPsw_ext1_MAP_max FPsw_MAP_max /end REF_CHARACTERISTIC
/end GROUP
/begin GROUP MAP_minv_EC_Fault "MAP low voltage"
 /begin REF_CHARACTERISTIC FCdc4_MAP_minv FCdtc_MAP_minv FCfmi_MAP_minv FCftb_MAP_minv FCspn_MAP_minv FPfl_MAP_minv FPfu_MAP_minv FPnd_MAP_minv FPsvr_MAP_minv FPsw_ext1_MAP_minv FPsw_MAP_minv /end REF_CHARACTERISTIC
/end GROUP
/begin GROUP MFA_ctout_EC_Fault "MFA / AT main comm lost"
 /begin REF_CHARACTERISTIC FCdc4_MFA_ctout FCdtc_MFA_ctout FCfmi_MFA_ctout FCftb_MFA_ctout FCspn_MFA_ctout FPfl_MFA_ctout FPfu_MFA_ctout FPnd_MFA_ctout FPsvr_MFA_ctout FPsw_ext1_MFA_ctout FPsw_MFA_ctout /end REF_CHARACTERISTIC
/end GROUP
/begin GROUP MFA_hi_flow_EC_Fault "MFA flow higher than expected"
 /begin REF_CHARACTERISTIC FCdc4_MFA_hi_flow FCdtc_MFA_hi_flow FCfmi_MFA_hi_flow FCftb_MFA_hi_flow FCspn_MFA_hi_flow FPfl_MFA_hi_flow FPfu_MFA_hi_flow FPnd_MFA_hi_flow FPsvr_MFA_hi_flow FPsw_ext1_MFA_hi_flow FPsw_MFA_hi_flow /end REF_CHARACTERISTIC
/end GROUP
/begin GROUP MFA_hsd_comm_EC_Fault "MFA / AT high speed data comm lost"
 /begin REF_CHARACTERISTIC FCdc4_MFA_hsd_comm FCdtc_MFA_hsd_comm FCfmi_MFA_hsd_comm FCftb_MFA_hsd_comm FCspn_MFA_hsd_comm FPfl_MFA_hsd_comm FPfu_MFA_hsd_comm FPnd_MFA_hsd_comm FPsvr_MFA_hsd_comm FPsw_ext1_MFA_hsd_comm FPsw_MFA_hsd_comm /end REF_CHARACTERISTIC
/end GROUP
/begin GROUP MFA_intF_circ_EC_Fault "MFA / AT internal circuitry fault detection"
 /begin REF_CHARACTERISTIC FCdc4_MFA_intF_circ FCdtc_MFA_intF_circ FCfmi_MFA_intF_circ FCftb_MFA_intF_circ FCspn_MFA_intF_circ FPfl_MFA_intF_circ FPfu_MFA_intF_circ FPnd_MFA_intF_circ FPsvr_MFA_intF_circ FPsw_ext1_MFA_intF_circ FPsw_MFA_intF_circ /end REF_CHARACTERISTIC
/end GROUP
/begin GROUP MFA_intF_DP_V_max_EC_Fault "MFA delta pressure voltage high"
 /begin REF_CHARACTERISTIC FCdc4_MFA_intF_DP_V_max FCdtc_MFA_intF_DP_V_max FCfmi_MFA_intF_DP_V_max FCftb_MFA_intF_DP_V_max FCspn_MFA_intF_DP_V_max FPfl_MFA_intF_DP_V_max FPfu_MFA_intF_DP_V_max FPnd_MFA_intF_DP_V_max FPsvr_MFA_intF_DP_V_max FPsw_ext1_MFA_intF_DP_V_max FPsw_MFA_intF_DP_V_max /end REF_CHARACTERISTIC
/end GROUP
/begin GROUP MFA_intF_DP_V_min_EC_Fault "MFA delta pressure voltage low"
 /begin REF_CHARACTERISTIC FCdc4_MFA_intF_DP_V_min FCdtc_MFA_intF_DP_V_min FCfmi_MFA_intF_DP_V_min FCftb_MFA_intF_DP_V_min FCspn_MFA_intF_DP_V_min FPfl_MFA_intF_DP_V_min FPfu_MFA_intF_DP_V_min FPnd_MFA_intF_DP_V_min FPsvr_MFA_intF_DP_V_min FPsw_ext1_MFA_intF_DP_V_min FPsw_MFA_intF_DP_V_min /end REF_CHARACTERISTIC
/end GROUP
/begin GROUP MFA_intF_DSPress_V_max_EC_Fault "MFA downstream pressure voltage high"
 /begin REF_CHARACTERISTIC FCdc4_MFA_intF_DSPress_V_max FCdtc_MFA_intF_DSPress_V_max FCfmi_MFA_intF_DSPress_V_max FCftb_MFA_intF_DSPress_V_max FCspn_MFA_intF_DSPress_V_max FPfl_MFA_intF_DSPress_V_max FPfu_MFA_intF_DSPress_V_max FPnd_MFA_intF_DSPress_V_max FPsvr_MFA_intF_DSPress_V_max FPsw_ext1_MFA_intF_DSPress_V_max FPsw_MFA_intF_DSPress_V_max /end REF_CHARACTERISTIC
/end GROUP
/begin GROUP MFA_intF_DSPress_V_min_EC_Fault "MFA downstream pressure voltage low"
 /begin REF_CHARACTERISTIC FCdc4_MFA_intF_DSPress_V_min FCdtc_MFA_intF_DSPress_V_min FCfmi_MFA_intF_DSPress_V_min FCftb_MFA_intF_DSPress_V_min FCspn_MFA_intF_DSPress_V_min FPfl_MFA_intF_DSPress_V_min FPfu_MFA_intF_DSPress_V_min FPnd_MFA_intF_DSPress_V_min FPsvr_MFA_intF_DSPress_V_min FPsw_ext1_MFA_intF_DSPress_V_min FPsw_MFA_intF_DSPress_V_min /end REF_CHARACTERISTIC
/end GROUP
/begin GROUP MFA_intF_FTemp_V_max_EC_Fault "MFA fluid temperature voltage high"
 /begin REF_CHARACTERISTIC FCdc4_MFA_intF_FTemp_V_max FCdtc_MFA_intF_FTemp_V_max FCfmi_MFA_intF_FTemp_V_max FCftb_MFA_intF_FTemp_V_max FCspn_MFA_intF_FTemp_V_max FPfl_MFA_intF_FTemp_V_max FPfu_MFA_intF_FTemp_V_max FPnd_MFA_intF_FTemp_V_max FPsvr_MFA_intF_FTemp_V_max FPsw_ext1_MFA_intF_FTemp_V_max FPsw_MFA_intF_FTemp_V_max /end REF_CHARACTERISTIC
/end GROUP
/begin GROUP MFA_intF_FTemp_V_min_EC_Fault "MFA fluid temperature voltage low"
 /begin REF_CHARACTERISTIC FCdc4_MFA_intF_FTemp_V_min FCdtc_MFA_intF_FTemp_V_min FCfmi_MFA_intF_FTemp_V_min FCftb_MFA_intF_FTemp_V_min FCspn_MFA_intF_FTemp_V_min FPfl_MFA_intF_FTemp_V_min FPfu_MFA_intF_FTemp_V_min FPnd_MFA_intF_FTemp_V_min FPsvr_MFA_intF_FTemp_V_min FPsw_ext1_MFA_intF_FTemp_V_min FPsw_MFA_intF_FTemp_V_min /end REF_CHARACTERISTIC
/end GROUP
/begin GROUP MFA_intF_general_EC_Fault "MFA / AT general fault"
 /begin REF_CHARACTERISTIC FCdc4_MFA_intF_general FCdtc_MFA_intF_general FCfmi_MFA_intF_general FCftb_MFA_intF_general FCspn_MFA_intF_general FPfl_MFA_intF_general FPfu_MFA_intF_general FPnd_MFA_intF_general FPsvr_MFA_intF_general FPsw_ext1_MFA_intF_general FPsw_MFA_intF_general /end REF_CHARACTERISTIC
/end GROUP
/begin GROUP MFA_intF_Tposerr_n_EC_Fault "MFA / AT unable to reach lower TPS"
 /begin REF_CHARACTERISTIC FCdc4_MFA_intF_Tposerr_n FCdtc_MFA_intF_Tposerr_n FCfmi_MFA_intF_Tposerr_n FCftb_MFA_intF_Tposerr_n FCspn_MFA_intF_Tposerr_n FPfl_MFA_intF_Tposerr_n FPfu_MFA_intF_Tposerr_n FPnd_MFA_intF_Tposerr_n FPsvr_MFA_intF_Tposerr_n FPsw_ext1_MFA_intF_Tposerr_n FPsw_MFA_intF_Tposerr_n /end REF_CHARACTERISTIC
/end GROUP
/begin GROUP MFA_intF_Tposerr_p_EC_Fault "MFA / AT unable to reach higher TPS"
 /begin REF_CHARACTERISTIC FCdc4_MFA_intF_Tposerr_p FCdtc_MFA_intF_Tposerr_p FCfmi_MFA_intF_Tposerr_p FCftb_MFA_intF_Tposerr_p FCspn_MFA_intF_Tposerr_p FPfl_MFA_intF_Tposerr_p FPfu_MFA_intF_Tposerr_p FPnd_MFA_intF_Tposerr_p FPsvr_MFA_intF_Tposerr_p FPsw_ext1_MFA_intF_Tposerr_p FPsw_MFA_intF_Tposerr_p /end REF_CHARACTERISTIC
/end GROUP
/begin GROUP MFA_intF_USPress_V_max_EC_Fault "MFA upstream pressure voltage high"
 /begin REF_CHARACTERISTIC FCdc4_MFA_intF_USPress_V_max FCdtc_MFA_intF_USPress_V_max FCfmi_MFA_intF_USPress_V_max FCftb_MFA_intF_USPress_V_max FCspn_MFA_intF_USPress_V_max FPfl_MFA_intF_USPress_V_max FPfu_MFA_intF_USPress_V_max FPnd_MFA_intF_USPress_V_max FPsvr_MFA_intF_USPress_V_max FPsw_ext1_MFA_intF_USPress_V_max FPsw_MFA_intF_USPress_V_max /end REF_CHARACTERISTIC
/end GROUP
/begin GROUP MFA_intF_USPress_V_min_EC_Fault "MFA upstream pressure voltage low"
 /begin REF_CHARACTERISTIC FCdc4_MFA_intF_USPress_V_min FCdtc_MFA_intF_USPress_V_min FCfmi_MFA_intF_USPress_V_min FCftb_MFA_intF_USPress_V_min FCspn_MFA_intF_USPress_V_min FPfl_MFA_intF_USPress_V_min FPfu_MFA_intF_USPress_V_min FPnd_MFA_intF_USPress_V_min FPsvr_MFA_intF_USPress_V_min FPsw_ext1_MFA_intF_USPress_V_min FPsw_MFA_intF_USPress_V_min /end REF_CHARACTERISTIC
/end GROUP
/begin GROUP MFA_intF_Vbat_max_EC_Fault "MFA / AT supply voltage high"
 /begin REF_CHARACTERISTIC FCdc4_MFA_intF_Vbat_max FCdtc_MFA_intF_Vbat_max FCfmi_MFA_intF_Vbat_max FCftb_MFA_intF_Vbat_max FCspn_MFA_intF_Vbat_max FPfl_MFA_intF_Vbat_max FPfu_MFA_intF_Vbat_max FPnd_MFA_intF_Vbat_max FPsvr_MFA_intF_Vbat_max FPsw_ext1_MFA_intF_Vbat_max FPsw_MFA_intF_Vbat_max /end REF_CHARACTERISTIC
/end GROUP
/begin GROUP MFA_intF_Vbat_min_EC_Fault "MFA / AT supply voltage low"
 /begin REF_CHARACTERISTIC FCdc4_MFA_intF_Vbat_min FCdtc_MFA_intF_Vbat_min FCfmi_MFA_intF_Vbat_min FCftb_MFA_intF_Vbat_min FCspn_MFA_intF_Vbat_min FPfl_MFA_intF_Vbat_min FPfu_MFA_intF_Vbat_min FPnd_MFA_intF_Vbat_min FPsvr_MFA_intF_Vbat_min FPsw_ext1_MFA_intF_Vbat_min FPsw_MFA_intF_Vbat_min /end REF_CHARACTERISTIC
/end GROUP
/begin GROUP MFA_lo_flow_EC_Fault "MFA flow lower than expected"
 /begin REF_CHARACTERISTIC FCdc4_MFA_lo_flow FCdtc_MFA_lo_flow FCfmi_MFA_lo_flow FCftb_MFA_lo_flow FCspn_MFA_lo_flow FPfl_MFA_lo_flow FPfu_MFA_lo_flow FPnd_MFA_lo_flow FPsvr_MFA_lo_flow FPsw_ext1_MFA_lo_flow FPsw_MFA_lo_flow /end REF_CHARACTERISTIC
/end GROUP
/begin GROUP MFG_ctout_EC_Fault "MFG main comm lost"
 /begin REF_CHARACTERISTIC FCdc4_MFG_ctout FCdtc_MFG_ctout FCfmi_MFG_ctout FCftb_MFG_ctout FCspn_MFG_ctout FPfl_MFG_ctout FPfu_MFG_ctout FPnd_MFG_ctout FPsvr_MFG_ctout FPsw_ext1_MFG_ctout FPsw_MFG_ctout /end REF_CHARACTERISTIC
/end GROUP
/begin GROUP MFG_hi_flow_EC_Fault "MFG flow higher than expected"
 /begin REF_CHARACTERISTIC FCdc4_MFG_hi_flow FCdtc_MFG_hi_flow FCfmi_MFG_hi_flow FCftb_MFG_hi_flow FCspn_MFG_hi_flow FPfl_MFG_hi_flow FPfu_MFG_hi_flow FPnd_MFG_hi_flow FPsvr_MFG_hi_flow FPsw_ext1_MFG_hi_flow FPsw_MFG_hi_flow /end REF_CHARACTERISTIC
/end GROUP
/begin GROUP MFG_hsd_comm_EC_Fault "MFG high speed data comm lost"
 /begin REF_CHARACTERISTIC FCdc4_MFG_hsd_comm FCdtc_MFG_hsd_comm FCfmi_MFG_hsd_comm FCftb_MFG_hsd_comm FCspn_MFG_hsd_comm FPfl_MFG_hsd_comm FPfu_MFG_hsd_comm FPnd_MFG_hsd_comm FPsvr_MFG_hsd_comm FPsw_ext1_MFG_hsd_comm FPsw_MFG_hsd_comm /end REF_CHARACTERISTIC
/end GROUP
/begin GROUP MFG_intF_circ_EC_Fault "MFG internal circuitry fault detection"
 /begin REF_CHARACTERISTIC FCdc4_MFG_intF_circ FCdtc_MFG_intF_circ FCfmi_MFG_intF_circ FCftb_MFG_intF_circ FCspn_MFG_intF_circ FPfl_MFG_intF_circ FPfu_MFG_intF_circ FPnd_MFG_intF_circ FPsvr_MFG_intF_circ FPsw_ext1_MFG_intF_circ FPsw_MFG_intF_circ /end REF_CHARACTERISTIC
/end GROUP
/begin GROUP MFG_intF_DP_V_max_EC_Fault "MFG delta pressure voltage high"
 /begin REF_CHARACTERISTIC FCdc4_MFG_intF_DP_V_max FCdtc_MFG_intF_DP_V_max FCfmi_MFG_intF_DP_V_max FCftb_MFG_intF_DP_V_max FCspn_MFG_intF_DP_V_max FPfl_MFG_intF_DP_V_max FPfu_MFG_intF_DP_V_max FPnd_MFG_intF_DP_V_max FPsvr_MFG_intF_DP_V_max FPsw_ext1_MFG_intF_DP_V_max FPsw_MFG_intF_DP_V_max /end REF_CHARACTERISTIC
/end GROUP
/begin GROUP MFG_intF_DP_V_min_EC_Fault "MFG delta pressure voltage low"
 /begin REF_CHARACTERISTIC FCdc4_MFG_intF_DP_V_min FCdtc_MFG_intF_DP_V_min FCfmi_MFG_intF_DP_V_min FCftb_MFG_intF_DP_V_min FCspn_MFG_intF_DP_V_min FPfl_MFG_intF_DP_V_min FPfu_MFG_intF_DP_V_min FPnd_MFG_intF_DP_V_min FPsvr_MFG_intF_DP_V_min FPsw_ext1_MFG_intF_DP_V_min FPsw_MFG_intF_DP_V_min /end REF_CHARACTERISTIC
/end GROUP
/begin GROUP MFG_intF_DPzVolt_V_max_EC_Fault "MFG delta pressure zVolt voltage high"
 /begin REF_CHARACTERISTIC FCdc4_MFG_intF_DPzVolt_V_max FCdtc_MFG_intF_DPzVolt_V_max FCfmi_MFG_intF_DPzVolt_V_max FCftb_MFG_intF_DPzVolt_V_max FCspn_MFG_intF_DPzVolt_V_max FPfl_MFG_intF_DPzVolt_V_max FPfu_MFG_intF_DPzVolt_V_max FPnd_MFG_intF_DPzVolt_V_max FPsvr_MFG_intF_DPzVolt_V_max FPsw_ext1_MFG_intF_DPzVolt_V_max FPsw_MFG_intF_DPzVolt_V_max /end REF_CHARACTERISTIC
/end GROUP
/begin GROUP MFG_intF_DPzVolt_V_min_EC_Fault "MFG delta pressure zVolt voltage low"
 /begin REF_CHARACTERISTIC FCdc4_MFG_intF_DPzVolt_V_min FCdtc_MFG_intF_DPzVolt_V_min FCfmi_MFG_intF_DPzVolt_V_min FCftb_MFG_intF_DPzVolt_V_min FCspn_MFG_intF_DPzVolt_V_min FPfl_MFG_intF_DPzVolt_V_min FPfu_MFG_intF_DPzVolt_V_min FPnd_MFG_intF_DPzVolt_V_min FPsvr_MFG_intF_DPzVolt_V_min FPsw_ext1_MFG_intF_DPzVolt_V_min FPsw_MFG_intF_DPzVolt_V_min /end REF_CHARACTERISTIC
/end GROUP
/begin GROUP MFG_intF_DSPress_V_max_EC_Fault "MFG downstream pressure voltage high"
 /begin REF_CHARACTERISTIC FCdc4_MFG_intF_DSPress_V_max FCdtc_MFG_intF_DSPress_V_max FCfmi_MFG_intF_DSPress_V_max FCftb_MFG_intF_DSPress_V_max FCspn_MFG_intF_DSPress_V_max FPfl_MFG_intF_DSPress_V_max FPfu_MFG_intF_DSPress_V_max FPnd_MFG_intF_DSPress_V_max FPsvr_MFG_intF_DSPress_V_max FPsw_ext1_MFG_intF_DSPress_V_max FPsw_MFG_intF_DSPress_V_max /end REF_CHARACTERISTIC
/end GROUP
/begin GROUP MFG_intF_DSPress_V_min_EC_Fault "MFG downstream pressure voltage low"
 /begin REF_CHARACTERISTIC FCdc4_MFG_intF_DSPress_V_min FCdtc_MFG_intF_DSPress_V_min FCfmi_MFG_intF_DSPress_V_min FCftb_MFG_intF_DSPress_V_min FCspn_MFG_intF_DSPress_V_min FPfl_MFG_intF_DSPress_V_min FPfu_MFG_intF_DSPress_V_min FPnd_MFG_intF_DSPress_V_min FPsvr_MFG_intF_DSPress_V_min FPsw_ext1_MFG_intF_DSPress_V_min FPsw_MFG_intF_DSPress_V_min /end REF_CHARACTERISTIC
/end GROUP
/begin GROUP MFG_intF_FTemp_V_max_EC_Fault "MFG fluid temperature voltage high"
 /begin REF_CHARACTERISTIC FCdc4_MFG_intF_FTemp_V_max FCdtc_MFG_intF_FTemp_V_max FCfmi_MFG_intF_FTemp_V_max FCftb_MFG_intF_FTemp_V_max FCspn_MFG_intF_FTemp_V_max FPfl_MFG_intF_FTemp_V_max FPfu_MFG_intF_FTemp_V_max FPnd_MFG_intF_FTemp_V_max FPsvr_MFG_intF_FTemp_V_max FPsw_ext1_MFG_intF_FTemp_V_max FPsw_MFG_intF_FTemp_V_max /end REF_CHARACTERISTIC
/end GROUP
/begin GROUP MFG_intF_FTemp_V_min_EC_Fault "MFG fluid temperature voltage low"
 /begin REF_CHARACTERISTIC FCdc4_MFG_intF_FTemp_V_min FCdtc_MFG_intF_FTemp_V_min FCfmi_MFG_intF_FTemp_V_min FCftb_MFG_intF_FTemp_V_min FCspn_MFG_intF_FTemp_V_min FPfl_MFG_intF_FTemp_V_min FPfu_MFG_intF_FTemp_V_min FPnd_MFG_intF_FTemp_V_min FPsvr_MFG_intF_FTemp_V_min FPsw_ext1_MFG_intF_FTemp_V_min FPsw_MFG_intF_FTemp_V_min /end REF_CHARACTERISTIC
/end GROUP
/begin GROUP MFG_intF_general_EC_Fault "MFG general fault"
 /begin REF_CHARACTERISTIC FCdc4_MFG_intF_general FCdtc_MFG_intF_general FCfmi_MFG_intF_general FCftb_MFG_intF_general FCspn_MFG_intF_general FPfl_MFG_intF_general FPfu_MFG_intF_general FPnd_MFG_intF_general FPsvr_MFG_intF_general FPsw_ext1_MFG_intF_general FPsw_MFG_intF_general /end REF_CHARACTERISTIC
/end GROUP
/begin GROUP MFG_intF_Tposerr_n_EC_Fault "MFG unable to reach lower TPS"
 /begin REF_CHARACTERISTIC FCdc4_MFG_intF_Tposerr_n FCdtc_MFG_intF_Tposerr_n FCfmi_MFG_intF_Tposerr_n FCftb_MFG_intF_Tposerr_n FCspn_MFG_intF_Tposerr_n FPfl_MFG_intF_Tposerr_n FPfu_MFG_intF_Tposerr_n FPnd_MFG_intF_Tposerr_n FPsvr_MFG_intF_Tposerr_n FPsw_ext1_MFG_intF_Tposerr_n FPsw_MFG_intF_Tposerr_n /end REF_CHARACTERISTIC
/end GROUP
/begin GROUP MFG_intF_Tposerr_p_EC_Fault "MFG unable to reach higher TPS"
 /begin REF_CHARACTERISTIC FCdc4_MFG_intF_Tposerr_p FCdtc_MFG_intF_Tposerr_p FCfmi_MFG_intF_Tposerr_p FCftb_MFG_intF_Tposerr_p FCspn_MFG_intF_Tposerr_p FPfl_MFG_intF_Tposerr_p FPfu_MFG_intF_Tposerr_p FPnd_MFG_intF_Tposerr_p FPsvr_MFG_intF_Tposerr_p FPsw_ext1_MFG_intF_Tposerr_p FPsw_MFG_intF_Tposerr_p /end REF_CHARACTERISTIC
/end GROUP
/begin GROUP MFG_intF_USPress_V_max_EC_Fault "MFG upstream pressure voltage high"
 /begin REF_CHARACTERISTIC FCdc4_MFG_intF_USPress_V_max FCdtc_MFG_intF_USPress_V_max FCfmi_MFG_intF_USPress_V_max FCftb_MFG_intF_USPress_V_max FCspn_MFG_intF_USPress_V_max FPfl_MFG_intF_USPress_V_max FPfu_MFG_intF_USPress_V_max FPnd_MFG_intF_USPress_V_max FPsvr_MFG_intF_USPress_V_max FPsw_ext1_MFG_intF_USPress_V_max FPsw_MFG_intF_USPress_V_max /end REF_CHARACTERISTIC
/end GROUP
/begin GROUP MFG_intF_USPress_V_min_EC_Fault "MFG upstream pressure voltage low"
 /begin REF_CHARACTERISTIC FCdc4_MFG_intF_USPress_V_min FCdtc_MFG_intF_USPress_V_min FCfmi_MFG_intF_USPress_V_min FCftb_MFG_intF_USPress_V_min FCspn_MFG_intF_USPress_V_min FPfl_MFG_intF_USPress_V_min FPfu_MFG_intF_USPress_V_min FPnd_MFG_intF_USPress_V_min FPsvr_MFG_intF_USPress_V_min FPsw_ext1_MFG_intF_USPress_V_min FPsw_MFG_intF_USPress_V_min /end REF_CHARACTERISTIC
/end GROUP
/begin GROUP MFG_intF_Vbat_max_EC_Fault "MFG supply voltage high"
 /begin REF_CHARACTERISTIC FCdc4_MFG_intF_Vbat_max FCdtc_MFG_intF_Vbat_max FCfmi_MFG_intF_Vbat_max FCftb_MFG_intF_Vbat_max FCspn_MFG_intF_Vbat_max FPfl_MFG_intF_Vbat_max FPfu_MFG_intF_Vbat_max FPnd_MFG_intF_Vbat_max FPsvr_MFG_intF_Vbat_max FPsw_ext1_MFG_intF_Vbat_max FPsw_MFG_intF_Vbat_max /end REF_CHARACTERISTIC
/end GROUP
/begin GROUP MFG_intF_Vbat_min_EC_Fault "MFG supply voltage low"
 /begin REF_CHARACTERISTIC FCdc4_MFG_intF_Vbat_min FCdtc_MFG_intF_Vbat_min FCfmi_MFG_intF_Vbat_min FCftb_MFG_intF_Vbat_min FCspn_MFG_intF_Vbat_min FPfl_MFG_intF_Vbat_min FPfu_MFG_intF_Vbat_min FPnd_MFG_intF_Vbat_min FPsvr_MFG_intF_Vbat_min FPsw_ext1_MFG_intF_Vbat_min FPsw_MFG_intF_Vbat_min /end REF_CHARACTERISTIC
/end GROUP
/begin GROUP MFG_lo_flow_EC_Fault "MFG flow lower than expected"
 /begin REF_CHARACTERISTIC FCdc4_MFG_lo_flow FCdtc_MFG_lo_flow FCfmi_MFG_lo_flow FCftb_MFG_lo_flow FCspn_MFG_lo_flow FPfl_MFG_lo_flow FPfu_MFG_lo_flow FPnd_MFG_lo_flow FPsvr_MFG_lo_flow FPsw_ext1_MFG_lo_flow FPsw_MFG_lo_flow /end REF_CHARACTERISTIC
/end GROUP
/begin GROUP MFG_RLV_fail_EC_Fault "MFG RLV test failed"
 /begin REF_CHARACTERISTIC FCdc4_MFG_RLV_fail FCdtc_MFG_RLV_fail FCfmi_MFG_RLV_fail FCftb_MFG_RLV_fail FCspn_MFG_RLV_fail FPfl_MFG_RLV_fail FPfu_MFG_RLV_fail FPnd_MFG_RLV_fail FPsvr_MFG_RLV_fail FPsw_ext1_MFG_RLV_fail FPsw_MFG_RLV_fail /end REF_CHARACTERISTIC
/end GROUP
/begin GROUP MIL_coilopen_EC_Fault "MIL open"
 /begin REF_CHARACTERISTIC FCdc4_MIL_coilopen FCdtc_MIL_coilopen FCfmi_MIL_coilopen FCftb_MIL_coilopen FCspn_MIL_coilopen FPfl_MIL_coilopen FPfu_MIL_coilopen FPnd_MIL_coilopen FPsvr_MIL_coilopen FPsw_ext1_MIL_coilopen FPsw_MIL_coilopen /end REF_CHARACTERISTIC
/end GROUP
/begin GROUP MIL_coilshort_EC_Fault "MIL control short to power"
 /begin REF_CHARACTERISTIC FCdc4_MIL_coilshort FCdtc_MIL_coilshort FCfmi_MIL_coilshort FCftb_MIL_coilshort FCspn_MIL_coilshort FPfl_MIL_coilshort FPfu_MIL_coilshort FPnd_MIL_coilshort FPsvr_MIL_coilshort FPsw_ext1_MIL_coilshort FPsw_MIL_coilshort /end REF_CHARACTERISTIC
/end GROUP
/begin GROUP MIL_gndshort_EC_Fault "MIL control ground short"
 /begin REF_CHARACTERISTIC FCdc4_MIL_gndshort FCdtc_MIL_gndshort FCfmi_MIL_gndshort FCftb_MIL_gndshort FCspn_MIL_gndshort FPfl_MIL_gndshort FPfu_MIL_gndshort FPnd_MIL_gndshort FPsvr_MIL_gndshort FPsw_ext1_MIL_gndshort FPsw_MIL_gndshort /end REF_CHARACTERISTIC
/end GROUP
/begin GROUP MJ_comm_tout_EC_Fault "EPR / CFV comm lost"
 /begin REF_CHARACTERISTIC FCdc4_MJ_comm_tout FCdtc_MJ_comm_tout FCfmi_MJ_comm_tout FCftb_MJ_comm_tout FCspn_MJ_comm_tout FPfl_MJ_comm_tout FPfu_MJ_comm_tout FPnd_MJ_comm_tout FPsvr_MJ_comm_tout FPsw_ext1_MJ_comm_tout FPsw_MJ_comm_tout /end REF_CHARACTERISTIC
/end GROUP
/begin GROUP MJ_intF_act_EC_Fault "EPR / CFV internal actuator fault detection"
 /begin REF_CHARACTERISTIC FCdc4_MJ_intF_act FCdtc_MJ_intF_act FCfmi_MJ_intF_act FCftb_MJ_intF_act FCspn_MJ_intF_act FPfl_MJ_intF_act FPfu_MJ_intF_act FPnd_MJ_intF_act FPsvr_MJ_intF_act FPsw_ext1_MJ_intF_act FPsw_MJ_intF_act /end REF_CHARACTERISTIC
/end GROUP
/begin GROUP MJ_intF_az_EC_Fault "EPR autozero / lockoff failed"
 /begin REF_CHARACTERISTIC FCdc4_MJ_intF_az FCdtc_MJ_intF_az FCfmi_MJ_intF_az FCftb_MJ_intF_az FCspn_MJ_intF_az FPfl_MJ_intF_az FPfu_MJ_intF_az FPnd_MJ_intF_az FPsvr_MJ_intF_az FPsw_ext1_MJ_intF_az FPsw_MJ_intF_az /end REF_CHARACTERISTIC
/end GROUP
/end MODULE
/end PROJECT
