ASAP2_VERSION 1 61
/begin PROJECT Econtrols_4G "4G Test"
/begin HEADER "4G A2L Configuration" PROJECT_NO EControls4G /* config for version control */ VERSION "$Revision: 82130 $:" /* config for version control */ /end HEADER
/begin MODULE EControls_4G_SH2A "EControls 4G"
/begin MOD_COMMON "" DEPOSIT ABSOLUTE BYTE_ORDER MSB_FIRST /end MOD_COMMON
/* Define the Record Layouts */
/begin RECORD_LAYOUT ECIPP_ALIGNMENT_UBYTE FNC_VALUES 1 UBYTE COLUMN_DIR DIRECT /end RECORD_LAYOUT
/begin RECORD_LAYOUT ECIPP_ALIGNMENT_UWORD FNC_VALUES 1 UWORD COLUMN_DIR DIRECT /end RECORD_LAYOUT
/begin RECORD_LAYOUT ECIPP_ALIGNMENT_ULONG FNC_VALUES 1 ULONG COLUMN_DIR DIRECT /end RECORD_LAYOUT
/* Define generic COMPU_METHODS used in the A2L */ /* NOTE: most of the parameters from ECIPP use unique/specific COMPU_METHODS */
/begin COMPU_METHOD Compu_ECIPP_STRINGS "ECIPP Strings " /* Identifier */ RAT_FUNC "%.0" /* Format */ "ASCII" /* Units */ COEFFS 0 1 0 0 0 1 /end COMPU_METHOD
/begin MEASUREMENT Vdot_exhaust "Exhaust volume flow rate" UWORD Compu_Vdot_exhaust 0 0 0 8191.875 ECU_ADDRESS 0x01001CA8 /end MEASUREMENT
/begin COMPU_METHOD Compu_Vdot_exhaust " " RAT_FUNC "%.1" "l / s" COEFFS 0 8 0 0 0 1 /end COMPU_METHOD
/begin MEASUREMENT EMP_slow "EMP" UWORD Compu_EMP_slow 0 0 0 255.99609375 ECU_ADDRESS 0x010092E0 /end MEASUREMENT
/begin COMPU_METHOD Compu_EMP_slow " " RAT_FUNC "%.2" "psia" COEFFS 0 256 0 0 0 1 /end COMPU_METHOD
/begin MEASUREMENT DPFdP "DPF delta-P" SWORD Compu_DPFdP 0 0 -32 31.9990234375 ECU_ADDRESS 0x010092F0 /end MEASUREMENT
/begin COMPU_METHOD Compu_DPFdP " " RAT_FUNC "%.3" "psig" COEFFS 0 1024 0 0 0 1 /end COMPU_METHOD
/begin MEASUREMENT TOT "Turbine Tout" UWORD Compu_TOT 0 0 -460 7731.875 ECU_ADDRESS 0x01009320 /end MEASUREMENT
/begin COMPU_METHOD Compu_TOT " " RAT_FUNC "%.1" "deg F" COEFFS 0 8 3680 0 0 1 /end COMPU_METHOD
/begin MEASUREMENT DOCT "DOCT" UWORD Compu_DOCT 0 0 -460 7731.875 ECU_ADDRESS 0x01009330 /end MEASUREMENT
/begin COMPU_METHOD Compu_DOCT " " RAT_FUNC "%.1" "deg F" COEFFS 0 8 3680 0 0 1 /end COMPU_METHOD
/begin MEASUREMENT DPFT "DPFT" UWORD Compu_DPFT 0 0 -460 7731.875 ECU_ADDRESS 0x01009338 /end MEASUREMENT
/begin COMPU_METHOD Compu_DPFT " " RAT_FUNC "%.1" "deg F" COEFFS 0 8 3680 0 0 1 /end COMPU_METHOD
/begin MEASUREMENT SCRT "SCRT" UWORD Compu_SCRT 0 0 -460 7731.875 ECU_ADDRESS 0x01009340 /end MEASUREMENT
/begin COMPU_METHOD Compu_SCRT " " RAT_FUNC "%.1" "deg F" COEFFS 0 8 3680 0 0 1 /end COMPU_METHOD
/begin CHARACTERISTIC DOCT_ena "DOCT source{DOCT_ena&0xff=0:Disabled}{DOCT_ena&0xff=1:Aux PU1}{DOCT_ena&0xff=2:Aux PU2}{DOCT_ena&0xff=3:Aux PU3}{DOCT_ena&0xff=4:Aux PUD1}{DOCT_ena&0xff=5:Aux PUD2}{DOCT_ena&0xff=6:Aux PUD3}{DOCT_ena&0xff=7:EGT Input}{DOCT_ena&0xff=8:Aux PUD4}{DOCT_ena&0x" VALUE 0x001f1a79 /* @ECU_Address@DOCT_ena@0x010093B8@ */ ECIPP_ALIGNMENT_UBYTE 255 DOCT_ena_COMPU_VTAB 0 255 BIT_MASK 0xff /end CHARACTERISTIC
/begin COMPU_METHOD DOCT_ena_COMPU_VTAB "Verbal Table" TAB_VERB "%.0" "list" COMPU_TAB_REF DOCT_ena_COMPU_VTAB_REF /end COMPU_METHOD
/begin COMPU_VTAB DOCT_ena_COMPU_VTAB_REF "Verbal Table" TAB_VERB 31 0 "Disabled" 1 "Aux PU1" 2 "Aux PU2" 3 "Aux PU3" 4 "Aux PUD1" 5 "Aux PUD2" 6 "Aux PUD3" 7 "EGT Input" 8 "Aux PUD4" 9 "Aux PUD5" 10 "Aux PUD6" 11 "Aux PUD7" 12 "Aux PUD8" 13 "Aux PUD9" 14 "Aux PUD10" 15 "Aux PUD11" 16 "Aux PUD12" 17 "Aux PUD13" 18 "Aux PUD14" 19 "Aux PUD15" 20 "Aux PUD16" 21 "Aux PUD17" 22 "Aux PUD18" 23 "Aux PUD19" 24 "Aux PUD20" 25 "Aux PUD21" 26 "Aux PUD22" 27 "Aux PUD23" 28 "Aux PUD24" 29 "Aux PUD25" 30 "CAN sourced" DEFAULT_VALUE "UNKNOWN" /end COMPU_VTAB
/begin CHARACTERISTIC DPFT_ena "DPFT source{DPFT_ena&0xff=0:Disabled}{DPFT_ena&0xff=1:Aux PU1}{DPFT_ena&0xff=2:Aux PU2}{DPFT_ena&0xff=3:Aux PU3}{DPFT_ena&0xff=4:Aux PUD1}{DPFT_ena&0xff=5:Aux PUD2}{DPFT_ena&0xff=6:Aux PUD3}{DPFT_ena&0xff=7:EGT Input}{DPFT_ena&0xff=8:Aux PUD4}{DPFT_ena&0x" VALUE 0x001f1a7b /* @ECU_Address@DPFT_ena@0x010093C0@ */ ECIPP_ALIGNMENT_UBYTE 255 DPFT_ena_COMPU_VTAB 0 255 BIT_MASK 0xff /end CHARACTERISTIC
/begin COMPU_METHOD DPFT_ena_COMPU_VTAB "Verbal Table" TAB_VERB "%.0" "list" COMPU_TAB_REF DPFT_ena_COMPU_VTAB_REF /end COMPU_METHOD
/begin COMPU_VTAB DPFT_ena_COMPU_VTAB_REF "Verbal Table" TAB_VERB 31 0 "Disabled" 1 "Aux PU1" 2 "Aux PU2" 3 "Aux PU3" 4 "Aux PUD1" 5 "Aux PUD2" 6 "Aux PUD3" 7 "EGT Input" 8 "Aux PUD4" 9 "Aux PUD5" 10 "Aux PUD6" 11 "Aux PUD7" 12 "Aux PUD8" 13 "Aux PUD9" 14 "Aux PUD10" 15 "Aux PUD11" 16 "Aux PUD12" 17 "Aux PUD13" 18 "Aux PUD14" 19 "Aux PUD15" 20 "Aux PUD16" 21 "Aux PUD17" 22 "Aux PUD18" 23 "Aux PUD19" 24 "Aux PUD20" 25 "Aux PUD21" 26 "Aux PUD22" 27 "Aux PUD23" 28 "Aux PUD24" 29 "Aux PUD25" 30 "CAN sourced" DEFAULT_VALUE "UNKNOWN" /end COMPU_VTAB
/begin CHARACTERISTIC SCRT_ena "SCRT source{SCRT_ena&0xff=0:Disabled}{SCRT_ena&0xff=1:Aux PU1}{SCRT_ena&0xff=2:Aux PU2}{SCRT_ena&0xff=3:Aux PU3}{SCRT_ena&0xff=4:Aux PUD1}{SCRT_ena&0xff=5:Aux PUD2}{SCRT_ena&0xff=6:Aux PUD3}{SCRT_ena&0xff=7:EGT Input}{SCRT_ena&0xff=8:Aux PUD4}{SCRT_ena&0x" VALUE 0x001f1a7f /* @ECU_Address@SCRT_ena@0x010093C8@ */ ECIPP_ALIGNMENT_UBYTE 255 SCRT_ena_COMPU_VTAB 0 255 BIT_MASK 0xff /end CHARACTERISTIC
/begin COMPU_METHOD SCRT_ena_COMPU_VTAB "Verbal Table" TAB_VERB "%.0" "list" COMPU_TAB_REF SCRT_ena_COMPU_VTAB_REF /end COMPU_METHOD
/begin COMPU_VTAB SCRT_ena_COMPU_VTAB_REF "Verbal Table" TAB_VERB 31 0 "Disabled" 1 "Aux PU1" 2 "Aux PU2" 3 "Aux PU3" 4 "Aux PUD1" 5 "Aux PUD2" 6 "Aux PUD3" 7 "EGT Input" 8 "Aux PUD4" 9 "Aux PUD5" 10 "Aux PUD6" 11 "Aux PUD7" 12 "Aux PUD8" 13 "Aux PUD9" 14 "Aux PUD10" 15 "Aux PUD11" 16 "Aux PUD12" 17 "Aux PUD13" 18 "Aux PUD14" 19 "Aux PUD15" 20 "Aux PUD16" 21 "Aux PUD17" 22 "Aux PUD18" 23 "Aux PUD19" 24 "Aux PUD20" 25 "Aux PUD21" 26 "Aux PUD22" 27 "Aux PUD23" 28 "Aux PUD24" 29 "Aux PUD25" 30 "CAN sourced" DEFAULT_VALUE "UNKNOWN" /end COMPU_VTAB
/begin CHARACTERISTIC DPFdP_ena "DPF delta-P sensor{DPFdP_ena&0xff=0:Disabled}{DPFdP_ena&0xff=1:Aux PD1}{DPFdP_ena&0xff=2:Aux PD2}{DPFdP_ena&0xff=3:Aux PD3}{DPFdP_ena&0xff=4:Aux PUD1}{DPFdP_ena&0xff=5:Aux PUD2}{DPFdP_ena&0xff=6:Aux PUD3}{DPFdP_ena&0xff=7:Aux PUD4}{DPFdP_ena&0xff=8:Aux PU" VALUE 0x001f1a7d /* @ECU_Address@DPFdP_ena@0x01009418@ */ ECIPP_ALIGNMENT_UBYTE 255 DPFdP_ena_COMPU_VTAB 0 255 BIT_MASK 0xff /end CHARACTERISTIC
/begin COMPU_METHOD DPFdP_ena_COMPU_VTAB "Verbal Table" TAB_VERB "%.0" "list" COMPU_TAB_REF DPFdP_ena_COMPU_VTAB_REF /end COMPU_METHOD
/begin COMPU_VTAB DPFdP_ena_COMPU_VTAB_REF "Verbal Table" TAB_VERB 31 0 "Disabled" 1 "Aux PD1" 2 "Aux PD2" 3 "Aux PD3" 4 "Aux PUD1" 5 "Aux PUD2" 6 "Aux PUD3" 7 "Aux PUD4" 8 "Aux PUD5" 9 "Aux PUD6" 10 "Aux PUD7" 11 "Aux PUD8" 12 "Aux PUD9" 13 "Aux PUD10" 14 "Aux PUD11" 15 "Aux PUD12" 16 "Aux PUD13" 17 "Aux PUD14" 18 "Aux PUD15" 19 "CAN sourced" 20 "FPP2 Input" 21 "Aux PUD16" 22 "Aux PUD17" 23 "Aux PUD18" 24 "Aux PUD19" 25 "Aux PUD20" 26 "Aux PUD21" 27 "Aux PUD22" 28 "Aux PUD23" 29 "Aux PUD24" 30 "Aux PUD25" DEFAULT_VALUE "UNKNOWN" /end COMPU_VTAB
/begin CHARACTERISTIC DPF_V_init "DPF initial volume" VALUE 0x001f1956 /* @ECU_Address@DPF_V_init@0x01009878@ */ ECIPP_ALIGNMENT_UWORD 32 Compu_DPF_V_init 0 31.99951171875 /end CHARACTERISTIC
/begin COMPU_METHOD Compu_DPF_V_init " " RAT_FUNC "%.2" "L" COEFFS 0 2048 0 0 0 1 /end COMPU_METHOD
/begin MEASUREMENT DPF_regen_active "DPF regen status{DPF_regen_active&0xff=0:Inactive}{DPF_regen_active&0xff=1:Active}" UBYTE DPF_regen_active_COMPU_VTAB 0 0 0 255 ECU_ADDRESS 0x01009880 BIT_MASK 0xff /end MEASUREMENT
/begin COMPU_METHOD DPF_regen_active_COMPU_VTAB "Verbal Table" TAB_VERB "%.0" "list" COMPU_TAB_REF DPF_regen_active_COMPU_VTAB_REF /end COMPU_METHOD
/begin COMPU_VTAB DPF_regen_active_COMPU_VTAB_REF "Verbal Table" TAB_VERB 2 0 "Inactive" 1 "Active" DEFAULT_VALUE "UNKNOWN" /end COMPU_VTAB
/begin MEASUREMENT DPF_soot_grams "DPF total soot accumulated" ULONG Compu_DPF_soot_grams 0 0 0 511.999999880791 ECU_ADDRESS 0x01009888 /end MEASUREMENT
/begin COMPU_METHOD Compu_DPF_soot_grams " " RAT_FUNC "%.1" "grams" COEFFS 0 8388608 0 0 0 1 /end COMPU_METHOD
/begin MEASUREMENT DPF_soot_g_per_L "DPF soot loading" UWORD Compu_DPF_soot_g_per_L 0 0 0 63.9990234375 ECU_ADDRESS 0x01009890 /end MEASUREMENT
/begin COMPU_METHOD Compu_DPF_soot_g_per_L " " RAT_FUNC "%.1" "g/L" COEFFS 0 1024 0 0 0 1 /end COMPU_METHOD
/begin MEASUREMENT DPF_soot_mg_sec "DPF soot loading rate" SWORD Compu_DPF_soot_mg_sec 0 0 -64 63.998046875 ECU_ADDRESS 0x01009898 /end MEASUREMENT
/begin COMPU_METHOD Compu_DPF_soot_mg_sec " " RAT_FUNC "%.2" "mg/sec" COEFFS 0 512 0 0 0 1 /end COMPU_METHOD
/begin MEASUREMENT mdot_ports_cmd "Port flow command" UWORD Compu_mdot_ports_cmd 0 0 0 1023.984375 ECU_ADDRESS 0x01009FB8 /end MEASUREMENT
/begin COMPU_METHOD Compu_mdot_ports_cmd " " RAT_FUNC "%.1" "g/sec" COEFFS 0 64 0 0 0 1 /end COMPU_METHOD
/begin CHARACTERISTIC CRI_Tmain_slct1 "Main injection timing{CRI_Tmain_slct1&0xff=0:Standard}{CRI_Tmain_slct1&0xff=1:Alternate 1}{CRI_Tmain_slct1&0xff=2:Alt 1 + Std}{CRI_Tmain_slct1&0xff=3:Alternate 2}{CRI_Tmain_slct1&0xff=4:Alt 2 + Std}" VALUE 0x001F19AF /* @ECU_Address@CRI_Tmain_slct1@0x0100A590@ */ ECIPP_ALIGNMENT_UBYTE 255 CRI_Tmain_slct1_COMPU_VTAB 0 255 BIT_MASK 0xff /end CHARACTERISTIC
/begin COMPU_METHOD CRI_Tmain_slct1_COMPU_VTAB "Verbal Table" TAB_VERB "%.0" "list" COMPU_TAB_REF CRI_Tmain_slct1_COMPU_VTAB_REF /end COMPU_METHOD
/begin COMPU_VTAB CRI_Tmain_slct1_COMPU_VTAB_REF "Verbal Table" TAB_VERB 5 0 "Standard" 1 "Alternate 1" 2 "Alt 1 + Std" 3 "Alternate 2" 4 "Alt 2 + Std" DEFAULT_VALUE "UNKNOWN" /end COMPU_VTAB
/begin CHARACTERISTIC CRI_Tmain_slct2 "Main injection timing{CRI_Tmain_slct2&0xff=0:Standard}{CRI_Tmain_slct2&0xff=1:Alternate 1}{CRI_Tmain_slct2&0xff=2:Alt 1 + Std}{CRI_Tmain_slct2&0xff=3:Alternate 2}{CRI_Tmain_slct2&0xff=4:Alt 2 + Std}" VALUE 0x001F19B0 /* @ECU_Address@CRI_Tmain_slct2@0x0100A598@ */ ECIPP_ALIGNMENT_UBYTE 255 CRI_Tmain_slct2_COMPU_VTAB 0 255 BIT_MASK 0xff /end CHARACTERISTIC
/begin COMPU_METHOD CRI_Tmain_slct2_COMPU_VTAB "Verbal Table" TAB_VERB "%.0" "list" COMPU_TAB_REF CRI_Tmain_slct2_COMPU_VTAB_REF /end COMPU_METHOD
/begin COMPU_VTAB CRI_Tmain_slct2_COMPU_VTAB_REF "Verbal Table" TAB_VERB 5 0 "Standard" 1 "Alternate 1" 2 "Alt 1 + Std" 3 "Alternate 2" 4 "Alt 2 + Std" DEFAULT_VALUE "UNKNOWN" /end COMPU_VTAB
/begin CHARACTERISTIC CRI_Tmain_slct3 "Main injection timing{CRI_Tmain_slct3&0xff=0:Standard}{CRI_Tmain_slct3&0xff=1:Alternate 1}{CRI_Tmain_slct3&0xff=2:Alt 1 + Std}{CRI_Tmain_slct3&0xff=3:Alternate 2}{CRI_Tmain_slct3&0xff=4:Alt 2 + Std}" VALUE 0x001F19B1 /* @ECU_Address@CRI_Tmain_slct3@0x0100A5A0@ */ ECIPP_ALIGNMENT_UBYTE 255 CRI_Tmain_slct3_COMPU_VTAB 0 255 BIT_MASK 0xff /end CHARACTERISTIC
/begin COMPU_METHOD CRI_Tmain_slct3_COMPU_VTAB "Verbal Table" TAB_VERB "%.0" "list" COMPU_TAB_REF CRI_Tmain_slct3_COMPU_VTAB_REF /end COMPU_METHOD
/begin COMPU_VTAB CRI_Tmain_slct3_COMPU_VTAB_REF "Verbal Table" TAB_VERB 5 0 "Standard" 1 "Alternate 1" 2 "Alt 1 + Std" 3 "Alternate 2" 4 "Alt 2 + Std" DEFAULT_VALUE "UNKNOWN" /end COMPU_VTAB
/begin CHARACTERISTIC CRI_Tmain_slct4 "Main injection timing{CRI_Tmain_slct4&0xff=0:Standard}{CRI_Tmain_slct4&0xff=1:Alternate 1}{CRI_Tmain_slct4&0xff=2:Alt 1 + Std}{CRI_Tmain_slct4&0xff=3:Alternate 2}{CRI_Tmain_slct4&0xff=4:Alt 2 + Std}" VALUE 0x001F19B2 /* @ECU_Address@CRI_Tmain_slct4@0x0100A5A8@ */ ECIPP_ALIGNMENT_UBYTE 255 CRI_Tmain_slct4_COMPU_VTAB 0 255 BIT_MASK 0xff /end CHARACTERISTIC
/begin COMPU_METHOD CRI_Tmain_slct4_COMPU_VTAB "Verbal Table" TAB_VERB "%.0" "list" COMPU_TAB_REF CRI_Tmain_slct4_COMPU_VTAB_REF /end COMPU_METHOD
/begin COMPU_VTAB CRI_Tmain_slct4_COMPU_VTAB_REF "Verbal Table" TAB_VERB 5 0 "Standard" 1 "Alternate 1" 2 "Alt 1 + Std" 3 "Alternate 2" 4 "Alt 2 + Std" DEFAULT_VALUE "UNKNOWN" /end COMPU_VTAB
/begin CHARACTERISTIC CRI_Tmain_slct5 "Main injection timing{CRI_Tmain_slct5&0xff=0:Standard}{CRI_Tmain_slct5&0xff=1:Alternate 1}{CRI_Tmain_slct5&0xff=2:Alt 1 + Std}{CRI_Tmain_slct5&0xff=3:Alternate 2}{CRI_Tmain_slct5&0xff=4:Alt 2 + Std}" VALUE 0x001F19B3 /* @ECU_Address@CRI_Tmain_slct5@0x0100A5B0@ */ ECIPP_ALIGNMENT_UBYTE 255 CRI_Tmain_slct5_COMPU_VTAB 0 255 BIT_MASK 0xff /end CHARACTERISTIC
/begin COMPU_METHOD CRI_Tmain_slct5_COMPU_VTAB "Verbal Table" TAB_VERB "%.0" "list" COMPU_TAB_REF CRI_Tmain_slct5_COMPU_VTAB_REF /end COMPU_METHOD
/begin COMPU_VTAB CRI_Tmain_slct5_COMPU_VTAB_REF "Verbal Table" TAB_VERB 5 0 "Standard" 1 "Alternate 1" 2 "Alt 1 + Std" 3 "Alternate 2" 4 "Alt 2 + Std" DEFAULT_VALUE "UNKNOWN" /end COMPU_VTAB
/begin CHARACTERISTIC CRI_Tmain_slct6 "Main injection timing{CRI_Tmain_slct6&0xff=0:Standard}{CRI_Tmain_slct6&0xff=1:Alternate 1}{CRI_Tmain_slct6&0xff=2:Alt 1 + Std}{CRI_Tmain_slct6&0xff=3:Alternate 2}{CRI_Tmain_slct6&0xff=4:Alt 2 + Std}" VALUE 0x001F19B4 /* @ECU_Address@CRI_Tmain_slct6@0x0100A5B8@ */ ECIPP_ALIGNMENT_UBYTE 255 CRI_Tmain_slct6_COMPU_VTAB 0 255 BIT_MASK 0xff /end CHARACTERISTIC
/begin COMPU_METHOD CRI_Tmain_slct6_COMPU_VTAB "Verbal Table" TAB_VERB "%.0" "list" COMPU_TAB_REF CRI_Tmain_slct6_COMPU_VTAB_REF /end COMPU_METHOD
/begin COMPU_VTAB CRI_Tmain_slct6_COMPU_VTAB_REF "Verbal Table" TAB_VERB 5 0 "Standard" 1 "Alternate 1" 2 "Alt 1 + Std" 3 "Alternate 2" 4 "Alt 2 + Std" DEFAULT_VALUE "UNKNOWN" /end COMPU_VTAB
/begin CHARACTERISTIC CRI_Tmain_slct7 "Main injection timing{CRI_Tmain_slct7&0xff=0:Standard}{CRI_Tmain_slct7&0xff=1:Alternate 1}{CRI_Tmain_slct7&0xff=2:Alt 1 + Std}{CRI_Tmain_slct7&0xff=3:Alternate 2}{CRI_Tmain_slct7&0xff=4:Alt 2 + Std}" VALUE 0x001F19B5 /* @ECU_Address@CRI_Tmain_slct7@0x0100A5C0@ */ ECIPP_ALIGNMENT_UBYTE 255 CRI_Tmain_slct7_COMPU_VTAB 0 255 BIT_MASK 0xff /end CHARACTERISTIC
/begin COMPU_METHOD CRI_Tmain_slct7_COMPU_VTAB "Verbal Table" TAB_VERB "%.0" "list" COMPU_TAB_REF CRI_Tmain_slct7_COMPU_VTAB_REF /end COMPU_METHOD
/begin COMPU_VTAB CRI_Tmain_slct7_COMPU_VTAB_REF "Verbal Table" TAB_VERB 5 0 "Standard" 1 "Alternate 1" 2 "Alt 1 + Std" 3 "Alternate 2" 4 "Alt 2 + Std" DEFAULT_VALUE "UNKNOWN" /end COMPU_VTAB
/begin CHARACTERISTIC CRI_Tpost1_slct0 "Post 1 injection timing{CRI_Tpost1_slct0&0xff=0:Standard}{CRI_Tpost1_slct0&0xff=1:Alternate 1}{CRI_Tpost1_slct0&0xff=2:Alt 1 + Std}" VALUE 0x001F19CE /* @ECU_Address@CRI_Tpost1_slct0@0x0100A5C8@ */ ECIPP_ALIGNMENT_UBYTE 255 CRI_Tpost1_slct0_COMPU_VTAB 0 255 BIT_MASK 0xff /end CHARACTERISTIC
/begin COMPU_METHOD CRI_Tpost1_slct0_COMPU_VTAB "Verbal Table" TAB_VERB "%.0" "list" COMPU_TAB_REF CRI_Tpost1_slct0_COMPU_VTAB_REF /end COMPU_METHOD
/begin COMPU_VTAB CRI_Tpost1_slct0_COMPU_VTAB_REF "Verbal Table" TAB_VERB 3 0 "Standard" 1 "Alternate 1" 2 "Alt 1 + Std" DEFAULT_VALUE "UNKNOWN" /end COMPU_VTAB
/begin CHARACTERISTIC CRI_Tpost1_slct1 "Post 1 injection timing{CRI_Tpost1_slct1&0xff=0:Standard}{CRI_Tpost1_slct1&0xff=1:Alternate 1}{CRI_Tpost1_slct1&0xff=2:Alt 1 + Std}" VALUE 0x001F19CF /* @ECU_Address@CRI_Tpost1_slct1@0x0100A5D0@ */ ECIPP_ALIGNMENT_UBYTE 255 CRI_Tpost1_slct1_COMPU_VTAB 0 255 BIT_MASK 0xff /end CHARACTERISTIC
/begin COMPU_METHOD CRI_Tpost1_slct1_COMPU_VTAB "Verbal Table" TAB_VERB "%.0" "list" COMPU_TAB_REF CRI_Tpost1_slct1_COMPU_VTAB_REF /end COMPU_METHOD
/begin COMPU_VTAB CRI_Tpost1_slct1_COMPU_VTAB_REF "Verbal Table" TAB_VERB 3 0 "Standard" 1 "Alternate 1" 2 "Alt 1 + Std" DEFAULT_VALUE "UNKNOWN" /end COMPU_VTAB
/begin CHARACTERISTIC CRI_Tpost1_slct2 "Post 1 injection timing{CRI_Tpost1_slct2&0xff=0:Standard}{CRI_Tpost1_slct2&0xff=1:Alternate 1}{CRI_Tpost1_slct2&0xff=2:Alt 1 + Std}" VALUE 0x001F19D0 /* @ECU_Address@CRI_Tpost1_slct2@0x0100A5D8@ */ ECIPP_ALIGNMENT_UBYTE 255 CRI_Tpost1_slct2_COMPU_VTAB 0 255 BIT_MASK 0xff /end CHARACTERISTIC
/begin COMPU_METHOD CRI_Tpost1_slct2_COMPU_VTAB "Verbal Table" TAB_VERB "%.0" "list" COMPU_TAB_REF CRI_Tpost1_slct2_COMPU_VTAB_REF /end COMPU_METHOD
/begin COMPU_VTAB CRI_Tpost1_slct2_COMPU_VTAB_REF "Verbal Table" TAB_VERB 3 0 "Standard" 1 "Alternate 1" 2 "Alt 1 + Std" DEFAULT_VALUE "UNKNOWN" /end COMPU_VTAB
/begin CHARACTERISTIC CRI_Tpost1_slct3 "Post 1 injection timing{CRI_Tpost1_slct3&0xff=0:Standard}{CRI_Tpost1_slct3&0xff=1:Alternate 1}{CRI_Tpost1_slct3&0xff=2:Alt 1 + Std}" VALUE 0x001F19D1 /* @ECU_Address@CRI_Tpost1_slct3@0x0100A5E0@ */ ECIPP_ALIGNMENT_UBYTE 255 CRI_Tpost1_slct3_COMPU_VTAB 0 255 BIT_MASK 0xff /end CHARACTERISTIC
/begin COMPU_METHOD CRI_Tpost1_slct3_COMPU_VTAB "Verbal Table" TAB_VERB "%.0" "list" COMPU_TAB_REF CRI_Tpost1_slct3_COMPU_VTAB_REF /end COMPU_METHOD
/begin COMPU_VTAB CRI_Tpost1_slct3_COMPU_VTAB_REF "Verbal Table" TAB_VERB 3 0 "Standard" 1 "Alternate 1" 2 "Alt 1 + Std" DEFAULT_VALUE "UNKNOWN" /end COMPU_VTAB
/begin CHARACTERISTIC CRI_Tpost1_slct4 "Post 1 injection timing{CRI_Tpost1_slct4&0xff=0:Standard}{CRI_Tpost1_slct4&0xff=1:Alternate 1}{CRI_Tpost1_slct4&0xff=2:Alt 1 + Std}" VALUE 0x001F19D2 /* @ECU_Address@CRI_Tpost1_slct4@0x0100A5E8@ */ ECIPP_ALIGNMENT_UBYTE 255 CRI_Tpost1_slct4_COMPU_VTAB 0 255 BIT_MASK 0xff /end CHARACTERISTIC
/begin COMPU_METHOD CRI_Tpost1_slct4_COMPU_VTAB "Verbal Table" TAB_VERB "%.0" "list" COMPU_TAB_REF CRI_Tpost1_slct4_COMPU_VTAB_REF /end COMPU_METHOD
/begin COMPU_VTAB CRI_Tpost1_slct4_COMPU_VTAB_REF "Verbal Table" TAB_VERB 3 0 "Standard" 1 "Alternate 1" 2 "Alt 1 + Std" DEFAULT_VALUE "UNKNOWN" /end COMPU_VTAB
/begin CHARACTERISTIC CRI_Tpost1_slct5 "Post 1 injection timing{CRI_Tpost1_slct5&0xff=0:Standard}{CRI_Tpost1_slct5&0xff=1:Alternate 1}{CRI_Tpost1_slct5&0xff=2:Alt 1 + Std}" VALUE 0x001F19D3 /* @ECU_Address@CRI_Tpost1_slct5@0x0100A5F0@ */ ECIPP_ALIGNMENT_UBYTE 255 CRI_Tpost1_slct5_COMPU_VTAB 0 255 BIT_MASK 0xff /end CHARACTERISTIC
/begin COMPU_METHOD CRI_Tpost1_slct5_COMPU_VTAB "Verbal Table" TAB_VERB "%.0" "list" COMPU_TAB_REF CRI_Tpost1_slct5_COMPU_VTAB_REF /end COMPU_METHOD
/begin COMPU_VTAB CRI_Tpost1_slct5_COMPU_VTAB_REF "Verbal Table" TAB_VERB 3 0 "Standard" 1 "Alternate 1" 2 "Alt 1 + Std" DEFAULT_VALUE "UNKNOWN" /end COMPU_VTAB
/begin CHARACTERISTIC CRI_Tpost1_slct6 "Post 1 injection timing{CRI_Tpost1_slct6&0xff=0:Standard}{CRI_Tpost1_slct6&0xff=1:Alternate 1}{CRI_Tpost1_slct6&0xff=2:Alt 1 + Std}" VALUE 0x001F19D4 /* @ECU_Address@CRI_Tpost1_slct6@0x0100A5F8@ */ ECIPP_ALIGNMENT_UBYTE 255 CRI_Tpost1_slct6_COMPU_VTAB 0 255 BIT_MASK 0xff /end CHARACTERISTIC
/begin COMPU_METHOD CRI_Tpost1_slct6_COMPU_VTAB "Verbal Table" TAB_VERB "%.0" "list" COMPU_TAB_REF CRI_Tpost1_slct6_COMPU_VTAB_REF /end COMPU_METHOD
/begin COMPU_VTAB CRI_Tpost1_slct6_COMPU_VTAB_REF "Verbal Table" TAB_VERB 3 0 "Standard" 1 "Alternate 1" 2 "Alt 1 + Std" DEFAULT_VALUE "UNKNOWN" /end COMPU_VTAB
/begin CHARACTERISTIC CRI_Tpost1_slct7 "Post 1 injection timing{CRI_Tpost1_slct7&0xff=0:Standard}{CRI_Tpost1_slct7&0xff=1:Alternate 1}{CRI_Tpost1_slct7&0xff=2:Alt 1 + Std}" VALUE 0x001F19D5 /* @ECU_Address@CRI_Tpost1_slct7@0x0100A600@ */ ECIPP_ALIGNMENT_UBYTE 255 CRI_Tpost1_slct7_COMPU_VTAB 0 255 BIT_MASK 0xff /end CHARACTERISTIC
/begin COMPU_METHOD CRI_Tpost1_slct7_COMPU_VTAB "Verbal Table" TAB_VERB "%.0" "list" COMPU_TAB_REF CRI_Tpost1_slct7_COMPU_VTAB_REF /end COMPU_METHOD
/begin COMPU_VTAB CRI_Tpost1_slct7_COMPU_VTAB_REF "Verbal Table" TAB_VERB 3 0 "Standard" 1 "Alternate 1" 2 "Alt 1 + Std" DEFAULT_VALUE "UNKNOWN" /end COMPU_VTAB
/begin CHARACTERISTIC CRI_Tpost2_slct0 "Post 2 injection timing{CRI_Tpost2_slct0&0xff=0:Standard}{CRI_Tpost2_slct0&0xff=1:Alternate 1}{CRI_Tpost2_slct0&0xff=2:Alt 1 + Std}" VALUE 0x001F19D8 /* @ECU_Address@CRI_Tpost2_slct0@0x0100A608@ */ ECIPP_ALIGNMENT_UBYTE 255 CRI_Tpost2_slct0_COMPU_VTAB 0 255 BIT_MASK 0xff /end CHARACTERISTIC
/begin COMPU_METHOD CRI_Tpost2_slct0_COMPU_VTAB "Verbal Table" TAB_VERB "%.0" "list" COMPU_TAB_REF CRI_Tpost2_slct0_COMPU_VTAB_REF /end COMPU_METHOD
/begin COMPU_VTAB CRI_Tpost2_slct0_COMPU_VTAB_REF "Verbal Table" TAB_VERB 3 0 "Standard" 1 "Alternate 1" 2 "Alt 1 + Std" DEFAULT_VALUE "UNKNOWN" /end COMPU_VTAB
/begin CHARACTERISTIC CRI_Tpost2_slct1 "Post 2 injection timing{CRI_Tpost2_slct1&0xff=0:Standard}{CRI_Tpost2_slct1&0xff=1:Alternate 1}{CRI_Tpost2_slct1&0xff=2:Alt 1 + Std}" VALUE 0x001F19D9 /* @ECU_Address@CRI_Tpost2_slct1@0x0100A610@ */ ECIPP_ALIGNMENT_UBYTE 255 CRI_Tpost2_slct1_COMPU_VTAB 0 255 BIT_MASK 0xff /end CHARACTERISTIC
/begin COMPU_METHOD CRI_Tpost2_slct1_COMPU_VTAB "Verbal Table" TAB_VERB "%.0" "list" COMPU_TAB_REF CRI_Tpost2_slct1_COMPU_VTAB_REF /end COMPU_METHOD
/begin COMPU_VTAB CRI_Tpost2_slct1_COMPU_VTAB_REF "Verbal Table" TAB_VERB 3 0 "Standard" 1 "Alternate 1" 2 "Alt 1 + Std" DEFAULT_VALUE "UNKNOWN" /end COMPU_VTAB
/begin CHARACTERISTIC CRI_Tpost2_slct2 "Post 2 injection timing{CRI_Tpost2_slct2&0xff=0:Standard}{CRI_Tpost2_slct2&0xff=1:Alternate 1}{CRI_Tpost2_slct2&0xff=2:Alt 1 + Std}" VALUE 0x001F19DA /* @ECU_Address@CRI_Tpost2_slct2@0x0100A618@ */ ECIPP_ALIGNMENT_UBYTE 255 CRI_Tpost2_slct2_COMPU_VTAB 0 255 BIT_MASK 0xff /end CHARACTERISTIC
/begin COMPU_METHOD CRI_Tpost2_slct2_COMPU_VTAB "Verbal Table" TAB_VERB "%.0" "list" COMPU_TAB_REF CRI_Tpost2_slct2_COMPU_VTAB_REF /end COMPU_METHOD
/begin COMPU_VTAB CRI_Tpost2_slct2_COMPU_VTAB_REF "Verbal Table" TAB_VERB 3 0 "Standard" 1 "Alternate 1" 2 "Alt 1 + Std" DEFAULT_VALUE "UNKNOWN" /end COMPU_VTAB
/begin CHARACTERISTIC CRI_Tpost2_slct3 "Post 2 injection timing{CRI_Tpost2_slct3&0xff=0:Standard}{CRI_Tpost2_slct3&0xff=1:Alternate 1}{CRI_Tpost2_slct3&0xff=2:Alt 1 + Std}" VALUE 0x001F19DB /* @ECU_Address@CRI_Tpost2_slct3@0x0100A620@ */ ECIPP_ALIGNMENT_UBYTE 255 CRI_Tpost2_slct3_COMPU_VTAB 0 255 BIT_MASK 0xff /end CHARACTERISTIC
/begin COMPU_METHOD CRI_Tpost2_slct3_COMPU_VTAB "Verbal Table" TAB_VERB "%.0" "list" COMPU_TAB_REF CRI_Tpost2_slct3_COMPU_VTAB_REF /end COMPU_METHOD
/begin COMPU_VTAB CRI_Tpost2_slct3_COMPU_VTAB_REF "Verbal Table" TAB_VERB 3 0 "Standard" 1 "Alternate 1" 2 "Alt 1 + Std" DEFAULT_VALUE "UNKNOWN" /end COMPU_VTAB
/begin CHARACTERISTIC CRI_Tpost2_slct4 "Post 2 injection timing{CRI_Tpost2_slct4&0xff=0:Standard}{CRI_Tpost2_slct4&0xff=1:Alternate 1}{CRI_Tpost2_slct4&0xff=2:Alt 1 + Std}" VALUE 0x001F19DC /* @ECU_Address@CRI_Tpost2_slct4@0x0100A628@ */ ECIPP_ALIGNMENT_UBYTE 255 CRI_Tpost2_slct4_COMPU_VTAB 0 255 BIT_MASK 0xff /end CHARACTERISTIC
/begin COMPU_METHOD CRI_Tpost2_slct4_COMPU_VTAB "Verbal Table" TAB_VERB "%.0" "list" COMPU_TAB_REF CRI_Tpost2_slct4_COMPU_VTAB_REF /end COMPU_METHOD
/begin COMPU_VTAB CRI_Tpost2_slct4_COMPU_VTAB_REF "Verbal Table" TAB_VERB 3 0 "Standard" 1 "Alternate 1" 2 "Alt 1 + Std" DEFAULT_VALUE "UNKNOWN" /end COMPU_VTAB
/begin CHARACTERISTIC CRI_Tpost2_slct5 "Post 2 injection timing{CRI_Tpost2_slct5&0xff=0:Standard}{CRI_Tpost2_slct5&0xff=1:Alternate 1}{CRI_Tpost2_slct5&0xff=2:Alt 1 + Std}" VALUE 0x001F19DD /* @ECU_Address@CRI_Tpost2_slct5@0x0100A630@ */ ECIPP_ALIGNMENT_UBYTE 255 CRI_Tpost2_slct5_COMPU_VTAB 0 255 BIT_MASK 0xff /end CHARACTERISTIC
/begin COMPU_METHOD CRI_Tpost2_slct5_COMPU_VTAB "Verbal Table" TAB_VERB "%.0" "list" COMPU_TAB_REF CRI_Tpost2_slct5_COMPU_VTAB_REF /end COMPU_METHOD
/begin COMPU_VTAB CRI_Tpost2_slct5_COMPU_VTAB_REF "Verbal Table" TAB_VERB 3 0 "Standard" 1 "Alternate 1" 2 "Alt 1 + Std" DEFAULT_VALUE "UNKNOWN" /end COMPU_VTAB
/begin CHARACTERISTIC CRI_Tpost2_slct6 "Post 2 injection timing{CRI_Tpost2_slct6&0xff=0:Standard}{CRI_Tpost2_slct6&0xff=1:Alternate 1}{CRI_Tpost2_slct6&0xff=2:Alt 1 + Std}" VALUE 0x001F19DE /* @ECU_Address@CRI_Tpost2_slct6@0x0100A638@ */ ECIPP_ALIGNMENT_UBYTE 255 CRI_Tpost2_slct6_COMPU_VTAB 0 255 BIT_MASK 0xff /end CHARACTERISTIC
/begin COMPU_METHOD CRI_Tpost2_slct6_COMPU_VTAB "Verbal Table" TAB_VERB "%.0" "list" COMPU_TAB_REF CRI_Tpost2_slct6_COMPU_VTAB_REF /end COMPU_METHOD
/begin COMPU_VTAB CRI_Tpost2_slct6_COMPU_VTAB_REF "Verbal Table" TAB_VERB 3 0 "Standard" 1 "Alternate 1" 2 "Alt 1 + Std" DEFAULT_VALUE "UNKNOWN" /end COMPU_VTAB
/begin CHARACTERISTIC CRI_Tpost2_slct7 "Post 2 injection timing{CRI_Tpost2_slct7&0xff=0:Standard}{CRI_Tpost2_slct7&0xff=1:Alternate 1}{CRI_Tpost2_slct7&0xff=2:Alt 1 + Std}" VALUE 0x001F19DF /* @ECU_Address@CRI_Tpost2_slct7@0x0100A640@ */ ECIPP_ALIGNMENT_UBYTE 255 CRI_Tpost2_slct7_COMPU_VTAB 0 255 BIT_MASK 0xff /end CHARACTERISTIC
/begin COMPU_METHOD CRI_Tpost2_slct7_COMPU_VTAB "Verbal Table" TAB_VERB "%.0" "list" COMPU_TAB_REF CRI_Tpost2_slct7_COMPU_VTAB_REF /end COMPU_METHOD
/begin COMPU_VTAB CRI_Tpost2_slct7_COMPU_VTAB_REF "Verbal Table" TAB_VERB 3 0 "Standard" 1 "Alternate 1" 2 "Alt 1 + Std" DEFAULT_VALUE "UNKNOWN" /end COMPU_VTAB
/begin MEASUREMENT CRI_active_mode "Active mode" UBYTE Compu_CRI_active_mode 0 0 0 255 ECU_ADDRESS 0x0100A648 /end MEASUREMENT
/begin COMPU_METHOD Compu_CRI_active_mode " " RAT_FUNC "%.0" "-" COEFFS 0 1 0 0 0 1 /end COMPU_METHOD
/begin CHARACTERISTIC CRI_pilot1_priority0 "Pilot 1/2 conflict priority{CRI_pilot1_priority0&0xff=0:Pilot 1}{CRI_pilot1_priority0&0xff=1:Pilot 2}" VALUE 0x001F1A64 /* @ECU_Address@CRI_pilot1_priority0@0x0100A7A8@ */ ECIPP_ALIGNMENT_UBYTE 255 CRI_pilot1_priority0_COMPU_VTAB 0 255 BIT_MASK 0xff /end CHARACTERISTIC
/begin COMPU_METHOD CRI_pilot1_priority0_COMPU_VTAB "Verbal Table" TAB_VERB "%.0" "list" COMPU_TAB_REF CRI_pilot1_priority0_COMPU_VTAB_REF /end COMPU_METHOD
/begin COMPU_VTAB CRI_pilot1_priority0_COMPU_VTAB_REF "Verbal Table" TAB_VERB 2 0 "Pilot 1" 1 "Pilot 2" DEFAULT_VALUE "UNKNOWN" /end COMPU_VTAB
/begin CHARACTERISTIC CRI_pulseoff_slct0 "Forced injection disabling table{CRI_pulseoff_slct0&0xff=0:None}{CRI_pulseoff_slct0&0xff=1:Standard}{CRI_pulseoff_slct0&0xff=2:Alternate 1}{CRI_pulseoff_slct0&0xff=3:Alt 1 or Std}" VALUE 0x001F1A6E /* @ECU_Address@CRI_pulseoff_slct0@0x0100A7B0@ */ ECIPP_ALIGNMENT_UBYTE 255 CRI_pulseoff_slct0_COMPU_VTAB 0 255 BIT_MASK 0xff /end CHARACTERISTIC
/begin COMPU_METHOD CRI_pulseoff_slct0_COMPU_VTAB "Verbal Table" TAB_VERB "%.0" "list" COMPU_TAB_REF CRI_pulseoff_slct0_COMPU_VTAB_REF /end COMPU_METHOD
/begin COMPU_VTAB CRI_pulseoff_slct0_COMPU_VTAB_REF "Verbal Table" TAB_VERB 4 0 "None" 1 "Standard" 2 "Alternate 1" 3 "Alt 1 or Std" DEFAULT_VALUE "UNKNOWN" /end COMPU_VTAB
/begin CHARACTERISTIC CRI_pulseoff_slct1 "Forced injection disabling table{CRI_pulseoff_slct1&0xff=0:None}{CRI_pulseoff_slct1&0xff=1:Standard}{CRI_pulseoff_slct1&0xff=2:Alternate 1}{CRI_pulseoff_slct1&0xff=3:Alt 1 or Std}" VALUE 0x001F1A6F /* @ECU_Address@CRI_pulseoff_slct1@0x0100A7B8@ */ ECIPP_ALIGNMENT_UBYTE 255 CRI_pulseoff_slct1_COMPU_VTAB 0 255 BIT_MASK 0xff /end CHARACTERISTIC
/begin COMPU_METHOD CRI_pulseoff_slct1_COMPU_VTAB "Verbal Table" TAB_VERB "%.0" "list" COMPU_TAB_REF CRI_pulseoff_slct1_COMPU_VTAB_REF /end COMPU_METHOD
/begin COMPU_VTAB CRI_pulseoff_slct1_COMPU_VTAB_REF "Verbal Table" TAB_VERB 4 0 "None" 1 "Standard" 2 "Alternate 1" 3 "Alt 1 or Std" DEFAULT_VALUE "UNKNOWN" /end COMPU_VTAB
/begin CHARACTERISTIC CRI_pulseoff_slct2 "Forced injection disabling table{CRI_pulseoff_slct2&0xff=0:None}{CRI_pulseoff_slct2&0xff=1:Standard}{CRI_pulseoff_slct2&0xff=2:Alternate 1}{CRI_pulseoff_slct2&0xff=3:Alt 1 or Std}" VALUE 0x001F1A70 /* @ECU_Address@CRI_pulseoff_slct2@0x0100A7C0@ */ ECIPP_ALIGNMENT_UBYTE 255 CRI_pulseoff_slct2_COMPU_VTAB 0 255 BIT_MASK 0xff /end CHARACTERISTIC
/begin COMPU_METHOD CRI_pulseoff_slct2_COMPU_VTAB "Verbal Table" TAB_VERB "%.0" "list" COMPU_TAB_REF CRI_pulseoff_slct2_COMPU_VTAB_REF /end COMPU_METHOD
/begin COMPU_VTAB CRI_pulseoff_slct2_COMPU_VTAB_REF "Verbal Table" TAB_VERB 4 0 "None" 1 "Standard" 2 "Alternate 1" 3 "Alt 1 or Std" DEFAULT_VALUE "UNKNOWN" /end COMPU_VTAB
/begin CHARACTERISTIC CRI_pulseoff_slct3 "Forced injection disabling table{CRI_pulseoff_slct3&0xff=0:None}{CRI_pulseoff_slct3&0xff=1:Standard}{CRI_pulseoff_slct3&0xff=2:Alternate 1}{CRI_pulseoff_slct3&0xff=3:Alt 1 or Std}" VALUE 0x001F1A71 /* @ECU_Address@CRI_pulseoff_slct3@0x0100A7C8@ */ ECIPP_ALIGNMENT_UBYTE 255 CRI_pulseoff_slct3_COMPU_VTAB 0 255 BIT_MASK 0xff /end CHARACTERISTIC
/begin COMPU_METHOD CRI_pulseoff_slct3_COMPU_VTAB "Verbal Table" TAB_VERB "%.0" "list" COMPU_TAB_REF CRI_pulseoff_slct3_COMPU_VTAB_REF /end COMPU_METHOD
/begin COMPU_VTAB CRI_pulseoff_slct3_COMPU_VTAB_REF "Verbal Table" TAB_VERB 4 0 "None" 1 "Standard" 2 "Alternate 1" 3 "Alt 1 or Std" DEFAULT_VALUE "UNKNOWN" /end COMPU_VTAB
/begin CHARACTERISTIC CRI_pulseoff_slct4 "Forced injection disabling table{CRI_pulseoff_slct4&0xff=0:None}{CRI_pulseoff_slct4&0xff=1:Standard}{CRI_pulseoff_slct4&0xff=2:Alternate 1}{CRI_pulseoff_slct4&0xff=3:Alt 1 or Std}" VALUE 0x001F1A72 /* @ECU_Address@CRI_pulseoff_slct4@0x0100A7D0@ */ ECIPP_ALIGNMENT_UBYTE 255 CRI_pulseoff_slct4_COMPU_VTAB 0 255 BIT_MASK 0xff /end CHARACTERISTIC
/begin COMPU_METHOD CRI_pulseoff_slct4_COMPU_VTAB "Verbal Table" TAB_VERB "%.0" "list" COMPU_TAB_REF CRI_pulseoff_slct4_COMPU_VTAB_REF /end COMPU_METHOD
/begin COMPU_VTAB CRI_pulseoff_slct4_COMPU_VTAB_REF "Verbal Table" TAB_VERB 4 0 "None" 1 "Standard" 2 "Alternate 1" 3 "Alt 1 or Std" DEFAULT_VALUE "UNKNOWN" /end COMPU_VTAB
/begin CHARACTERISTIC CRI_pulseoff_slct5 "Forced injection disabling table{CRI_pulseoff_slct5&0xff=0:None}{CRI_pulseoff_slct5&0xff=1:Standard}{CRI_pulseoff_slct5&0xff=2:Alternate 1}{CRI_pulseoff_slct5&0xff=3:Alt 1 or Std}" VALUE 0x001F1A73 /* @ECU_Address@CRI_pulseoff_slct5@0x0100A7D8@ */ ECIPP_ALIGNMENT_UBYTE 255 CRI_pulseoff_slct5_COMPU_VTAB 0 255 BIT_MASK 0xff /end CHARACTERISTIC
/begin COMPU_METHOD CRI_pulseoff_slct5_COMPU_VTAB "Verbal Table" TAB_VERB "%.0" "list" COMPU_TAB_REF CRI_pulseoff_slct5_COMPU_VTAB_REF /end COMPU_METHOD
/begin COMPU_VTAB CRI_pulseoff_slct5_COMPU_VTAB_REF "Verbal Table" TAB_VERB 4 0 "None" 1 "Standard" 2 "Alternate 1" 3 "Alt 1 or Std" DEFAULT_VALUE "UNKNOWN" /end COMPU_VTAB
/begin CHARACTERISTIC CRI_pulseoff_slct6 "Forced injection disabling table{CRI_pulseoff_slct6&0xff=0:None}{CRI_pulseoff_slct6&0xff=1:Standard}{CRI_pulseoff_slct6&0xff=2:Alternate 1}{CRI_pulseoff_slct6&0xff=3:Alt 1 or Std}" VALUE 0x001F1A74 /* @ECU_Address@CRI_pulseoff_slct6@0x0100A7E0@ */ ECIPP_ALIGNMENT_UBYTE 255 CRI_pulseoff_slct6_COMPU_VTAB 0 255 BIT_MASK 0xff /end CHARACTERISTIC
/begin COMPU_METHOD CRI_pulseoff_slct6_COMPU_VTAB "Verbal Table" TAB_VERB "%.0" "list" COMPU_TAB_REF CRI_pulseoff_slct6_COMPU_VTAB_REF /end COMPU_METHOD
/begin COMPU_VTAB CRI_pulseoff_slct6_COMPU_VTAB_REF "Verbal Table" TAB_VERB 4 0 "None" 1 "Standard" 2 "Alternate 1" 3 "Alt 1 or Std" DEFAULT_VALUE "UNKNOWN" /end COMPU_VTAB
/begin CHARACTERISTIC CRI_pulseoff_slct7 "Forced injection disabling table{CRI_pulseoff_slct7&0xff=0:None}{CRI_pulseoff_slct7&0xff=1:Standard}{CRI_pulseoff_slct7&0xff=2:Alternate 1}{CRI_pulseoff_slct7&0xff=3:Alt 1 or Std}" VALUE 0x001F1A75 /* @ECU_Address@CRI_pulseoff_slct7@0x0100A7E8@ */ ECIPP_ALIGNMENT_UBYTE 255 CRI_pulseoff_slct7_COMPU_VTAB 0 255 BIT_MASK 0xff /end CHARACTERISTIC
/begin COMPU_METHOD CRI_pulseoff_slct7_COMPU_VTAB "Verbal Table" TAB_VERB "%.0" "list" COMPU_TAB_REF CRI_pulseoff_slct7_COMPU_VTAB_REF /end COMPU_METHOD
/begin COMPU_VTAB CRI_pulseoff_slct7_COMPU_VTAB_REF "Verbal Table" TAB_VERB 4 0 "None" 1 "Standard" 2 "Alternate 1" 3 "Alt 1 or Std" DEFAULT_VALUE "UNKNOWN" /end COMPU_VTAB
/begin CHARACTERISTIC CRI_bst_dP_scalar0 "Boost EMP throttle delta-P scalar" VALUE 0x001F18B4 /* @ECU_Address@CRI_bst_dP_scalar0@0x0100A7F0@ */ ECIPP_ALIGNMENT_UWORD 256 Compu_CRI_bst_dP_scalar0 0 255.99609375 /end CHARACTERISTIC
/begin COMPU_METHOD Compu_CRI_bst_dP_scalar0 " " RAT_FUNC "%.2" "psi" COEFFS 0 256 0 0 0 1 /end COMPU_METHOD
/begin CHARACTERISTIC CRI_bst_dP_slct0 "Boost EMP throttle delta-P command{CRI_bst_dP_slct0&0xff=0:Scalar (below)}{CRI_bst_dP_slct0&0xff=1:Boost 2D Cmd}" VALUE 0x001F19EC /* @ECU_Address@CRI_bst_dP_slct0@0x0100A7F8@ */ ECIPP_ALIGNMENT_UBYTE 255 CRI_bst_dP_slct0_COMPU_VTAB 0 255 BIT_MASK 0xff /end CHARACTERISTIC
/begin COMPU_METHOD CRI_bst_dP_slct0_COMPU_VTAB "Verbal Table" TAB_VERB "%.0" "list" COMPU_TAB_REF CRI_bst_dP_slct0_COMPU_VTAB_REF /end COMPU_METHOD
/begin COMPU_VTAB CRI_bst_dP_slct0_COMPU_VTAB_REF "Verbal Table" TAB_VERB 2 0 "Scalar (below)" 1 "Boost 2D Cmd" DEFAULT_VALUE "UNKNOWN" /end COMPU_VTAB
/begin CHARACTERISTIC CRI_bst_dP_slct1 "Boost EMP throttle delta-P command{CRI_bst_dP_slct1&0xff=0:Scalar (below)}{CRI_bst_dP_slct1&0xff=1:Boost 2D Cmd}" VALUE 0x001F19ED /* @ECU_Address@CRI_bst_dP_slct1@0x0100A800@ */ ECIPP_ALIGNMENT_UBYTE 255 CRI_bst_dP_slct1_COMPU_VTAB 0 255 BIT_MASK 0xff /end CHARACTERISTIC
/begin COMPU_METHOD CRI_bst_dP_slct1_COMPU_VTAB "Verbal Table" TAB_VERB "%.0" "list" COMPU_TAB_REF CRI_bst_dP_slct1_COMPU_VTAB_REF /end COMPU_METHOD
/begin COMPU_VTAB CRI_bst_dP_slct1_COMPU_VTAB_REF "Verbal Table" TAB_VERB 2 0 "Scalar (below)" 1 "Boost 2D Cmd" DEFAULT_VALUE "UNKNOWN" /end COMPU_VTAB
/begin CHARACTERISTIC CRI_bst_dP_slct2 "Boost EMP throttle delta-P command{CRI_bst_dP_slct2&0xff=0:Scalar (below)}{CRI_bst_dP_slct2&0xff=1:Boost 2D Cmd}" VALUE 0x001F19EE /* @ECU_Address@CRI_bst_dP_slct2@0x0100A808@ */ ECIPP_ALIGNMENT_UBYTE 255 CRI_bst_dP_slct2_COMPU_VTAB 0 255 BIT_MASK 0xff /end CHARACTERISTIC
/begin COMPU_METHOD CRI_bst_dP_slct2_COMPU_VTAB "Verbal Table" TAB_VERB "%.0" "list" COMPU_TAB_REF CRI_bst_dP_slct2_COMPU_VTAB_REF /end COMPU_METHOD
/begin COMPU_VTAB CRI_bst_dP_slct2_COMPU_VTAB_REF "Verbal Table" TAB_VERB 2 0 "Scalar (below)" 1 "Boost 2D Cmd" DEFAULT_VALUE "UNKNOWN" /end COMPU_VTAB
/begin CHARACTERISTIC CRI_bst_dP_slct3 "Boost EMP throttle delta-P command{CRI_bst_dP_slct3&0xff=0:Scalar (below)}{CRI_bst_dP_slct3&0xff=1:Boost 2D Cmd}" VALUE 0x001F19EF /* @ECU_Address@CRI_bst_dP_slct3@0x0100A810@ */ ECIPP_ALIGNMENT_UBYTE 255 CRI_bst_dP_slct3_COMPU_VTAB 0 255 BIT_MASK 0xff /end CHARACTERISTIC
/begin COMPU_METHOD CRI_bst_dP_slct3_COMPU_VTAB "Verbal Table" TAB_VERB "%.0" "list" COMPU_TAB_REF CRI_bst_dP_slct3_COMPU_VTAB_REF /end COMPU_METHOD
/begin COMPU_VTAB CRI_bst_dP_slct3_COMPU_VTAB_REF "Verbal Table" TAB_VERB 2 0 "Scalar (below)" 1 "Boost 2D Cmd" DEFAULT_VALUE "UNKNOWN" /end COMPU_VTAB
/begin CHARACTERISTIC CRI_bst_dP_slct4 "Boost EMP throttle delta-P command{CRI_bst_dP_slct4&0xff=0:Scalar (below)}{CRI_bst_dP_slct4&0xff=1:Boost 2D Cmd}" VALUE 0x001F19F0 /* @ECU_Address@CRI_bst_dP_slct4@0x0100A818@ */ ECIPP_ALIGNMENT_UBYTE 255 CRI_bst_dP_slct4_COMPU_VTAB 0 255 BIT_MASK 0xff /end CHARACTERISTIC
/begin COMPU_METHOD CRI_bst_dP_slct4_COMPU_VTAB "Verbal Table" TAB_VERB "%.0" "list" COMPU_TAB_REF CRI_bst_dP_slct4_COMPU_VTAB_REF /end COMPU_METHOD
/begin COMPU_VTAB CRI_bst_dP_slct4_COMPU_VTAB_REF "Verbal Table" TAB_VERB 2 0 "Scalar (below)" 1 "Boost 2D Cmd" DEFAULT_VALUE "UNKNOWN" /end COMPU_VTAB
/begin CHARACTERISTIC CRI_bst_dP_slct5 "Boost EMP throttle delta-P command{CRI_bst_dP_slct5&0xff=0:Scalar (below)}{CRI_bst_dP_slct5&0xff=1:Boost 2D Cmd}" VALUE 0x001F19F1 /* @ECU_Address@CRI_bst_dP_slct5@0x0100A820@ */ ECIPP_ALIGNMENT_UBYTE 255 CRI_bst_dP_slct5_COMPU_VTAB 0 255 BIT_MASK 0xff /end CHARACTERISTIC
/begin COMPU_METHOD CRI_bst_dP_slct5_COMPU_VTAB "Verbal Table" TAB_VERB "%.0" "list" COMPU_TAB_REF CRI_bst_dP_slct5_COMPU_VTAB_REF /end COMPU_METHOD
/begin COMPU_VTAB CRI_bst_dP_slct5_COMPU_VTAB_REF "Verbal Table" TAB_VERB 2 0 "Scalar (below)" 1 "Boost 2D Cmd" DEFAULT_VALUE "UNKNOWN" /end COMPU_VTAB
/begin CHARACTERISTIC CRI_bst_dP_slct6 "Boost EMP throttle delta-P command{CRI_bst_dP_slct6&0xff=0:Scalar (below)}{CRI_bst_dP_slct6&0xff=1:Boost 2D Cmd}" VALUE 0x001F19F2 /* @ECU_Address@CRI_bst_dP_slct6@0x0100A828@ */ ECIPP_ALIGNMENT_UBYTE 255 CRI_bst_dP_slct6_COMPU_VTAB 0 255 BIT_MASK 0xff /end CHARACTERISTIC
/begin COMPU_METHOD CRI_bst_dP_slct6_COMPU_VTAB "Verbal Table" TAB_VERB "%.0" "list" COMPU_TAB_REF CRI_bst_dP_slct6_COMPU_VTAB_REF /end COMPU_METHOD
/begin COMPU_VTAB CRI_bst_dP_slct6_COMPU_VTAB_REF "Verbal Table" TAB_VERB 2 0 "Scalar (below)" 1 "Boost 2D Cmd" DEFAULT_VALUE "UNKNOWN" /end COMPU_VTAB
/begin CHARACTERISTIC CRI_bst_dP_slct7 "Boost EMP throttle delta-P command{CRI_bst_dP_slct7&0xff=0:Scalar (below)}{CRI_bst_dP_slct7&0xff=1:Boost 2D Cmd}" VALUE 0x001F19F3 /* @ECU_Address@CRI_bst_dP_slct7@0x0100A830@ */ ECIPP_ALIGNMENT_UBYTE 255 CRI_bst_dP_slct7_COMPU_VTAB 0 255 BIT_MASK 0xff /end CHARACTERISTIC
/begin COMPU_METHOD CRI_bst_dP_slct7_COMPU_VTAB "Verbal Table" TAB_VERB "%.0" "list" COMPU_TAB_REF CRI_bst_dP_slct7_COMPU_VTAB_REF /end COMPU_METHOD
/begin COMPU_VTAB CRI_bst_dP_slct7_COMPU_VTAB_REF "Verbal Table" TAB_VERB 2 0 "Scalar (below)" 1 "Boost 2D Cmd" DEFAULT_VALUE "UNKNOWN" /end COMPU_VTAB
/begin CHARACTERISTIC CRI_EGR_dP_slct0 "EGR minimum delta-P command{CRI_EGR_dP_slct0&0xff=0:Standard}{CRI_EGR_dP_slct0&0xff=1:Alternate 1}{CRI_EGR_dP_slct0&0xff=2:Alt 1 + Std}" VALUE 0x001F1968 /* @ECU_Address@CRI_EGR_dP_slct0@0x0100A838@ */ ECIPP_ALIGNMENT_UBYTE 255 CRI_EGR_dP_slct0_COMPU_VTAB 0 255 BIT_MASK 0xff /end CHARACTERISTIC
/begin COMPU_METHOD CRI_EGR_dP_slct0_COMPU_VTAB "Verbal Table" TAB_VERB "%.0" "list" COMPU_TAB_REF CRI_EGR_dP_slct0_COMPU_VTAB_REF /end COMPU_METHOD
/begin COMPU_VTAB CRI_EGR_dP_slct0_COMPU_VTAB_REF "Verbal Table" TAB_VERB 3 0 "Standard" 1 "Alternate 1" 2 "Alt 1 + Std" DEFAULT_VALUE "UNKNOWN" /end COMPU_VTAB
/begin CHARACTERISTIC CRI_EGR_dP_slct1 "EGR minimum delta-P command{CRI_EGR_dP_slct1&0xff=0:Standard}{CRI_EGR_dP_slct1&0xff=1:Alternate 1}{CRI_EGR_dP_slct1&0xff=2:Alt 1 + Std}" VALUE 0x001F1969 /* @ECU_Address@CRI_EGR_dP_slct1@0x0100A840@ */ ECIPP_ALIGNMENT_UBYTE 255 CRI_EGR_dP_slct1_COMPU_VTAB 0 255 BIT_MASK 0xff /end CHARACTERISTIC
/begin COMPU_METHOD CRI_EGR_dP_slct1_COMPU_VTAB "Verbal Table" TAB_VERB "%.0" "list" COMPU_TAB_REF CRI_EGR_dP_slct1_COMPU_VTAB_REF /end COMPU_METHOD
/begin COMPU_VTAB CRI_EGR_dP_slct1_COMPU_VTAB_REF "Verbal Table" TAB_VERB 3 0 "Standard" 1 "Alternate 1" 2 "Alt 1 + Std" DEFAULT_VALUE "UNKNOWN" /end COMPU_VTAB
/begin CHARACTERISTIC CRI_EGR_dP_slct2 "EGR minimum delta-P command{CRI_EGR_dP_slct2&0xff=0:Standard}{CRI_EGR_dP_slct2&0xff=1:Alternate 1}{CRI_EGR_dP_slct2&0xff=2:Alt 1 + Std}" VALUE 0x001F196A /* @ECU_Address@CRI_EGR_dP_slct2@0x0100A848@ */ ECIPP_ALIGNMENT_UBYTE 255 CRI_EGR_dP_slct2_COMPU_VTAB 0 255 BIT_MASK 0xff /end CHARACTERISTIC
/begin COMPU_METHOD CRI_EGR_dP_slct2_COMPU_VTAB "Verbal Table" TAB_VERB "%.0" "list" COMPU_TAB_REF CRI_EGR_dP_slct2_COMPU_VTAB_REF /end COMPU_METHOD
/begin COMPU_VTAB CRI_EGR_dP_slct2_COMPU_VTAB_REF "Verbal Table" TAB_VERB 3 0 "Standard" 1 "Alternate 1" 2 "Alt 1 + Std" DEFAULT_VALUE "UNKNOWN" /end COMPU_VTAB
/begin CHARACTERISTIC CRI_EGR_dP_slct3 "EGR minimum delta-P command{CRI_EGR_dP_slct3&0xff=0:Standard}{CRI_EGR_dP_slct3&0xff=1:Alternate 1}{CRI_EGR_dP_slct3&0xff=2:Alt 1 + Std}" VALUE 0x001F196B /* @ECU_Address@CRI_EGR_dP_slct3@0x0100A850@ */ ECIPP_ALIGNMENT_UBYTE 255 CRI_EGR_dP_slct3_COMPU_VTAB 0 255 BIT_MASK 0xff /end CHARACTERISTIC
/begin COMPU_METHOD CRI_EGR_dP_slct3_COMPU_VTAB "Verbal Table" TAB_VERB "%.0" "list" COMPU_TAB_REF CRI_EGR_dP_slct3_COMPU_VTAB_REF /end COMPU_METHOD
/begin COMPU_VTAB CRI_EGR_dP_slct3_COMPU_VTAB_REF "Verbal Table" TAB_VERB 3 0 "Standard" 1 "Alternate 1" 2 "Alt 1 + Std" DEFAULT_VALUE "UNKNOWN" /end COMPU_VTAB
/begin CHARACTERISTIC CRI_EGR_dP_slct4 "EGR minimum delta-P command{CRI_EGR_dP_slct4&0xff=0:Standard}{CRI_EGR_dP_slct4&0xff=1:Alternate 1}{CRI_EGR_dP_slct4&0xff=2:Alt 1 + Std}" VALUE 0x001F196C /* @ECU_Address@CRI_EGR_dP_slct4@0x0100A858@ */ ECIPP_ALIGNMENT_UBYTE 255 CRI_EGR_dP_slct4_COMPU_VTAB 0 255 BIT_MASK 0xff /end CHARACTERISTIC
/begin COMPU_METHOD CRI_EGR_dP_slct4_COMPU_VTAB "Verbal Table" TAB_VERB "%.0" "list" COMPU_TAB_REF CRI_EGR_dP_slct4_COMPU_VTAB_REF /end COMPU_METHOD
/begin COMPU_VTAB CRI_EGR_dP_slct4_COMPU_VTAB_REF "Verbal Table" TAB_VERB 3 0 "Standard" 1 "Alternate 1" 2 "Alt 1 + Std" DEFAULT_VALUE "UNKNOWN" /end COMPU_VTAB
/begin CHARACTERISTIC CRI_EGR_dP_slct5 "EGR minimum delta-P command{CRI_EGR_dP_slct5&0xff=0:Standard}{CRI_EGR_dP_slct5&0xff=1:Alternate 1}{CRI_EGR_dP_slct5&0xff=2:Alt 1 + Std}" VALUE 0x001F196D /* @ECU_Address@CRI_EGR_dP_slct5@0x0100A860@ */ ECIPP_ALIGNMENT_UBYTE 255 CRI_EGR_dP_slct5_COMPU_VTAB 0 255 BIT_MASK 0xff /end CHARACTERISTIC
/begin COMPU_METHOD CRI_EGR_dP_slct5_COMPU_VTAB "Verbal Table" TAB_VERB "%.0" "list" COMPU_TAB_REF CRI_EGR_dP_slct5_COMPU_VTAB_REF /end COMPU_METHOD
/begin COMPU_VTAB CRI_EGR_dP_slct5_COMPU_VTAB_REF "Verbal Table" TAB_VERB 3 0 "Standard" 1 "Alternate 1" 2 "Alt 1 + Std" DEFAULT_VALUE "UNKNOWN" /end COMPU_VTAB
/begin CHARACTERISTIC CRI_EGR_dP_slct6 "EGR minimum delta-P command{CRI_EGR_dP_slct6&0xff=0:Standard}{CRI_EGR_dP_slct6&0xff=1:Alternate 1}{CRI_EGR_dP_slct6&0xff=2:Alt 1 + Std}" VALUE 0x001F196E /* @ECU_Address@CRI_EGR_dP_slct6@0x0100A868@ */ ECIPP_ALIGNMENT_UBYTE 255 CRI_EGR_dP_slct6_COMPU_VTAB 0 255 BIT_MASK 0xff /end CHARACTERISTIC
/begin COMPU_METHOD CRI_EGR_dP_slct6_COMPU_VTAB "Verbal Table" TAB_VERB "%.0" "list" COMPU_TAB_REF CRI_EGR_dP_slct6_COMPU_VTAB_REF /end COMPU_METHOD
/begin COMPU_VTAB CRI_EGR_dP_slct6_COMPU_VTAB_REF "Verbal Table" TAB_VERB 3 0 "Standard" 1 "Alternate 1" 2 "Alt 1 + Std" DEFAULT_VALUE "UNKNOWN" /end COMPU_VTAB
/begin CHARACTERISTIC CRI_EGR_dP_slct7 "EGR minimum delta-P command{CRI_EGR_dP_slct7&0xff=0:Standard}{CRI_EGR_dP_slct7&0xff=1:Alternate 1}{CRI_EGR_dP_slct7&0xff=2:Alt 1 + Std}" VALUE 0x001F196F /* @ECU_Address@CRI_EGR_dP_slct7@0x0100A870@ */ ECIPP_ALIGNMENT_UBYTE 255 CRI_EGR_dP_slct7_COMPU_VTAB 0 255 BIT_MASK 0xff /end CHARACTERISTIC
/begin COMPU_METHOD CRI_EGR_dP_slct7_COMPU_VTAB "Verbal Table" TAB_VERB "%.0" "list" COMPU_TAB_REF CRI_EGR_dP_slct7_COMPU_VTAB_REF /end COMPU_METHOD
/begin COMPU_VTAB CRI_EGR_dP_slct7_COMPU_VTAB_REF "Verbal Table" TAB_VERB 3 0 "Standard" 1 "Alternate 1" 2 "Alt 1 + Std" DEFAULT_VALUE "UNKNOWN" /end COMPU_VTAB
/begin CHARACTERISTIC CRI_air_slct8 "Air mass command{CRI_air_slct8&0xff=0:Standard}{CRI_air_slct8&0xff=1:Alternate 1}{CRI_air_slct8&0xff=2:Alt 1 + Std}" VALUE 0x001F19EA /* @ECU_Address@CRI_air_slct8@0x0100A878@ */ ECIPP_ALIGNMENT_UBYTE 255 CRI_air_slct8_COMPU_VTAB 0 255 BIT_MASK 0xff /end CHARACTERISTIC
/begin COMPU_METHOD CRI_air_slct8_COMPU_VTAB "Verbal Table" TAB_VERB "%.0" "list" COMPU_TAB_REF CRI_air_slct8_COMPU_VTAB_REF /end COMPU_METHOD
/begin COMPU_VTAB CRI_air_slct8_COMPU_VTAB_REF "Verbal Table" TAB_VERB 3 0 "Standard" 1 "Alternate 1" 2 "Alt 1 + Std" DEFAULT_VALUE "UNKNOWN" /end COMPU_VTAB
/begin CHARACTERISTIC CRI_P_slct8 "Fuel pressure command{CRI_P_slct8&0xff=0:Standard}{CRI_P_slct8&0xff=1:Alternate 1}{CRI_P_slct8&0xff=2:Alt 1 + Std}" VALUE 0x001F197A /* @ECU_Address@CRI_P_slct8@0x0100A880@ */ ECIPP_ALIGNMENT_UBYTE 255 CRI_P_slct8_COMPU_VTAB 0 255 BIT_MASK 0xff /end CHARACTERISTIC
/begin COMPU_METHOD CRI_P_slct8_COMPU_VTAB "Verbal Table" TAB_VERB "%.0" "list" COMPU_TAB_REF CRI_P_slct8_COMPU_VTAB_REF /end COMPU_METHOD
/begin COMPU_VTAB CRI_P_slct8_COMPU_VTAB_REF "Verbal Table" TAB_VERB 3 0 "Standard" 1 "Alternate 1" 2 "Alt 1 + Std" DEFAULT_VALUE "UNKNOWN" /end COMPU_VTAB
/begin CHARACTERISTIC CRI_dilpct_slct8 "EGR diluent command{CRI_dilpct_slct8&0xff=0:Standard}{CRI_dilpct_slct8&0xff=1:Alternate 1}{CRI_dilpct_slct8&0xff=2:Alt 1 + Std}" VALUE 0x001F19FE /* @ECU_Address@CRI_dilpct_slct8@0x0100A888@ */ ECIPP_ALIGNMENT_UBYTE 255 CRI_dilpct_slct8_COMPU_VTAB 0 255 BIT_MASK 0xff /end CHARACTERISTIC
/begin COMPU_METHOD CRI_dilpct_slct8_COMPU_VTAB "Verbal Table" TAB_VERB "%.0" "list" COMPU_TAB_REF CRI_dilpct_slct8_COMPU_VTAB_REF /end COMPU_METHOD
/begin COMPU_VTAB CRI_dilpct_slct8_COMPU_VTAB_REF "Verbal Table" TAB_VERB 3 0 "Standard" 1 "Alternate 1" 2 "Alt 1 + Std" DEFAULT_VALUE "UNKNOWN" /end COMPU_VTAB
/begin CHARACTERISTIC CRI_Qpilot2_slct8 "Pilot 2 injection quantity{CRI_Qpilot2_slct8&0xff=0:Standard}{CRI_Qpilot2_slct8&0xff=1:Alternate 1}{CRI_Qpilot2_slct8&0xff=2:Alt 1 + Std}" VALUE 0x001F1998 /* @ECU_Address@CRI_Qpilot2_slct8@0x0100A890@ */ ECIPP_ALIGNMENT_UBYTE 255 CRI_Qpilot2_slct8_COMPU_VTAB 0 255 BIT_MASK 0xff /end CHARACTERISTIC
/begin COMPU_METHOD CRI_Qpilot2_slct8_COMPU_VTAB "Verbal Table" TAB_VERB "%.0" "list" COMPU_TAB_REF CRI_Qpilot2_slct8_COMPU_VTAB_REF /end COMPU_METHOD
/begin COMPU_VTAB CRI_Qpilot2_slct8_COMPU_VTAB_REF "Verbal Table" TAB_VERB 3 0 "Standard" 1 "Alternate 1" 2 "Alt 1 + Std" DEFAULT_VALUE "UNKNOWN" /end COMPU_VTAB
/begin CHARACTERISTIC CRI_Qpilot1_slct8 "Pilot 1 injection quantity{CRI_Qpilot1_slct8&0xff=0:Standard}{CRI_Qpilot1_slct8&0xff=1:Alternate 1}{CRI_Qpilot1_slct8&0xff=2:Alt 1 + Std}" VALUE 0x001F198E /* @ECU_Address@CRI_Qpilot1_slct8@0x0100A898@ */ ECIPP_ALIGNMENT_UBYTE 255 CRI_Qpilot1_slct8_COMPU_VTAB 0 255 BIT_MASK 0xff /end CHARACTERISTIC
/begin COMPU_METHOD CRI_Qpilot1_slct8_COMPU_VTAB "Verbal Table" TAB_VERB "%.0" "list" COMPU_TAB_REF CRI_Qpilot1_slct8_COMPU_VTAB_REF /end COMPU_METHOD
/begin COMPU_VTAB CRI_Qpilot1_slct8_COMPU_VTAB_REF "Verbal Table" TAB_VERB 3 0 "Standard" 1 "Alternate 1" 2 "Alt 1 + Std" DEFAULT_VALUE "UNKNOWN" /end COMPU_VTAB
/begin CHARACTERISTIC CRI_Qload_slct8 "Fuel load command{CRI_Qload_slct8&0xff=0:Standard}{CRI_Qload_slct8&0xff=1:Alternate 1}{CRI_Qload_slct8&0xff=2:Alt 1 + Std}{CRI_Qload_slct8&0xff=3:Alternate 2}{CRI_Qload_slct8&0xff=4:Alt 2 + Std}" VALUE 0x001F1984 /* @ECU_Address@CRI_Qload_slct8@0x0100A8A0@ */ ECIPP_ALIGNMENT_UBYTE 255 CRI_Qload_slct8_COMPU_VTAB 0 255 BIT_MASK 0xff /end CHARACTERISTIC
/begin COMPU_METHOD CRI_Qload_slct8_COMPU_VTAB "Verbal Table" TAB_VERB "%.0" "list" COMPU_TAB_REF CRI_Qload_slct8_COMPU_VTAB_REF /end COMPU_METHOD
/begin COMPU_VTAB CRI_Qload_slct8_COMPU_VTAB_REF "Verbal Table" TAB_VERB 5 0 "Standard" 1 "Alternate 1" 2 "Alt 1 + Std" 3 "Alternate 2" 4 "Alt 2 + Std" DEFAULT_VALUE "UNKNOWN" /end COMPU_VTAB
/begin CHARACTERISTIC CRI_Qpost1_slct8 "Post 1 injection quantity{CRI_Qpost1_slct8&0xff=0:Standard}{CRI_Qpost1_slct8&0xff=1:Alternate 1}{CRI_Qpost1_slct8&0xff=2:Alt 1 + Std}" VALUE 0x001F19A2 /* @ECU_Address@CRI_Qpost1_slct8@0x0100A8A8@ */ ECIPP_ALIGNMENT_UBYTE 255 CRI_Qpost1_slct8_COMPU_VTAB 0 255 BIT_MASK 0xff /end CHARACTERISTIC
/begin COMPU_METHOD CRI_Qpost1_slct8_COMPU_VTAB "Verbal Table" TAB_VERB "%.0" "list" COMPU_TAB_REF CRI_Qpost1_slct8_COMPU_VTAB_REF /end COMPU_METHOD
/begin COMPU_VTAB CRI_Qpost1_slct8_COMPU_VTAB_REF "Verbal Table" TAB_VERB 3 0 "Standard" 1 "Alternate 1" 2 "Alt 1 + Std" DEFAULT_VALUE "UNKNOWN" /end COMPU_VTAB
/begin CHARACTERISTIC CRI_Qpost2_slct8 "Post 2 injection quantity{CRI_Qpost2_slct8&0xff=0:Standard}{CRI_Qpost2_slct8&0xff=1:Alternate 1}{CRI_Qpost2_slct8&0xff=2:Alt 1 + Std}" VALUE 0x001F19AC /* @ECU_Address@CRI_Qpost2_slct8@0x0100A8B0@ */ ECIPP_ALIGNMENT_UBYTE 255 CRI_Qpost2_slct8_COMPU_VTAB 0 255 BIT_MASK 0xff /end CHARACTERISTIC
/begin COMPU_METHOD CRI_Qpost2_slct8_COMPU_VTAB "Verbal Table" TAB_VERB "%.0" "list" COMPU_TAB_REF CRI_Qpost2_slct8_COMPU_VTAB_REF /end COMPU_METHOD
/begin COMPU_VTAB CRI_Qpost2_slct8_COMPU_VTAB_REF "Verbal Table" TAB_VERB 3 0 "Standard" 1 "Alternate 1" 2 "Alt 1 + Std" DEFAULT_VALUE "UNKNOWN" /end COMPU_VTAB
/begin CHARACTERISTIC CRI_Tpilot2_slct8 "Pilot 2 injection timing{CRI_Tpilot2_slct8&0xff=0:Standard}{CRI_Tpilot2_slct8&0xff=1:Alternate 1}{CRI_Tpilot2_slct8&0xff=2:Alt 1 + Std}" VALUE 0x001F19CB /* @ECU_Address@CRI_Tpilot2_slct8@0x0100A8B8@ */ ECIPP_ALIGNMENT_UBYTE 255 CRI_Tpilot2_slct8_COMPU_VTAB 0 255 BIT_MASK 0xff /end CHARACTERISTIC
/begin COMPU_METHOD CRI_Tpilot2_slct8_COMPU_VTAB "Verbal Table" TAB_VERB "%.0" "list" COMPU_TAB_REF CRI_Tpilot2_slct8_COMPU_VTAB_REF /end COMPU_METHOD
/begin COMPU_VTAB CRI_Tpilot2_slct8_COMPU_VTAB_REF "Verbal Table" TAB_VERB 3 0 "Standard" 1 "Alternate 1" 2 "Alt 1 + Std" DEFAULT_VALUE "UNKNOWN" /end COMPU_VTAB
/begin CHARACTERISTIC CRI_Tpilot1_slct8 "Pilot 1 injection timing{CRI_Tpilot1_slct8&0xff=0:Standard}{CRI_Tpilot1_slct8&0xff=1:Alternate 1}{CRI_Tpilot1_slct8&0xff=2:Alt 1 + Std}" VALUE 0x001F19C0 /* @ECU_Address@CRI_Tpilot1_slct8@0x0100A8C0@ */ ECIPP_ALIGNMENT_UBYTE 255 CRI_Tpilot1_slct8_COMPU_VTAB 0 255 BIT_MASK 0xff /end CHARACTERISTIC
/begin COMPU_METHOD CRI_Tpilot1_slct8_COMPU_VTAB "Verbal Table" TAB_VERB "%.0" "list" COMPU_TAB_REF CRI_Tpilot1_slct8_COMPU_VTAB_REF /end COMPU_METHOD
/begin COMPU_VTAB CRI_Tpilot1_slct8_COMPU_VTAB_REF "Verbal Table" TAB_VERB 3 0 "Standard" 1 "Alternate 1" 2 "Alt 1 + Std" DEFAULT_VALUE "UNKNOWN" /end COMPU_VTAB
/begin CHARACTERISTIC CRI_Tmain_slct8 "Main injection timing{CRI_Tmain_slct8&0xff=0:Standard}{CRI_Tmain_slct8&0xff=1:Alternate 1}{CRI_Tmain_slct8&0xff=2:Alt 1 + Std}{CRI_Tmain_slct8&0xff=3:Alternate 2}{CRI_Tmain_slct8&0xff=4:Alt 2 + Std}" VALUE 0x001F19B6 /* @ECU_Address@CRI_Tmain_slct8@0x0100A8C8@ */ ECIPP_ALIGNMENT_UBYTE 255 CRI_Tmain_slct8_COMPU_VTAB 0 255 BIT_MASK 0xff /end CHARACTERISTIC
/begin COMPU_METHOD CRI_Tmain_slct8_COMPU_VTAB "Verbal Table" TAB_VERB "%.0" "list" COMPU_TAB_REF CRI_Tmain_slct8_COMPU_VTAB_REF /end COMPU_METHOD
/begin COMPU_VTAB CRI_Tmain_slct8_COMPU_VTAB_REF "Verbal Table" TAB_VERB 5 0 "Standard" 1 "Alternate 1" 2 "Alt 1 + Std" 3 "Alternate 2" 4 "Alt 2 + Std" DEFAULT_VALUE "UNKNOWN" /end COMPU_VTAB
/begin CHARACTERISTIC CRI_Tpost1_slct8 "Post 1 injection timing{CRI_Tpost1_slct8&0xff=0:Standard}{CRI_Tpost1_slct8&0xff=1:Alternate 1}{CRI_Tpost1_slct8&0xff=2:Alt 1 + Std}" VALUE 0x001F19D6 /* @ECU_Address@CRI_Tpost1_slct8@0x0100A8D0@ */ ECIPP_ALIGNMENT_UBYTE 255 CRI_Tpost1_slct8_COMPU_VTAB 0 255 BIT_MASK 0xff /end CHARACTERISTIC
/begin COMPU_METHOD CRI_Tpost1_slct8_COMPU_VTAB "Verbal Table" TAB_VERB "%.0" "list" COMPU_TAB_REF CRI_Tpost1_slct8_COMPU_VTAB_REF /end COMPU_METHOD
/begin COMPU_VTAB CRI_Tpost1_slct8_COMPU_VTAB_REF "Verbal Table" TAB_VERB 3 0 "Standard" 1 "Alternate 1" 2 "Alt 1 + Std" DEFAULT_VALUE "UNKNOWN" /end COMPU_VTAB
/begin CHARACTERISTIC CRI_Tpost2_slct8 "Post 2 injection timing{CRI_Tpost2_slct8&0xff=0:Standard}{CRI_Tpost2_slct8&0xff=1:Alternate 1}{CRI_Tpost2_slct8&0xff=2:Alt 1 + Std}" VALUE 0x001F19E0 /* @ECU_Address@CRI_Tpost2_slct8@0x0100A8D8@ */ ECIPP_ALIGNMENT_UBYTE 255 CRI_Tpost2_slct8_COMPU_VTAB 0 255 BIT_MASK 0xff /end CHARACTERISTIC
/begin COMPU_METHOD CRI_Tpost2_slct8_COMPU_VTAB "Verbal Table" TAB_VERB "%.0" "list" COMPU_TAB_REF CRI_Tpost2_slct8_COMPU_VTAB_REF /end COMPU_METHOD
/begin COMPU_VTAB CRI_Tpost2_slct8_COMPU_VTAB_REF "Verbal Table" TAB_VERB 3 0 "Standard" 1 "Alternate 1" 2 "Alt 1 + Std" DEFAULT_VALUE "UNKNOWN" /end COMPU_VTAB
/begin CHARACTERISTIC CRI_pulseoff_slct8 "Forced injection disabling table{CRI_pulseoff_slct8&0xff=0:None}{CRI_pulseoff_slct8&0xff=1:Standard}{CRI_pulseoff_slct8&0xff=2:Alternate 1}{CRI_pulseoff_slct8&0xff=3:Alt 1 or Std}" VALUE 0x001F1A76 /* @ECU_Address@CRI_pulseoff_slct8@0x0100A8E0@ */ ECIPP_ALIGNMENT_UBYTE 255 CRI_pulseoff_slct8_COMPU_VTAB 0 255 BIT_MASK 0xff /end CHARACTERISTIC
/begin COMPU_METHOD CRI_pulseoff_slct8_COMPU_VTAB "Verbal Table" TAB_VERB "%.0" "list" COMPU_TAB_REF CRI_pulseoff_slct8_COMPU_VTAB_REF /end COMPU_METHOD
/begin COMPU_VTAB CRI_pulseoff_slct8_COMPU_VTAB_REF "Verbal Table" TAB_VERB 4 0 "None" 1 "Standard" 2 "Alternate 1" 3 "Alt 1 or Std" DEFAULT_VALUE "UNKNOWN" /end COMPU_VTAB
/begin CHARACTERISTIC CRI_bst_dP_slct8 "Boost EMP throttle delta-P command{CRI_bst_dP_slct8&0xff=0:Scalar (below)}{CRI_bst_dP_slct8&0xff=1:Boost 2D Cmd}" VALUE 0x001F19F4 /* @ECU_Address@CRI_bst_dP_slct8@0x0100A8E8@ */ ECIPP_ALIGNMENT_UBYTE 255 CRI_bst_dP_slct8_COMPU_VTAB 0 255 BIT_MASK 0xff /end CHARACTERISTIC
/begin COMPU_METHOD CRI_bst_dP_slct8_COMPU_VTAB "Verbal Table" TAB_VERB "%.0" "list" COMPU_TAB_REF CRI_bst_dP_slct8_COMPU_VTAB_REF /end COMPU_METHOD
/begin COMPU_VTAB CRI_bst_dP_slct8_COMPU_VTAB_REF "Verbal Table" TAB_VERB 2 0 "Scalar (below)" 1 "Boost 2D Cmd" DEFAULT_VALUE "UNKNOWN" /end COMPU_VTAB
/begin CHARACTERISTIC CRI_EGR_dP_slct8 "EGR minimum delta-P command{CRI_EGR_dP_slct8&0xff=0:Standard}{CRI_EGR_dP_slct8&0xff=1:Alternate 1}{CRI_EGR_dP_slct8&0xff=2:Alt 1 + Std}" VALUE 0x001F1970 /* @ECU_Address@CRI_EGR_dP_slct8@0x0100A8F0@ */ ECIPP_ALIGNMENT_UBYTE 255 CRI_EGR_dP_slct8_COMPU_VTAB 0 255 BIT_MASK 0xff /end CHARACTERISTIC
/begin COMPU_METHOD CRI_EGR_dP_slct8_COMPU_VTAB "Verbal Table" TAB_VERB "%.0" "list" COMPU_TAB_REF CRI_EGR_dP_slct8_COMPU_VTAB_REF /end COMPU_METHOD
/begin COMPU_VTAB CRI_EGR_dP_slct8_COMPU_VTAB_REF "Verbal Table" TAB_VERB 3 0 "Standard" 1 "Alternate 1" 2 "Alt 1 + Std" DEFAULT_VALUE "UNKNOWN" /end COMPU_VTAB
/begin CHARACTERISTIC CRI_air_slct9 "Air mass command{CRI_air_slct9&0xff=0:Standard}{CRI_air_slct9&0xff=1:Alternate 1}{CRI_air_slct9&0xff=2:Alt 1 + Std}" VALUE 0x001F19EB /* @ECU_Address@CRI_air_slct9@0x0100A8F8@ */ ECIPP_ALIGNMENT_UBYTE 255 CRI_air_slct9_COMPU_VTAB 0 255 BIT_MASK 0xff /end CHARACTERISTIC
/begin COMPU_METHOD CRI_air_slct9_COMPU_VTAB "Verbal Table" TAB_VERB "%.0" "list" COMPU_TAB_REF CRI_air_slct9_COMPU_VTAB_REF /end COMPU_METHOD
/begin COMPU_VTAB CRI_air_slct9_COMPU_VTAB_REF "Verbal Table" TAB_VERB 3 0 "Standard" 1 "Alternate 1" 2 "Alt 1 + Std" DEFAULT_VALUE "UNKNOWN" /end COMPU_VTAB
/begin CHARACTERISTIC CRI_P_slct9 "Fuel pressure command{CRI_P_slct9&0xff=0:Standard}{CRI_P_slct9&0xff=1:Alternate 1}{CRI_P_slct9&0xff=2:Alt 1 + Std}" VALUE 0x001F197B /* @ECU_Address@CRI_P_slct9@0x0100A900@ */ ECIPP_ALIGNMENT_UBYTE 255 CRI_P_slct9_COMPU_VTAB 0 255 BIT_MASK 0xff /end CHARACTERISTIC
/begin COMPU_METHOD CRI_P_slct9_COMPU_VTAB "Verbal Table" TAB_VERB "%.0" "list" COMPU_TAB_REF CRI_P_slct9_COMPU_VTAB_REF /end COMPU_METHOD
/begin COMPU_VTAB CRI_P_slct9_COMPU_VTAB_REF "Verbal Table" TAB_VERB 3 0 "Standard" 1 "Alternate 1" 2 "Alt 1 + Std" DEFAULT_VALUE "UNKNOWN" /end COMPU_VTAB
/begin CHARACTERISTIC CRI_dilpct_slct9 "EGR diluent command{CRI_dilpct_slct9&0xff=0:Standard}{CRI_dilpct_slct9&0xff=1:Alternate 1}{CRI_dilpct_slct9&0xff=2:Alt 1 + Std}" VALUE 0x001F19FF /* @ECU_Address@CRI_dilpct_slct9@0x0100A908@ */ ECIPP_ALIGNMENT_UBYTE 255 CRI_dilpct_slct9_COMPU_VTAB 0 255 BIT_MASK 0xff /end CHARACTERISTIC
/begin COMPU_METHOD CRI_dilpct_slct9_COMPU_VTAB "Verbal Table" TAB_VERB "%.0" "list" COMPU_TAB_REF CRI_dilpct_slct9_COMPU_VTAB_REF /end COMPU_METHOD
/begin COMPU_VTAB CRI_dilpct_slct9_COMPU_VTAB_REF "Verbal Table" TAB_VERB 3 0 "Standard" 1 "Alternate 1" 2 "Alt 1 + Std" DEFAULT_VALUE "UNKNOWN" /end COMPU_VTAB
/begin CHARACTERISTIC CRI_Qpilot2_slct9 "Pilot 2 injection quantity{CRI_Qpilot2_slct9&0xff=0:Standard}{CRI_Qpilot2_slct9&0xff=1:Alternate 1}{CRI_Qpilot2_slct9&0xff=2:Alt 1 + Std}" VALUE 0x001F1999 /* @ECU_Address@CRI_Qpilot2_slct9@0x0100A910@ */ ECIPP_ALIGNMENT_UBYTE 255 CRI_Qpilot2_slct9_COMPU_VTAB 0 255 BIT_MASK 0xff /end CHARACTERISTIC
/begin COMPU_METHOD CRI_Qpilot2_slct9_COMPU_VTAB "Verbal Table" TAB_VERB "%.0" "list" COMPU_TAB_REF CRI_Qpilot2_slct9_COMPU_VTAB_REF /end COMPU_METHOD
/begin COMPU_VTAB CRI_Qpilot2_slct9_COMPU_VTAB_REF "Verbal Table" TAB_VERB 3 0 "Standard" 1 "Alternate 1" 2 "Alt 1 + Std" DEFAULT_VALUE "UNKNOWN" /end COMPU_VTAB
/begin CHARACTERISTIC CRI_Qpilot1_slct9 "Pilot 1 injection quantity{CRI_Qpilot1_slct9&0xff=0:Standard}{CRI_Qpilot1_slct9&0xff=1:Alternate 1}{CRI_Qpilot1_slct9&0xff=2:Alt 1 + Std}" VALUE 0x001F198F /* @ECU_Address@CRI_Qpilot1_slct9@0x0100A918@ */ ECIPP_ALIGNMENT_UBYTE 255 CRI_Qpilot1_slct9_COMPU_VTAB 0 255 BIT_MASK 0xff /end CHARACTERISTIC
/begin COMPU_METHOD CRI_Qpilot1_slct9_COMPU_VTAB "Verbal Table" TAB_VERB "%.0" "list" COMPU_TAB_REF CRI_Qpilot1_slct9_COMPU_VTAB_REF /end COMPU_METHOD
/begin COMPU_VTAB CRI_Qpilot1_slct9_COMPU_VTAB_REF "Verbal Table" TAB_VERB 3 0 "Standard" 1 "Alternate 1" 2 "Alt 1 + Std" DEFAULT_VALUE "UNKNOWN" /end COMPU_VTAB
/begin CHARACTERISTIC CRI_Qload_slct9 "Fuel load command{CRI_Qload_slct9&0xff=0:Standard}{CRI_Qload_slct9&0xff=1:Alternate 1}{CRI_Qload_slct9&0xff=2:Alt 1 + Std}{CRI_Qload_slct9&0xff=3:Alternate 2}{CRI_Qload_slct9&0xff=4:Alt 2 + Std}" VALUE 0x001F1985 /* @ECU_Address@CRI_Qload_slct9@0x0100A920@ */ ECIPP_ALIGNMENT_UBYTE 255 CRI_Qload_slct9_COMPU_VTAB 0 255 BIT_MASK 0xff /end CHARACTERISTIC
/begin COMPU_METHOD CRI_Qload_slct9_COMPU_VTAB "Verbal Table" TAB_VERB "%.0" "list" COMPU_TAB_REF CRI_Qload_slct9_COMPU_VTAB_REF /end COMPU_METHOD
/begin COMPU_VTAB CRI_Qload_slct9_COMPU_VTAB_REF "Verbal Table" TAB_VERB 5 0 "Standard" 1 "Alternate 1" 2 "Alt 1 + Std" 3 "Alternate 2" 4 "Alt 2 + Std" DEFAULT_VALUE "UNKNOWN" /end COMPU_VTAB
/begin CHARACTERISTIC CRI_Qpost1_slct9 "Post 1 injection quantity{CRI_Qpost1_slct9&0xff=0:Standard}{CRI_Qpost1_slct9&0xff=1:Alternate 1}{CRI_Qpost1_slct9&0xff=2:Alt 1 + Std}" VALUE 0x001F19A3 /* @ECU_Address@CRI_Qpost1_slct9@0x0100A928@ */ ECIPP_ALIGNMENT_UBYTE 255 CRI_Qpost1_slct9_COMPU_VTAB 0 255 BIT_MASK 0xff /end CHARACTERISTIC
/begin COMPU_METHOD CRI_Qpost1_slct9_COMPU_VTAB "Verbal Table" TAB_VERB "%.0" "list" COMPU_TAB_REF CRI_Qpost1_slct9_COMPU_VTAB_REF /end COMPU_METHOD
/begin COMPU_VTAB CRI_Qpost1_slct9_COMPU_VTAB_REF "Verbal Table" TAB_VERB 3 0 "Standard" 1 "Alternate 1" 2 "Alt 1 + Std" DEFAULT_VALUE "UNKNOWN" /end COMPU_VTAB
/begin CHARACTERISTIC CRI_Qpost2_slct9 "Post 2 injection quantity{CRI_Qpost2_slct9&0xff=0:Standard}{CRI_Qpost2_slct9&0xff=1:Alternate 1}{CRI_Qpost2_slct9&0xff=2:Alt 1 + Std}" VALUE 0x001F19AD /* @ECU_Address@CRI_Qpost2_slct9@0x0100A930@ */ ECIPP_ALIGNMENT_UBYTE 255 CRI_Qpost2_slct9_COMPU_VTAB 0 255 BIT_MASK 0xff /end CHARACTERISTIC
/begin COMPU_METHOD CRI_Qpost2_slct9_COMPU_VTAB "Verbal Table" TAB_VERB "%.0" "list" COMPU_TAB_REF CRI_Qpost2_slct9_COMPU_VTAB_REF /end COMPU_METHOD
/begin COMPU_VTAB CRI_Qpost2_slct9_COMPU_VTAB_REF "Verbal Table" TAB_VERB 3 0 "Standard" 1 "Alternate 1" 2 "Alt 1 + Std" DEFAULT_VALUE "UNKNOWN" /end COMPU_VTAB
/begin CHARACTERISTIC CRI_Tpilot2_slct9 "Pilot 2 injection timing{CRI_Tpilot2_slct9&0xff=0:Standard}{CRI_Tpilot2_slct9&0xff=1:Alternate 1}{CRI_Tpilot2_slct9&0xff=2:Alt 1 + Std}" VALUE 0x001F19CC /* @ECU_Address@CRI_Tpilot2_slct9@0x0100A938@ */ ECIPP_ALIGNMENT_UBYTE 255 CRI_Tpilot2_slct9_COMPU_VTAB 0 255 BIT_MASK 0xff /end CHARACTERISTIC
/begin COMPU_METHOD CRI_Tpilot2_slct9_COMPU_VTAB "Verbal Table" TAB_VERB "%.0" "list" COMPU_TAB_REF CRI_Tpilot2_slct9_COMPU_VTAB_REF /end COMPU_METHOD
/begin COMPU_VTAB CRI_Tpilot2_slct9_COMPU_VTAB_REF "Verbal Table" TAB_VERB 3 0 "Standard" 1 "Alternate 1" 2 "Alt 1 + Std" DEFAULT_VALUE "UNKNOWN" /end COMPU_VTAB
/begin CHARACTERISTIC CRI_Tpilot1_slct9 "Pilot 1 injection timing{CRI_Tpilot1_slct9&0xff=0:Standard}{CRI_Tpilot1_slct9&0xff=1:Alternate 1}{CRI_Tpilot1_slct9&0xff=2:Alt 1 + Std}" VALUE 0x001F19C1 /* @ECU_Address@CRI_Tpilot1_slct9@0x0100A940@ */ ECIPP_ALIGNMENT_UBYTE 255 CRI_Tpilot1_slct9_COMPU_VTAB 0 255 BIT_MASK 0xff /end CHARACTERISTIC
/begin COMPU_METHOD CRI_Tpilot1_slct9_COMPU_VTAB "Verbal Table" TAB_VERB "%.0" "list" COMPU_TAB_REF CRI_Tpilot1_slct9_COMPU_VTAB_REF /end COMPU_METHOD
/begin COMPU_VTAB CRI_Tpilot1_slct9_COMPU_VTAB_REF "Verbal Table" TAB_VERB 3 0 "Standard" 1 "Alternate 1" 2 "Alt 1 + Std" DEFAULT_VALUE "UNKNOWN" /end COMPU_VTAB
/begin CHARACTERISTIC CRI_Tmain_slct9 "Main injection timing{CRI_Tmain_slct9&0xff=0:Standard}{CRI_Tmain_slct9&0xff=1:Alternate 1}{CRI_Tmain_slct9&0xff=2:Alt 1 + Std}{CRI_Tmain_slct9&0xff=3:Alternate 2}{CRI_Tmain_slct9&0xff=4:Alt 2 + Std}" VALUE 0x001F19B7 /* @ECU_Address@CRI_Tmain_slct9@0x0100A948@ */ ECIPP_ALIGNMENT_UBYTE 255 CRI_Tmain_slct9_COMPU_VTAB 0 255 BIT_MASK 0xff /end CHARACTERISTIC
/begin COMPU_METHOD CRI_Tmain_slct9_COMPU_VTAB "Verbal Table" TAB_VERB "%.0" "list" COMPU_TAB_REF CRI_Tmain_slct9_COMPU_VTAB_REF /end COMPU_METHOD
/begin COMPU_VTAB CRI_Tmain_slct9_COMPU_VTAB_REF "Verbal Table" TAB_VERB 5 0 "Standard" 1 "Alternate 1" 2 "Alt 1 + Std" 3 "Alternate 2" 4 "Alt 2 + Std" DEFAULT_VALUE "UNKNOWN" /end COMPU_VTAB
/begin CHARACTERISTIC CRI_Tpost1_slct9 "Post 1 injection timing{CRI_Tpost1_slct9&0xff=0:Standard}{CRI_Tpost1_slct9&0xff=1:Alternate 1}{CRI_Tpost1_slct9&0xff=2:Alt 1 + Std}" VALUE 0x001F19D7 /* @ECU_Address@CRI_Tpost1_slct9@0x0100A950@ */ ECIPP_ALIGNMENT_UBYTE 255 CRI_Tpost1_slct9_COMPU_VTAB 0 255 BIT_MASK 0xff /end CHARACTERISTIC
/begin COMPU_METHOD CRI_Tpost1_slct9_COMPU_VTAB "Verbal Table" TAB_VERB "%.0" "list" COMPU_TAB_REF CRI_Tpost1_slct9_COMPU_VTAB_REF /end COMPU_METHOD
/begin COMPU_VTAB CRI_Tpost1_slct9_COMPU_VTAB_REF "Verbal Table" TAB_VERB 3 0 "Standard" 1 "Alternate 1" 2 "Alt 1 + Std" DEFAULT_VALUE "UNKNOWN" /end COMPU_VTAB
/begin CHARACTERISTIC CRI_Tpost2_slct9 "Post 2 injection timing{CRI_Tpost2_slct9&0xff=0:Standard}{CRI_Tpost2_slct9&0xff=1:Alternate 1}{CRI_Tpost2_slct9&0xff=2:Alt 1 + Std}" VALUE 0x001F19E1 /* @ECU_Address@CRI_Tpost2_slct9@0x0100A958@ */ ECIPP_ALIGNMENT_UBYTE 255 CRI_Tpost2_slct9_COMPU_VTAB 0 255 BIT_MASK 0xff /end CHARACTERISTIC
/begin COMPU_METHOD CRI_Tpost2_slct9_COMPU_VTAB "Verbal Table" TAB_VERB "%.0" "list" COMPU_TAB_REF CRI_Tpost2_slct9_COMPU_VTAB_REF /end COMPU_METHOD
/begin COMPU_VTAB CRI_Tpost2_slct9_COMPU_VTAB_REF "Verbal Table" TAB_VERB 3 0 "Standard" 1 "Alternate 1" 2 "Alt 1 + Std" DEFAULT_VALUE "UNKNOWN" /end COMPU_VTAB
/begin CHARACTERISTIC CRI_pulseoff_slct9 "Forced injection disabling table{CRI_pulseoff_slct9&0xff=0:None}{CRI_pulseoff_slct9&0xff=1:Standard}{CRI_pulseoff_slct9&0xff=2:Alternate 1}{CRI_pulseoff_slct9&0xff=3:Alt 1 or Std}" VALUE 0x001F1A77 /* @ECU_Address@CRI_pulseoff_slct9@0x0100A960@ */ ECIPP_ALIGNMENT_UBYTE 255 CRI_pulseoff_slct9_COMPU_VTAB 0 255 BIT_MASK 0xff /end CHARACTERISTIC
/begin COMPU_METHOD CRI_pulseoff_slct9_COMPU_VTAB "Verbal Table" TAB_VERB "%.0" "list" COMPU_TAB_REF CRI_pulseoff_slct9_COMPU_VTAB_REF /end COMPU_METHOD
/begin COMPU_VTAB CRI_pulseoff_slct9_COMPU_VTAB_REF "Verbal Table" TAB_VERB 4 0 "None" 1 "Standard" 2 "Alternate 1" 3 "Alt 1 or Std" DEFAULT_VALUE "UNKNOWN" /end COMPU_VTAB
/begin CHARACTERISTIC CRI_bst_dP_slct9 "Boost EMP throttle delta-P command{CRI_bst_dP_slct9&0xff=0:Scalar (below)}{CRI_bst_dP_slct9&0xff=1:Boost 2D Cmd}" VALUE 0x001F19F5 /* @ECU_Address@CRI_bst_dP_slct9@0x0100A968@ */ ECIPP_ALIGNMENT_UBYTE 255 CRI_bst_dP_slct9_COMPU_VTAB 0 255 BIT_MASK 0xff /end CHARACTERISTIC
/begin COMPU_METHOD CRI_bst_dP_slct9_COMPU_VTAB "Verbal Table" TAB_VERB "%.0" "list" COMPU_TAB_REF CRI_bst_dP_slct9_COMPU_VTAB_REF /end COMPU_METHOD
/begin COMPU_VTAB CRI_bst_dP_slct9_COMPU_VTAB_REF "Verbal Table" TAB_VERB 2 0 "Scalar (below)" 1 "Boost 2D Cmd" DEFAULT_VALUE "UNKNOWN" /end COMPU_VTAB
/begin CHARACTERISTIC CRI_EGR_dP_slct9 "EGR minimum delta-P command{CRI_EGR_dP_slct9&0xff=0:Standard}{CRI_EGR_dP_slct9&0xff=1:Alternate 1}{CRI_EGR_dP_slct9&0xff=2:Alt 1 + Std}" VALUE 0x001F1971 /* @ECU_Address@CRI_EGR_dP_slct9@0x0100A970@ */ ECIPP_ALIGNMENT_UBYTE 255 CRI_EGR_dP_slct9_COMPU_VTAB 0 255 BIT_MASK 0xff /end CHARACTERISTIC
/begin COMPU_METHOD CRI_EGR_dP_slct9_COMPU_VTAB "Verbal Table" TAB_VERB "%.0" "list" COMPU_TAB_REF CRI_EGR_dP_slct9_COMPU_VTAB_REF /end COMPU_METHOD
/begin COMPU_VTAB CRI_EGR_dP_slct9_COMPU_VTAB_REF "Verbal Table" TAB_VERB 3 0 "Standard" 1 "Alternate 1" 2 "Alt 1 + Std" DEFAULT_VALUE "UNKNOWN" /end COMPU_VTAB
/begin CHARACTERISTIC CRI_bst_dP_scalar1 "Boost EMP throttle delta-P scalar" VALUE 0x001F18B6 /* @ECU_Address@CRI_bst_dP_scalar1@0x0100A978@ */ ECIPP_ALIGNMENT_UWORD 256 Compu_CRI_bst_dP_scalar1 0 255.99609375 /end CHARACTERISTIC
/begin COMPU_METHOD Compu_CRI_bst_dP_scalar1 " " RAT_FUNC "%.2" "psi" COEFFS 0 256 0 0 0 1 /end COMPU_METHOD
/begin CHARACTERISTIC CRI_bst_dP_scalar2 "Boost EMP throttle delta-P scalar" VALUE 0x001F18B8 /* @ECU_Address@CRI_bst_dP_scalar2@0x0100A980@ */ ECIPP_ALIGNMENT_UWORD 256 Compu_CRI_bst_dP_scalar2 0 255.99609375 /end CHARACTERISTIC
/begin COMPU_METHOD Compu_CRI_bst_dP_scalar2 " " RAT_FUNC "%.2" "psi" COEFFS 0 256 0 0 0 1 /end COMPU_METHOD
/begin CHARACTERISTIC CRI_bst_dP_scalar3 "Boost EMP throttle delta-P scalar" VALUE 0x001F18BA /* @ECU_Address@CRI_bst_dP_scalar3@0x0100A988@ */ ECIPP_ALIGNMENT_UWORD 256 Compu_CRI_bst_dP_scalar3 0 255.99609375 /end CHARACTERISTIC
/begin COMPU_METHOD Compu_CRI_bst_dP_scalar3 " " RAT_FUNC "%.2" "psi" COEFFS 0 256 0 0 0 1 /end COMPU_METHOD
/begin CHARACTERISTIC CRI_bst_dP_scalar4 "Boost EMP throttle delta-P scalar" VALUE 0x001F18BC /* @ECU_Address@CRI_bst_dP_scalar4@0x0100A990@ */ ECIPP_ALIGNMENT_UWORD 256 Compu_CRI_bst_dP_scalar4 0 255.99609375 /end CHARACTERISTIC
/begin COMPU_METHOD Compu_CRI_bst_dP_scalar4 " " RAT_FUNC "%.2" "psi" COEFFS 0 256 0 0 0 1 /end COMPU_METHOD
/begin CHARACTERISTIC CRI_bst_dP_scalar5 "Boost EMP throttle delta-P scalar" VALUE 0x001F18BE /* @ECU_Address@CRI_bst_dP_scalar5@0x0100A998@ */ ECIPP_ALIGNMENT_UWORD 256 Compu_CRI_bst_dP_scalar5 0 255.99609375 /end CHARACTERISTIC
/begin COMPU_METHOD Compu_CRI_bst_dP_scalar5 " " RAT_FUNC "%.2" "psi" COEFFS 0 256 0 0 0 1 /end COMPU_METHOD
/begin CHARACTERISTIC CRI_bst_dP_scalar6 "Boost EMP throttle delta-P scalar" VALUE 0x001F18C0 /* @ECU_Address@CRI_bst_dP_scalar6@0x0100A9A0@ */ ECIPP_ALIGNMENT_UWORD 256 Compu_CRI_bst_dP_scalar6 0 255.99609375 /end CHARACTERISTIC
/begin COMPU_METHOD Compu_CRI_bst_dP_scalar6 " " RAT_FUNC "%.2" "psi" COEFFS 0 256 0 0 0 1 /end COMPU_METHOD
/begin CHARACTERISTIC CRI_bst_dP_scalar7 "Boost EMP throttle delta-P scalar" VALUE 0x001F18C2 /* @ECU_Address@CRI_bst_dP_scalar7@0x0100A9A8@ */ ECIPP_ALIGNMENT_UWORD 256 Compu_CRI_bst_dP_scalar7 0 255.99609375 /end CHARACTERISTIC
/begin COMPU_METHOD Compu_CRI_bst_dP_scalar7 " " RAT_FUNC "%.2" "psi" COEFFS 0 256 0 0 0 1 /end COMPU_METHOD
/begin CHARACTERISTIC CRI_bst_dP_scalar8 "Boost EMP throttle delta-P scalar" VALUE 0x001F18C4 /* @ECU_Address@CRI_bst_dP_scalar8@0x0100A9B0@ */ ECIPP_ALIGNMENT_UWORD 256 Compu_CRI_bst_dP_scalar8 0 255.99609375 /end CHARACTERISTIC
/begin COMPU_METHOD Compu_CRI_bst_dP_scalar8 " " RAT_FUNC "%.2" "psi" COEFFS 0 256 0 0 0 1 /end COMPU_METHOD
/begin CHARACTERISTIC CRI_bst_dP_scalar9 "Boost EMP throttle delta-P scalar" VALUE 0x001F18C6 /* @ECU_Address@CRI_bst_dP_scalar9@0x0100A9B8@ */ ECIPP_ALIGNMENT_UWORD 256 Compu_CRI_bst_dP_scalar9 0 255.99609375 /end CHARACTERISTIC
/begin COMPU_METHOD Compu_CRI_bst_dP_scalar9 " " RAT_FUNC "%.2" "psi" COEFFS 0 256 0 0 0 1 /end COMPU_METHOD
/begin CHARACTERISTIC CRI_pilot1_priority1 "Pilot 1/2 conflict priority{CRI_pilot1_priority1&0xff=0:Pilot 1}{CRI_pilot1_priority1&0xff=1:Pilot 2}" VALUE 0x001F1A65 /* @ECU_Address@CRI_pilot1_priority1@0x0100A9C0@ */ ECIPP_ALIGNMENT_UBYTE 255 CRI_pilot1_priority1_COMPU_VTAB 0 255 BIT_MASK 0xff /end CHARACTERISTIC
/begin COMPU_METHOD CRI_pilot1_priority1_COMPU_VTAB "Verbal Table" TAB_VERB "%.0" "list" COMPU_TAB_REF CRI_pilot1_priority1_COMPU_VTAB_REF /end COMPU_METHOD
/begin COMPU_VTAB CRI_pilot1_priority1_COMPU_VTAB_REF "Verbal Table" TAB_VERB 2 0 "Pilot 1" 1 "Pilot 2" DEFAULT_VALUE "UNKNOWN" /end COMPU_VTAB
/begin CHARACTERISTIC CRI_pilot1_priority2 "Pilot 1/2 conflict priority{CRI_pilot1_priority2&0xff=0:Pilot 1}{CRI_pilot1_priority2&0xff=1:Pilot 2}" VALUE 0x001F1A66 /* @ECU_Address@CRI_pilot1_priority2@0x0100A9C8@ */ ECIPP_ALIGNMENT_UBYTE 255 CRI_pilot1_priority2_COMPU_VTAB 0 255 BIT_MASK 0xff /end CHARACTERISTIC
/begin COMPU_METHOD CRI_pilot1_priority2_COMPU_VTAB "Verbal Table" TAB_VERB "%.0" "list" COMPU_TAB_REF CRI_pilot1_priority2_COMPU_VTAB_REF /end COMPU_METHOD
/begin COMPU_VTAB CRI_pilot1_priority2_COMPU_VTAB_REF "Verbal Table" TAB_VERB 2 0 "Pilot 1" 1 "Pilot 2" DEFAULT_VALUE "UNKNOWN" /end COMPU_VTAB
/begin CHARACTERISTIC CRI_pilot1_priority3 "Pilot 1/2 conflict priority{CRI_pilot1_priority3&0xff=0:Pilot 1}{CRI_pilot1_priority3&0xff=1:Pilot 2}" VALUE 0x001F1A67 /* @ECU_Address@CRI_pilot1_priority3@0x0100A9D0@ */ ECIPP_ALIGNMENT_UBYTE 255 CRI_pilot1_priority3_COMPU_VTAB 0 255 BIT_MASK 0xff /end CHARACTERISTIC
/begin COMPU_METHOD CRI_pilot1_priority3_COMPU_VTAB "Verbal Table" TAB_VERB "%.0" "list" COMPU_TAB_REF CRI_pilot1_priority3_COMPU_VTAB_REF /end COMPU_METHOD
/begin COMPU_VTAB CRI_pilot1_priority3_COMPU_VTAB_REF "Verbal Table" TAB_VERB 2 0 "Pilot 1" 1 "Pilot 2" DEFAULT_VALUE "UNKNOWN" /end COMPU_VTAB
/begin CHARACTERISTIC CRI_pilot1_priority4 "Pilot 1/2 conflict priority{CRI_pilot1_priority4&0xff=0:Pilot 1}{CRI_pilot1_priority4&0xff=1:Pilot 2}" VALUE 0x001F1A68 /* @ECU_Address@CRI_pilot1_priority4@0x0100A9D8@ */ ECIPP_ALIGNMENT_UBYTE 255 CRI_pilot1_priority4_COMPU_VTAB 0 255 BIT_MASK 0xff /end CHARACTERISTIC
/begin COMPU_METHOD CRI_pilot1_priority4_COMPU_VTAB "Verbal Table" TAB_VERB "%.0" "list" COMPU_TAB_REF CRI_pilot1_priority4_COMPU_VTAB_REF /end COMPU_METHOD
/begin COMPU_VTAB CRI_pilot1_priority4_COMPU_VTAB_REF "Verbal Table" TAB_VERB 2 0 "Pilot 1" 1 "Pilot 2" DEFAULT_VALUE "UNKNOWN" /end COMPU_VTAB
/begin CHARACTERISTIC CRI_pilot1_priority5 "Pilot 1/2 conflict priority{CRI_pilot1_priority5&0xff=0:Pilot 1}{CRI_pilot1_priority5&0xff=1:Pilot 2}" VALUE 0x001F1A69 /* @ECU_Address@CRI_pilot1_priority5@0x0100A9E0@ */ ECIPP_ALIGNMENT_UBYTE 255 CRI_pilot1_priority5_COMPU_VTAB 0 255 BIT_MASK 0xff /end CHARACTERISTIC
/begin COMPU_METHOD CRI_pilot1_priority5_COMPU_VTAB "Verbal Table" TAB_VERB "%.0" "list" COMPU_TAB_REF CRI_pilot1_priority5_COMPU_VTAB_REF /end COMPU_METHOD
/begin COMPU_VTAB CRI_pilot1_priority5_COMPU_VTAB_REF "Verbal Table" TAB_VERB 2 0 "Pilot 1" 1 "Pilot 2" DEFAULT_VALUE "UNKNOWN" /end COMPU_VTAB
/begin CHARACTERISTIC CRI_pilot1_priority6 "Pilot 1/2 conflict priority{CRI_pilot1_priority6&0xff=0:Pilot 1}{CRI_pilot1_priority6&0xff=1:Pilot 2}" VALUE 0x001F1A6A /* @ECU_Address@CRI_pilot1_priority6@0x0100A9E8@ */ ECIPP_ALIGNMENT_UBYTE 255 CRI_pilot1_priority6_COMPU_VTAB 0 255 BIT_MASK 0xff /end CHARACTERISTIC
/begin COMPU_METHOD CRI_pilot1_priority6_COMPU_VTAB "Verbal Table" TAB_VERB "%.0" "list" COMPU_TAB_REF CRI_pilot1_priority6_COMPU_VTAB_REF /end COMPU_METHOD
/begin COMPU_VTAB CRI_pilot1_priority6_COMPU_VTAB_REF "Verbal Table" TAB_VERB 2 0 "Pilot 1" 1 "Pilot 2" DEFAULT_VALUE "UNKNOWN" /end COMPU_VTAB
/begin CHARACTERISTIC CRI_pilot1_priority7 "Pilot 1/2 conflict priority{CRI_pilot1_priority7&0xff=0:Pilot 1}{CRI_pilot1_priority7&0xff=1:Pilot 2}" VALUE 0x001F1A6B /* @ECU_Address@CRI_pilot1_priority7@0x0100A9F0@ */ ECIPP_ALIGNMENT_UBYTE 255 CRI_pilot1_priority7_COMPU_VTAB 0 255 BIT_MASK 0xff /end CHARACTERISTIC
/begin COMPU_METHOD CRI_pilot1_priority7_COMPU_VTAB "Verbal Table" TAB_VERB "%.0" "list" COMPU_TAB_REF CRI_pilot1_priority7_COMPU_VTAB_REF /end COMPU_METHOD
/begin COMPU_VTAB CRI_pilot1_priority7_COMPU_VTAB_REF "Verbal Table" TAB_VERB 2 0 "Pilot 1" 1 "Pilot 2" DEFAULT_VALUE "UNKNOWN" /end COMPU_VTAB
/begin CHARACTERISTIC CRI_pilot1_priority8 "Pilot 1/2 conflict priority{CRI_pilot1_priority8&0xff=0:Pilot 1}{CRI_pilot1_priority8&0xff=1:Pilot 2}" VALUE 0x001F1A6C /* @ECU_Address@CRI_pilot1_priority8@0x0100A9F8@ */ ECIPP_ALIGNMENT_UBYTE 255 CRI_pilot1_priority8_COMPU_VTAB 0 255 BIT_MASK 0xff /end CHARACTERISTIC
/begin COMPU_METHOD CRI_pilot1_priority8_COMPU_VTAB "Verbal Table" TAB_VERB "%.0" "list" COMPU_TAB_REF CRI_pilot1_priority8_COMPU_VTAB_REF /end COMPU_METHOD
/begin COMPU_VTAB CRI_pilot1_priority8_COMPU_VTAB_REF "Verbal Table" TAB_VERB 2 0 "Pilot 1" 1 "Pilot 2" DEFAULT_VALUE "UNKNOWN" /end COMPU_VTAB
/begin CHARACTERISTIC CRI_pilot1_priority9 "Pilot 1/2 conflict priority{CRI_pilot1_priority9&0xff=0:Pilot 1}{CRI_pilot1_priority9&0xff=1:Pilot 2}" VALUE 0x001F1A6D /* @ECU_Address@CRI_pilot1_priority9@0x0100AA00@ */ ECIPP_ALIGNMENT_UBYTE 255 CRI_pilot1_priority9_COMPU_VTAB 0 255 BIT_MASK 0xff /end CHARACTERISTIC
/begin COMPU_METHOD CRI_pilot1_priority9_COMPU_VTAB "Verbal Table" TAB_VERB "%.0" "list" COMPU_TAB_REF CRI_pilot1_priority9_COMPU_VTAB_REF /end COMPU_METHOD
/begin COMPU_VTAB CRI_pilot1_priority9_COMPU_VTAB_REF "Verbal Table" TAB_VERB 2 0 "Pilot 1" 1 "Pilot 2" DEFAULT_VALUE "UNKNOWN" /end COMPU_VTAB
/begin CHARACTERISTIC CRI_DOC_Tcl_slct0 "DOC closed-loop T control{CRI_DOC_Tcl_slct0&0xff=0:Disabled}{CRI_DOC_Tcl_slct0&0xff=1:Standard}{CRI_DOC_Tcl_slct0&0xff=2:Alternate 1}{CRI_DOC_Tcl_slct0&0xff=3:Alt 1 + Std}" VALUE 0x001F195E /* @ECU_Address@CRI_DOC_Tcl_slct0@0x0100AA08@ */ ECIPP_ALIGNMENT_UBYTE 255 CRI_DOC_Tcl_slct0_COMPU_VTAB 0 255 BIT_MASK 0xff /end CHARACTERISTIC
/begin COMPU_METHOD CRI_DOC_Tcl_slct0_COMPU_VTAB "Verbal Table" TAB_VERB "%.0" "list" COMPU_TAB_REF CRI_DOC_Tcl_slct0_COMPU_VTAB_REF /end COMPU_METHOD
/begin COMPU_VTAB CRI_DOC_Tcl_slct0_COMPU_VTAB_REF "Verbal Table" TAB_VERB 4 0 "Disabled" 1 "Standard" 2 "Alternate 1" 3 "Alt 1 + Std" DEFAULT_VALUE "UNKNOWN" /end COMPU_VTAB
/begin CHARACTERISTIC CRI_DOC_Tcl_slct1 "DOC closed-loop T control{CRI_DOC_Tcl_slct1&0xff=0:Disabled}{CRI_DOC_Tcl_slct1&0xff=1:Standard}{CRI_DOC_Tcl_slct1&0xff=2:Alternate 1}{CRI_DOC_Tcl_slct1&0xff=3:Alt 1 + Std}" VALUE 0x001F195F /* @ECU_Address@CRI_DOC_Tcl_slct1@0x0100AA10@ */ ECIPP_ALIGNMENT_UBYTE 255 CRI_DOC_Tcl_slct1_COMPU_VTAB 0 255 BIT_MASK 0xff /end CHARACTERISTIC
/begin COMPU_METHOD CRI_DOC_Tcl_slct1_COMPU_VTAB "Verbal Table" TAB_VERB "%.0" "list" COMPU_TAB_REF CRI_DOC_Tcl_slct1_COMPU_VTAB_REF /end COMPU_METHOD
/begin COMPU_VTAB CRI_DOC_Tcl_slct1_COMPU_VTAB_REF "Verbal Table" TAB_VERB 4 0 "Disabled" 1 "Standard" 2 "Alternate 1" 3 "Alt 1 + Std" DEFAULT_VALUE "UNKNOWN" /end COMPU_VTAB
/begin CHARACTERISTIC CRI_DOC_Tcl_slct2 "DOC closed-loop T control{CRI_DOC_Tcl_slct2&0xff=0:Disabled}{CRI_DOC_Tcl_slct2&0xff=1:Standard}{CRI_DOC_Tcl_slct2&0xff=2:Alternate 1}{CRI_DOC_Tcl_slct2&0xff=3:Alt 1 + Std}" VALUE 0x001F1960 /* @ECU_Address@CRI_DOC_Tcl_slct2@0x0100AA18@ */ ECIPP_ALIGNMENT_UBYTE 255 CRI_DOC_Tcl_slct2_COMPU_VTAB 0 255 BIT_MASK 0xff /end CHARACTERISTIC
/begin COMPU_METHOD CRI_DOC_Tcl_slct2_COMPU_VTAB "Verbal Table" TAB_VERB "%.0" "list" COMPU_TAB_REF CRI_DOC_Tcl_slct2_COMPU_VTAB_REF /end COMPU_METHOD
/begin COMPU_VTAB CRI_DOC_Tcl_slct2_COMPU_VTAB_REF "Verbal Table" TAB_VERB 4 0 "Disabled" 1 "Standard" 2 "Alternate 1" 3 "Alt 1 + Std" DEFAULT_VALUE "UNKNOWN" /end COMPU_VTAB
/begin CHARACTERISTIC CRI_DOC_Tcl_slct3 "DOC closed-loop T control{CRI_DOC_Tcl_slct3&0xff=0:Disabled}{CRI_DOC_Tcl_slct3&0xff=1:Standard}{CRI_DOC_Tcl_slct3&0xff=2:Alternate 1}{CRI_DOC_Tcl_slct3&0xff=3:Alt 1 + Std}" VALUE 0x001F1961 /* @ECU_Address@CRI_DOC_Tcl_slct3@0x0100AA20@ */ ECIPP_ALIGNMENT_UBYTE 255 CRI_DOC_Tcl_slct3_COMPU_VTAB 0 255 BIT_MASK 0xff /end CHARACTERISTIC
/begin COMPU_METHOD CRI_DOC_Tcl_slct3_COMPU_VTAB "Verbal Table" TAB_VERB "%.0" "list" COMPU_TAB_REF CRI_DOC_Tcl_slct3_COMPU_VTAB_REF /end COMPU_METHOD
/begin COMPU_VTAB CRI_DOC_Tcl_slct3_COMPU_VTAB_REF "Verbal Table" TAB_VERB 4 0 "Disabled" 1 "Standard" 2 "Alternate 1" 3 "Alt 1 + Std" DEFAULT_VALUE "UNKNOWN" /end COMPU_VTAB
/begin CHARACTERISTIC CRI_DOC_Tcl_slct4 "DOC closed-loop T control{CRI_DOC_Tcl_slct4&0xff=0:Disabled}{CRI_DOC_Tcl_slct4&0xff=1:Standard}{CRI_DOC_Tcl_slct4&0xff=2:Alternate 1}{CRI_DOC_Tcl_slct4&0xff=3:Alt 1 + Std}" VALUE 0x001F1962 /* @ECU_Address@CRI_DOC_Tcl_slct4@0x0100AA28@ */ ECIPP_ALIGNMENT_UBYTE 255 CRI_DOC_Tcl_slct4_COMPU_VTAB 0 255 BIT_MASK 0xff /end CHARACTERISTIC
/begin COMPU_METHOD CRI_DOC_Tcl_slct4_COMPU_VTAB "Verbal Table" TAB_VERB "%.0" "list" COMPU_TAB_REF CRI_DOC_Tcl_slct4_COMPU_VTAB_REF /end COMPU_METHOD
/begin COMPU_VTAB CRI_DOC_Tcl_slct4_COMPU_VTAB_REF "Verbal Table" TAB_VERB 4 0 "Disabled" 1 "Standard" 2 "Alternate 1" 3 "Alt 1 + Std" DEFAULT_VALUE "UNKNOWN" /end COMPU_VTAB
/begin CHARACTERISTIC CRI_DOC_Tcl_slct5 "DOC closed-loop T control{CRI_DOC_Tcl_slct5&0xff=0:Disabled}{CRI_DOC_Tcl_slct5&0xff=1:Standard}{CRI_DOC_Tcl_slct5&0xff=2:Alternate 1}{CRI_DOC_Tcl_slct5&0xff=3:Alt 1 + Std}" VALUE 0x001F1963 /* @ECU_Address@CRI_DOC_Tcl_slct5@0x0100AA30@ */ ECIPP_ALIGNMENT_UBYTE 255 CRI_DOC_Tcl_slct5_COMPU_VTAB 0 255 BIT_MASK 0xff /end CHARACTERISTIC
/begin COMPU_METHOD CRI_DOC_Tcl_slct5_COMPU_VTAB "Verbal Table" TAB_VERB "%.0" "list" COMPU_TAB_REF CRI_DOC_Tcl_slct5_COMPU_VTAB_REF /end COMPU_METHOD
/begin COMPU_VTAB CRI_DOC_Tcl_slct5_COMPU_VTAB_REF "Verbal Table" TAB_VERB 4 0 "Disabled" 1 "Standard" 2 "Alternate 1" 3 "Alt 1 + Std" DEFAULT_VALUE "UNKNOWN" /end COMPU_VTAB
/begin CHARACTERISTIC CRI_DOC_Tcl_slct6 "DOC closed-loop T control{CRI_DOC_Tcl_slct6&0xff=0:Disabled}{CRI_DOC_Tcl_slct6&0xff=1:Standard}{CRI_DOC_Tcl_slct6&0xff=2:Alternate 1}{CRI_DOC_Tcl_slct6&0xff=3:Alt 1 + Std}" VALUE 0x001F1964 /* @ECU_Address@CRI_DOC_Tcl_slct6@0x0100AA38@ */ ECIPP_ALIGNMENT_UBYTE 255 CRI_DOC_Tcl_slct6_COMPU_VTAB 0 255 BIT_MASK 0xff /end CHARACTERISTIC
/begin COMPU_METHOD CRI_DOC_Tcl_slct6_COMPU_VTAB "Verbal Table" TAB_VERB "%.0" "list" COMPU_TAB_REF CRI_DOC_Tcl_slct6_COMPU_VTAB_REF /end COMPU_METHOD
/begin COMPU_VTAB CRI_DOC_Tcl_slct6_COMPU_VTAB_REF "Verbal Table" TAB_VERB 4 0 "Disabled" 1 "Standard" 2 "Alternate 1" 3 "Alt 1 + Std" DEFAULT_VALUE "UNKNOWN" /end COMPU_VTAB
/begin CHARACTERISTIC CRI_DOC_Tcl_slct7 "DOC closed-loop T control{CRI_DOC_Tcl_slct7&0xff=0:Disabled}{CRI_DOC_Tcl_slct7&0xff=1:Standard}{CRI_DOC_Tcl_slct7&0xff=2:Alternate 1}{CRI_DOC_Tcl_slct7&0xff=3:Alt 1 + Std}" VALUE 0x001F1965 /* @ECU_Address@CRI_DOC_Tcl_slct7@0x0100AA40@ */ ECIPP_ALIGNMENT_UBYTE 255 CRI_DOC_Tcl_slct7_COMPU_VTAB 0 255 BIT_MASK 0xff /end CHARACTERISTIC
/begin COMPU_METHOD CRI_DOC_Tcl_slct7_COMPU_VTAB "Verbal Table" TAB_VERB "%.0" "list" COMPU_TAB_REF CRI_DOC_Tcl_slct7_COMPU_VTAB_REF /end COMPU_METHOD
/begin COMPU_VTAB CRI_DOC_Tcl_slct7_COMPU_VTAB_REF "Verbal Table" TAB_VERB 4 0 "Disabled" 1 "Standard" 2 "Alternate 1" 3 "Alt 1 + Std" DEFAULT_VALUE "UNKNOWN" /end COMPU_VTAB
/begin CHARACTERISTIC CRI_DOC_Tcl_slct8 "DOC closed-loop T control{CRI_DOC_Tcl_slct8&0xff=0:Disabled}{CRI_DOC_Tcl_slct8&0xff=1:Standard}{CRI_DOC_Tcl_slct8&0xff=2:Alternate 1}{CRI_DOC_Tcl_slct8&0xff=3:Alt 1 + Std}" VALUE 0x001F1966 /* @ECU_Address@CRI_DOC_Tcl_slct8@0x0100AA48@ */ ECIPP_ALIGNMENT_UBYTE 255 CRI_DOC_Tcl_slct8_COMPU_VTAB 0 255 BIT_MASK 0xff /end CHARACTERISTIC
/begin COMPU_METHOD CRI_DOC_Tcl_slct8_COMPU_VTAB "Verbal Table" TAB_VERB "%.0" "list" COMPU_TAB_REF CRI_DOC_Tcl_slct8_COMPU_VTAB_REF /end COMPU_METHOD
/begin COMPU_VTAB CRI_DOC_Tcl_slct8_COMPU_VTAB_REF "Verbal Table" TAB_VERB 4 0 "Disabled" 1 "Standard" 2 "Alternate 1" 3 "Alt 1 + Std" DEFAULT_VALUE "UNKNOWN" /end COMPU_VTAB
/begin CHARACTERISTIC CRI_DOC_Tcl_slct9 "DOC closed-loop T control{CRI_DOC_Tcl_slct9&0xff=0:Disabled}{CRI_DOC_Tcl_slct9&0xff=1:Standard}{CRI_DOC_Tcl_slct9&0xff=2:Alternate 1}{CRI_DOC_Tcl_slct9&0xff=3:Alt 1 + Std}" VALUE 0x001F1967 /* @ECU_Address@CRI_DOC_Tcl_slct9@0x0100AA50@ */ ECIPP_ALIGNMENT_UBYTE 255 CRI_DOC_Tcl_slct9_COMPU_VTAB 0 255 BIT_MASK 0xff /end CHARACTERISTIC
/begin COMPU_METHOD CRI_DOC_Tcl_slct9_COMPU_VTAB "Verbal Table" TAB_VERB "%.0" "list" COMPU_TAB_REF CRI_DOC_Tcl_slct9_COMPU_VTAB_REF /end COMPU_METHOD
/begin COMPU_VTAB CRI_DOC_Tcl_slct9_COMPU_VTAB_REF "Verbal Table" TAB_VERB 4 0 "Disabled" 1 "Standard" 2 "Alternate 1" 3 "Alt 1 + Std" DEFAULT_VALUE "UNKNOWN" /end COMPU_VTAB
/begin CHARACTERISTIC CRI_mchk_RPM0 "Enter this mode if RPM is{CRI_mchk_RPM0&0xff=0:X}{CRI_mchk_RPM0&0xff=1:<}{CRI_mchk_RPM0&0xff=2:>}{CRI_mchk_RPM0&0xff=3:<=}{CRI_mchk_RPM0&0xff=4:>=}{CRI_mchk_RPM0&0xff=5:=}{CRI_mchk_RPM0&0xff=6:<>}" VALUE 0x001F1A28 /* @ECU_Address@CRI_mchk_RPM0@0x0100AA58@ */ ECIPP_ALIGNMENT_UBYTE 255 CRI_mchk_RPM0_COMPU_VTAB 0 255 BIT_MASK 0xff /end CHARACTERISTIC
/begin COMPU_METHOD CRI_mchk_RPM0_COMPU_VTAB "Verbal Table" TAB_VERB "%.0" "list" COMPU_TAB_REF CRI_mchk_RPM0_COMPU_VTAB_REF /end COMPU_METHOD
/begin COMPU_VTAB CRI_mchk_RPM0_COMPU_VTAB_REF "Verbal Table" TAB_VERB 7 0 "X" 1 "<" 2 ">" 3 "<=" 4 ">=" 5 "=" 6 "<>" DEFAULT_VALUE "UNKNOWN" /end COMPU_VTAB
/begin CHARACTERISTIC CRI_mchk_RPM1 "Enter this mode if RPM is{CRI_mchk_RPM1&0xff=0:X}{CRI_mchk_RPM1&0xff=1:<}{CRI_mchk_RPM1&0xff=2:>}{CRI_mchk_RPM1&0xff=3:<=}{CRI_mchk_RPM1&0xff=4:>=}{CRI_mchk_RPM1&0xff=5:=}{CRI_mchk_RPM1&0xff=6:<>}" VALUE 0x001F1A29 /* @ECU_Address@CRI_mchk_RPM1@0x0100AA60@ */ ECIPP_ALIGNMENT_UBYTE 255 CRI_mchk_RPM1_COMPU_VTAB 0 255 BIT_MASK 0xff /end CHARACTERISTIC
/begin COMPU_METHOD CRI_mchk_RPM1_COMPU_VTAB "Verbal Table" TAB_VERB "%.0" "list" COMPU_TAB_REF CRI_mchk_RPM1_COMPU_VTAB_REF /end COMPU_METHOD
/begin COMPU_VTAB CRI_mchk_RPM1_COMPU_VTAB_REF "Verbal Table" TAB_VERB 7 0 "X" 1 "<" 2 ">" 3 "<=" 4 ">=" 5 "=" 6 "<>" DEFAULT_VALUE "UNKNOWN" /end COMPU_VTAB
/begin CHARACTERISTIC CRI_mchk_RPM2 "Enter this mode if RPM is{CRI_mchk_RPM2&0xff=0:X}{CRI_mchk_RPM2&0xff=1:<}{CRI_mchk_RPM2&0xff=2:>}{CRI_mchk_RPM2&0xff=3:<=}{CRI_mchk_RPM2&0xff=4:>=}{CRI_mchk_RPM2&0xff=5:=}{CRI_mchk_RPM2&0xff=6:<>}" VALUE 0x001F1A2A /* @ECU_Address@CRI_mchk_RPM2@0x0100AA68@ */ ECIPP_ALIGNMENT_UBYTE 255 CRI_mchk_RPM2_COMPU_VTAB 0 255 BIT_MASK 0xff /end CHARACTERISTIC
/begin COMPU_METHOD CRI_mchk_RPM2_COMPU_VTAB "Verbal Table" TAB_VERB "%.0" "list" COMPU_TAB_REF CRI_mchk_RPM2_COMPU_VTAB_REF /end COMPU_METHOD
/begin COMPU_VTAB CRI_mchk_RPM2_COMPU_VTAB_REF "Verbal Table" TAB_VERB 7 0 "X" 1 "<" 2 ">" 3 "<=" 4 ">=" 5 "=" 6 "<>" DEFAULT_VALUE "UNKNOWN" /end COMPU_VTAB
/begin CHARACTERISTIC CRI_mchk_RPM3 "Enter this mode if RPM is{CRI_mchk_RPM3&0xff=0:X}{CRI_mchk_RPM3&0xff=1:<}{CRI_mchk_RPM3&0xff=2:>}{CRI_mchk_RPM3&0xff=3:<=}{CRI_mchk_RPM3&0xff=4:>=}{CRI_mchk_RPM3&0xff=5:=}{CRI_mchk_RPM3&0xff=6:<>}" VALUE 0x001F1A2B /* @ECU_Address@CRI_mchk_RPM3@0x0100AA70@ */ ECIPP_ALIGNMENT_UBYTE 255 CRI_mchk_RPM3_COMPU_VTAB 0 255 BIT_MASK 0xff /end CHARACTERISTIC
/begin COMPU_METHOD CRI_mchk_RPM3_COMPU_VTAB "Verbal Table" TAB_VERB "%.0" "list" COMPU_TAB_REF CRI_mchk_RPM3_COMPU_VTAB_REF /end COMPU_METHOD
/begin COMPU_VTAB CRI_mchk_RPM3_COMPU_VTAB_REF "Verbal Table" TAB_VERB 7 0 "X" 1 "<" 2 ">" 3 "<=" 4 ">=" 5 "=" 6 "<>" DEFAULT_VALUE "UNKNOWN" /end COMPU_VTAB
/begin CHARACTERISTIC CRI_mchk_RPM4 "Enter this mode if RPM is{CRI_mchk_RPM4&0xff=0:X}{CRI_mchk_RPM4&0xff=1:<}{CRI_mchk_RPM4&0xff=2:>}{CRI_mchk_RPM4&0xff=3:<=}{CRI_mchk_RPM4&0xff=4:>=}{CRI_mchk_RPM4&0xff=5:=}{CRI_mchk_RPM4&0xff=6:<>}" VALUE 0x001F1A2C /* @ECU_Address@CRI_mchk_RPM4@0x0100AA78@ */ ECIPP_ALIGNMENT_UBYTE 255 CRI_mchk_RPM4_COMPU_VTAB 0 255 BIT_MASK 0xff /end CHARACTERISTIC
/begin COMPU_METHOD CRI_mchk_RPM4_COMPU_VTAB "Verbal Table" TAB_VERB "%.0" "list" COMPU_TAB_REF CRI_mchk_RPM4_COMPU_VTAB_REF /end COMPU_METHOD
/begin COMPU_VTAB CRI_mchk_RPM4_COMPU_VTAB_REF "Verbal Table" TAB_VERB 7 0 "X" 1 "<" 2 ">" 3 "<=" 4 ">=" 5 "=" 6 "<>" DEFAULT_VALUE "UNKNOWN" /end COMPU_VTAB
/begin CHARACTERISTIC CRI_mchk_RPM5 "Enter this mode if RPM is{CRI_mchk_RPM5&0xff=0:X}{CRI_mchk_RPM5&0xff=1:<}{CRI_mchk_RPM5&0xff=2:>}{CRI_mchk_RPM5&0xff=3:<=}{CRI_mchk_RPM5&0xff=4:>=}{CRI_mchk_RPM5&0xff=5:=}{CRI_mchk_RPM5&0xff=6:<>}" VALUE 0x001F1A2D /* @ECU_Address@CRI_mchk_RPM5@0x0100AA80@ */ ECIPP_ALIGNMENT_UBYTE 255 CRI_mchk_RPM5_COMPU_VTAB 0 255 BIT_MASK 0xff /end CHARACTERISTIC
/begin COMPU_METHOD CRI_mchk_RPM5_COMPU_VTAB "Verbal Table" TAB_VERB "%.0" "list" COMPU_TAB_REF CRI_mchk_RPM5_COMPU_VTAB_REF /end COMPU_METHOD
/begin COMPU_VTAB CRI_mchk_RPM5_COMPU_VTAB_REF "Verbal Table" TAB_VERB 7 0 "X" 1 "<" 2 ">" 3 "<=" 4 ">=" 5 "=" 6 "<>" DEFAULT_VALUE "UNKNOWN" /end COMPU_VTAB
/begin CHARACTERISTIC CRI_mchk_RPM6 "Enter this mode if RPM is{CRI_mchk_RPM6&0xff=0:X}{CRI_mchk_RPM6&0xff=1:<}{CRI_mchk_RPM6&0xff=2:>}{CRI_mchk_RPM6&0xff=3:<=}{CRI_mchk_RPM6&0xff=4:>=}{CRI_mchk_RPM6&0xff=5:=}{CRI_mchk_RPM6&0xff=6:<>}" VALUE 0x001F1A2E /* @ECU_Address@CRI_mchk_RPM6@0x0100AA88@ */ ECIPP_ALIGNMENT_UBYTE 255 CRI_mchk_RPM6_COMPU_VTAB 0 255 BIT_MASK 0xff /end CHARACTERISTIC
/begin COMPU_METHOD CRI_mchk_RPM6_COMPU_VTAB "Verbal Table" TAB_VERB "%.0" "list" COMPU_TAB_REF CRI_mchk_RPM6_COMPU_VTAB_REF /end COMPU_METHOD
/begin COMPU_VTAB CRI_mchk_RPM6_COMPU_VTAB_REF "Verbal Table" TAB_VERB 7 0 "X" 1 "<" 2 ">" 3 "<=" 4 ">=" 5 "=" 6 "<>" DEFAULT_VALUE "UNKNOWN" /end COMPU_VTAB
/begin CHARACTERISTIC CRI_mchk_RPM7 "Enter this mode if RPM is{CRI_mchk_RPM7&0xff=0:X}{CRI_mchk_RPM7&0xff=1:<}{CRI_mchk_RPM7&0xff=2:>}{CRI_mchk_RPM7&0xff=3:<=}{CRI_mchk_RPM7&0xff=4:>=}{CRI_mchk_RPM7&0xff=5:=}{CRI_mchk_RPM7&0xff=6:<>}" VALUE 0x001F1A2F /* @ECU_Address@CRI_mchk_RPM7@0x0100AA90@ */ ECIPP_ALIGNMENT_UBYTE 255 CRI_mchk_RPM7_COMPU_VTAB 0 255 BIT_MASK 0xff /end CHARACTERISTIC
/begin COMPU_METHOD CRI_mchk_RPM7_COMPU_VTAB "Verbal Table" TAB_VERB "%.0" "list" COMPU_TAB_REF CRI_mchk_RPM7_COMPU_VTAB_REF /end COMPU_METHOD
/begin COMPU_VTAB CRI_mchk_RPM7_COMPU_VTAB_REF "Verbal Table" TAB_VERB 7 0 "X" 1 "<" 2 ">" 3 "<=" 4 ">=" 5 "=" 6 "<>" DEFAULT_VALUE "UNKNOWN" /end COMPU_VTAB
/begin CHARACTERISTIC CRI_mchk_RPM8 "Enter this mode if RPM is{CRI_mchk_RPM8&0xff=0:X}{CRI_mchk_RPM8&0xff=1:<}{CRI_mchk_RPM8&0xff=2:>}{CRI_mchk_RPM8&0xff=3:<=}{CRI_mchk_RPM8&0xff=4:>=}{CRI_mchk_RPM8&0xff=5:=}{CRI_mchk_RPM8&0xff=6:<>}" VALUE 0x001F1A30 /* @ECU_Address@CRI_mchk_RPM8@0x0100AA98@ */ ECIPP_ALIGNMENT_UBYTE 255 CRI_mchk_RPM8_COMPU_VTAB 0 255 BIT_MASK 0xff /end CHARACTERISTIC
/begin COMPU_METHOD CRI_mchk_RPM8_COMPU_VTAB "Verbal Table" TAB_VERB "%.0" "list" COMPU_TAB_REF CRI_mchk_RPM8_COMPU_VTAB_REF /end COMPU_METHOD
/begin COMPU_VTAB CRI_mchk_RPM8_COMPU_VTAB_REF "Verbal Table" TAB_VERB 7 0 "X" 1 "<" 2 ">" 3 "<=" 4 ">=" 5 "=" 6 "<>" DEFAULT_VALUE "UNKNOWN" /end COMPU_VTAB
/begin CHARACTERISTIC CRI_mchk_RPM9 "Enter this mode if RPM is{CRI_mchk_RPM9&0xff=0:X}{CRI_mchk_RPM9&0xff=1:<}{CRI_mchk_RPM9&0xff=2:>}{CRI_mchk_RPM9&0xff=3:<=}{CRI_mchk_RPM9&0xff=4:>=}{CRI_mchk_RPM9&0xff=5:=}{CRI_mchk_RPM9&0xff=6:<>}" VALUE 0x001F1A31 /* @ECU_Address@CRI_mchk_RPM9@0x0100AAA0@ */ ECIPP_ALIGNMENT_UBYTE 255 CRI_mchk_RPM9_COMPU_VTAB 0 255 BIT_MASK 0xff /end CHARACTERISTIC
/begin COMPU_METHOD CRI_mchk_RPM9_COMPU_VTAB "Verbal Table" TAB_VERB "%.0" "list" COMPU_TAB_REF CRI_mchk_RPM9_COMPU_VTAB_REF /end COMPU_METHOD
/begin COMPU_VTAB CRI_mchk_RPM9_COMPU_VTAB_REF "Verbal Table" TAB_VERB 7 0 "X" 1 "<" 2 ">" 3 "<=" 4 ">=" 5 "=" 6 "<>" DEFAULT_VALUE "UNKNOWN" /end COMPU_VTAB
/begin CHARACTERISTIC CRI_mchk_ECT0 "and ECT is{CRI_mchk_ECT0&0xff=0:X}{CRI_mchk_ECT0&0xff=1:<}{CRI_mchk_ECT0&0xff=2:>}{CRI_mchk_ECT0&0xff=3:<=}{CRI_mchk_ECT0&0xff=4:>=}{CRI_mchk_ECT0&0xff=5:=}{CRI_mchk_ECT0&0xff=6:<>}" VALUE 0x001F1A14 /* @ECU_Address@CRI_mchk_ECT0@0x0100AAA8@ */ ECIPP_ALIGNMENT_UBYTE 255 CRI_mchk_ECT0_COMPU_VTAB 0 255 BIT_MASK 0xff /end CHARACTERISTIC
/begin COMPU_METHOD CRI_mchk_ECT0_COMPU_VTAB "Verbal Table" TAB_VERB "%.0" "list" COMPU_TAB_REF CRI_mchk_ECT0_COMPU_VTAB_REF /end COMPU_METHOD
/begin COMPU_VTAB CRI_mchk_ECT0_COMPU_VTAB_REF "Verbal Table" TAB_VERB 7 0 "X" 1 "<" 2 ">" 3 "<=" 4 ">=" 5 "=" 6 "<>" DEFAULT_VALUE "UNKNOWN" /end COMPU_VTAB
/begin CHARACTERISTIC CRI_mchk_ECT1 "and ECT is{CRI_mchk_ECT1&0xff=0:X}{CRI_mchk_ECT1&0xff=1:<}{CRI_mchk_ECT1&0xff=2:>}{CRI_mchk_ECT1&0xff=3:<=}{CRI_mchk_ECT1&0xff=4:>=}{CRI_mchk_ECT1&0xff=5:=}{CRI_mchk_ECT1&0xff=6:<>}" VALUE 0x001F1A15 /* @ECU_Address@CRI_mchk_ECT1@0x0100AAB0@ */ ECIPP_ALIGNMENT_UBYTE 255 CRI_mchk_ECT1_COMPU_VTAB 0 255 BIT_MASK 0xff /end CHARACTERISTIC
/begin COMPU_METHOD CRI_mchk_ECT1_COMPU_VTAB "Verbal Table" TAB_VERB "%.0" "list" COMPU_TAB_REF CRI_mchk_ECT1_COMPU_VTAB_REF /end COMPU_METHOD
/begin COMPU_VTAB CRI_mchk_ECT1_COMPU_VTAB_REF "Verbal Table" TAB_VERB 7 0 "X" 1 "<" 2 ">" 3 "<=" 4 ">=" 5 "=" 6 "<>" DEFAULT_VALUE "UNKNOWN" /end COMPU_VTAB
/begin CHARACTERISTIC CRI_mchk_ECT2 "and ECT is{CRI_mchk_ECT2&0xff=0:X}{CRI_mchk_ECT2&0xff=1:<}{CRI_mchk_ECT2&0xff=2:>}{CRI_mchk_ECT2&0xff=3:<=}{CRI_mchk_ECT2&0xff=4:>=}{CRI_mchk_ECT2&0xff=5:=}{CRI_mchk_ECT2&0xff=6:<>}" VALUE 0x001F1A16 /* @ECU_Address@CRI_mchk_ECT2@0x0100AAB8@ */ ECIPP_ALIGNMENT_UBYTE 255 CRI_mchk_ECT2_COMPU_VTAB 0 255 BIT_MASK 0xff /end CHARACTERISTIC
/begin COMPU_METHOD CRI_mchk_ECT2_COMPU_VTAB "Verbal Table" TAB_VERB "%.0" "list" COMPU_TAB_REF CRI_mchk_ECT2_COMPU_VTAB_REF /end COMPU_METHOD
/begin COMPU_VTAB CRI_mchk_ECT2_COMPU_VTAB_REF "Verbal Table" TAB_VERB 7 0 "X" 1 "<" 2 ">" 3 "<=" 4 ">=" 5 "=" 6 "<>" DEFAULT_VALUE "UNKNOWN" /end COMPU_VTAB
/begin CHARACTERISTIC CRI_mchk_ECT3 "and ECT is{CRI_mchk_ECT3&0xff=0:X}{CRI_mchk_ECT3&0xff=1:<}{CRI_mchk_ECT3&0xff=2:>}{CRI_mchk_ECT3&0xff=3:<=}{CRI_mchk_ECT3&0xff=4:>=}{CRI_mchk_ECT3&0xff=5:=}{CRI_mchk_ECT3&0xff=6:<>}" VALUE 0x001F1A17 /* @ECU_Address@CRI_mchk_ECT3@0x0100AAC0@ */ ECIPP_ALIGNMENT_UBYTE 255 CRI_mchk_ECT3_COMPU_VTAB 0 255 BIT_MASK 0xff /end CHARACTERISTIC
/begin COMPU_METHOD CRI_mchk_ECT3_COMPU_VTAB "Verbal Table" TAB_VERB "%.0" "list" COMPU_TAB_REF CRI_mchk_ECT3_COMPU_VTAB_REF /end COMPU_METHOD
/begin COMPU_VTAB CRI_mchk_ECT3_COMPU_VTAB_REF "Verbal Table" TAB_VERB 7 0 "X" 1 "<" 2 ">" 3 "<=" 4 ">=" 5 "=" 6 "<>" DEFAULT_VALUE "UNKNOWN" /end COMPU_VTAB
/begin CHARACTERISTIC CRI_mchk_ECT4 "and ECT is{CRI_mchk_ECT4&0xff=0:X}{CRI_mchk_ECT4&0xff=1:<}{CRI_mchk_ECT4&0xff=2:>}{CRI_mchk_ECT4&0xff=3:<=}{CRI_mchk_ECT4&0xff=4:>=}{CRI_mchk_ECT4&0xff=5:=}{CRI_mchk_ECT4&0xff=6:<>}" VALUE 0x001F1A18 /* @ECU_Address@CRI_mchk_ECT4@0x0100AAC8@ */ ECIPP_ALIGNMENT_UBYTE 255 CRI_mchk_ECT4_COMPU_VTAB 0 255 BIT_MASK 0xff /end CHARACTERISTIC
/begin COMPU_METHOD CRI_mchk_ECT4_COMPU_VTAB "Verbal Table" TAB_VERB "%.0" "list" COMPU_TAB_REF CRI_mchk_ECT4_COMPU_VTAB_REF /end COMPU_METHOD
/begin COMPU_VTAB CRI_mchk_ECT4_COMPU_VTAB_REF "Verbal Table" TAB_VERB 7 0 "X" 1 "<" 2 ">" 3 "<=" 4 ">=" 5 "=" 6 "<>" DEFAULT_VALUE "UNKNOWN" /end COMPU_VTAB
/begin CHARACTERISTIC CRI_mchk_ECT5 "and ECT is{CRI_mchk_ECT5&0xff=0:X}{CRI_mchk_ECT5&0xff=1:<}{CRI_mchk_ECT5&0xff=2:>}{CRI_mchk_ECT5&0xff=3:<=}{CRI_mchk_ECT5&0xff=4:>=}{CRI_mchk_ECT5&0xff=5:=}{CRI_mchk_ECT5&0xff=6:<>}" VALUE 0x001F1A19 /* @ECU_Address@CRI_mchk_ECT5@0x0100AAD0@ */ ECIPP_ALIGNMENT_UBYTE 255 CRI_mchk_ECT5_COMPU_VTAB 0 255 BIT_MASK 0xff /end CHARACTERISTIC
/begin COMPU_METHOD CRI_mchk_ECT5_COMPU_VTAB "Verbal Table" TAB_VERB "%.0" "list" COMPU_TAB_REF CRI_mchk_ECT5_COMPU_VTAB_REF /end COMPU_METHOD
/begin COMPU_VTAB CRI_mchk_ECT5_COMPU_VTAB_REF "Verbal Table" TAB_VERB 7 0 "X" 1 "<" 2 ">" 3 "<=" 4 ">=" 5 "=" 6 "<>" DEFAULT_VALUE "UNKNOWN" /end COMPU_VTAB
/begin CHARACTERISTIC CRI_mchk_ECT6 "and ECT is{CRI_mchk_ECT6&0xff=0:X}{CRI_mchk_ECT6&0xff=1:<}{CRI_mchk_ECT6&0xff=2:>}{CRI_mchk_ECT6&0xff=3:<=}{CRI_mchk_ECT6&0xff=4:>=}{CRI_mchk_ECT6&0xff=5:=}{CRI_mchk_ECT6&0xff=6:<>}" VALUE 0x001F1A1A /* @ECU_Address@CRI_mchk_ECT6@0x0100AAD8@ */ ECIPP_ALIGNMENT_UBYTE 255 CRI_mchk_ECT6_COMPU_VTAB 0 255 BIT_MASK 0xff /end CHARACTERISTIC
/begin COMPU_METHOD CRI_mchk_ECT6_COMPU_VTAB "Verbal Table" TAB_VERB "%.0" "list" COMPU_TAB_REF CRI_mchk_ECT6_COMPU_VTAB_REF /end COMPU_METHOD
/begin COMPU_VTAB CRI_mchk_ECT6_COMPU_VTAB_REF "Verbal Table" TAB_VERB 7 0 "X" 1 "<" 2 ">" 3 "<=" 4 ">=" 5 "=" 6 "<>" DEFAULT_VALUE "UNKNOWN" /end COMPU_VTAB
/begin CHARACTERISTIC CRI_mchk_ECT7 "and ECT is{CRI_mchk_ECT7&0xff=0:X}{CRI_mchk_ECT7&0xff=1:<}{CRI_mchk_ECT7&0xff=2:>}{CRI_mchk_ECT7&0xff=3:<=}{CRI_mchk_ECT7&0xff=4:>=}{CRI_mchk_ECT7&0xff=5:=}{CRI_mchk_ECT7&0xff=6:<>}" VALUE 0x001F1A1B /* @ECU_Address@CRI_mchk_ECT7@0x0100AAE0@ */ ECIPP_ALIGNMENT_UBYTE 255 CRI_mchk_ECT7_COMPU_VTAB 0 255 BIT_MASK 0xff /end CHARACTERISTIC
/begin COMPU_METHOD CRI_mchk_ECT7_COMPU_VTAB "Verbal Table" TAB_VERB "%.0" "list" COMPU_TAB_REF CRI_mchk_ECT7_COMPU_VTAB_REF /end COMPU_METHOD
/begin COMPU_VTAB CRI_mchk_ECT7_COMPU_VTAB_REF "Verbal Table" TAB_VERB 7 0 "X" 1 "<" 2 ">" 3 "<=" 4 ">=" 5 "=" 6 "<>" DEFAULT_VALUE "UNKNOWN" /end COMPU_VTAB
/begin CHARACTERISTIC CRI_mchk_ECT8 "and ECT is{CRI_mchk_ECT8&0xff=0:X}{CRI_mchk_ECT8&0xff=1:<}{CRI_mchk_ECT8&0xff=2:>}{CRI_mchk_ECT8&0xff=3:<=}{CRI_mchk_ECT8&0xff=4:>=}{CRI_mchk_ECT8&0xff=5:=}{CRI_mchk_ECT8&0xff=6:<>}" VALUE 0x001F1A1C /* @ECU_Address@CRI_mchk_ECT8@0x0100AAE8@ */ ECIPP_ALIGNMENT_UBYTE 255 CRI_mchk_ECT8_COMPU_VTAB 0 255 BIT_MASK 0xff /end CHARACTERISTIC
/begin COMPU_METHOD CRI_mchk_ECT8_COMPU_VTAB "Verbal Table" TAB_VERB "%.0" "list" COMPU_TAB_REF CRI_mchk_ECT8_COMPU_VTAB_REF /end COMPU_METHOD
/begin COMPU_VTAB CRI_mchk_ECT8_COMPU_VTAB_REF "Verbal Table" TAB_VERB 7 0 "X" 1 "<" 2 ">" 3 "<=" 4 ">=" 5 "=" 6 "<>" DEFAULT_VALUE "UNKNOWN" /end COMPU_VTAB
/begin CHARACTERISTIC CRI_mchk_ECT9 "and ECT is{CRI_mchk_ECT9&0xff=0:X}{CRI_mchk_ECT9&0xff=1:<}{CRI_mchk_ECT9&0xff=2:>}{CRI_mchk_ECT9&0xff=3:<=}{CRI_mchk_ECT9&0xff=4:>=}{CRI_mchk_ECT9&0xff=5:=}{CRI_mchk_ECT9&0xff=6:<>}" VALUE 0x001F1A1D /* @ECU_Address@CRI_mchk_ECT9@0x0100AAF0@ */ ECIPP_ALIGNMENT_UBYTE 255 CRI_mchk_ECT9_COMPU_VTAB 0 255 BIT_MASK 0xff /end CHARACTERISTIC
/begin COMPU_METHOD CRI_mchk_ECT9_COMPU_VTAB "Verbal Table" TAB_VERB "%.0" "list" COMPU_TAB_REF CRI_mchk_ECT9_COMPU_VTAB_REF /end COMPU_METHOD
/begin COMPU_VTAB CRI_mchk_ECT9_COMPU_VTAB_REF "Verbal Table" TAB_VERB 7 0 "X" 1 "<" 2 ">" 3 "<=" 4 ">=" 5 "=" 6 "<>" DEFAULT_VALUE "UNKNOWN" /end COMPU_VTAB
/begin CHARACTERISTIC CRI_mchk_IAT0 "and IAT is{CRI_mchk_IAT0&0xff=0:X}{CRI_mchk_IAT0&0xff=1:<}{CRI_mchk_IAT0&0xff=2:>}{CRI_mchk_IAT0&0xff=3:<=}{CRI_mchk_IAT0&0xff=4:>=}{CRI_mchk_IAT0&0xff=5:=}{CRI_mchk_IAT0&0xff=6:<>}" VALUE 0x001F1A1E /* @ECU_Address@CRI_mchk_IAT0@0x0100AAF8@ */ ECIPP_ALIGNMENT_UBYTE 255 CRI_mchk_IAT0_COMPU_VTAB 0 255 BIT_MASK 0xff /end CHARACTERISTIC
/begin COMPU_METHOD CRI_mchk_IAT0_COMPU_VTAB "Verbal Table" TAB_VERB "%.0" "list" COMPU_TAB_REF CRI_mchk_IAT0_COMPU_VTAB_REF /end COMPU_METHOD
/begin COMPU_VTAB CRI_mchk_IAT0_COMPU_VTAB_REF "Verbal Table" TAB_VERB 7 0 "X" 1 "<" 2 ">" 3 "<=" 4 ">=" 5 "=" 6 "<>" DEFAULT_VALUE "UNKNOWN" /end COMPU_VTAB
/begin CHARACTERISTIC CRI_mchk_IAT1 "and IAT is{CRI_mchk_IAT1&0xff=0:X}{CRI_mchk_IAT1&0xff=1:<}{CRI_mchk_IAT1&0xff=2:>}{CRI_mchk_IAT1&0xff=3:<=}{CRI_mchk_IAT1&0xff=4:>=}{CRI_mchk_IAT1&0xff=5:=}{CRI_mchk_IAT1&0xff=6:<>}" VALUE 0x001F1A1F /* @ECU_Address@CRI_mchk_IAT1@0x0100AB00@ */ ECIPP_ALIGNMENT_UBYTE 255 CRI_mchk_IAT1_COMPU_VTAB 0 255 BIT_MASK 0xff /end CHARACTERISTIC
/begin COMPU_METHOD CRI_mchk_IAT1_COMPU_VTAB "Verbal Table" TAB_VERB "%.0" "list" COMPU_TAB_REF CRI_mchk_IAT1_COMPU_VTAB_REF /end COMPU_METHOD
/begin COMPU_VTAB CRI_mchk_IAT1_COMPU_VTAB_REF "Verbal Table" TAB_VERB 7 0 "X" 1 "<" 2 ">" 3 "<=" 4 ">=" 5 "=" 6 "<>" DEFAULT_VALUE "UNKNOWN" /end COMPU_VTAB
/begin CHARACTERISTIC CRI_mchk_IAT2 "and IAT is{CRI_mchk_IAT2&0xff=0:X}{CRI_mchk_IAT2&0xff=1:<}{CRI_mchk_IAT2&0xff=2:>}{CRI_mchk_IAT2&0xff=3:<=}{CRI_mchk_IAT2&0xff=4:>=}{CRI_mchk_IAT2&0xff=5:=}{CRI_mchk_IAT2&0xff=6:<>}" VALUE 0x001F1A20 /* @ECU_Address@CRI_mchk_IAT2@0x0100AB08@ */ ECIPP_ALIGNMENT_UBYTE 255 CRI_mchk_IAT2_COMPU_VTAB 0 255 BIT_MASK 0xff /end CHARACTERISTIC
/begin COMPU_METHOD CRI_mchk_IAT2_COMPU_VTAB "Verbal Table" TAB_VERB "%.0" "list" COMPU_TAB_REF CRI_mchk_IAT2_COMPU_VTAB_REF /end COMPU_METHOD
/begin COMPU_VTAB CRI_mchk_IAT2_COMPU_VTAB_REF "Verbal Table" TAB_VERB 7 0 "X" 1 "<" 2 ">" 3 "<=" 4 ">=" 5 "=" 6 "<>" DEFAULT_VALUE "UNKNOWN" /end COMPU_VTAB
/begin CHARACTERISTIC CRI_mchk_IAT3 "and IAT is{CRI_mchk_IAT3&0xff=0:X}{CRI_mchk_IAT3&0xff=1:<}{CRI_mchk_IAT3&0xff=2:>}{CRI_mchk_IAT3&0xff=3:<=}{CRI_mchk_IAT3&0xff=4:>=}{CRI_mchk_IAT3&0xff=5:=}{CRI_mchk_IAT3&0xff=6:<>}" VALUE 0x001F1A21 /* @ECU_Address@CRI_mchk_IAT3@0x0100AB10@ */ ECIPP_ALIGNMENT_UBYTE 255 CRI_mchk_IAT3_COMPU_VTAB 0 255 BIT_MASK 0xff /end CHARACTERISTIC
/begin COMPU_METHOD CRI_mchk_IAT3_COMPU_VTAB "Verbal Table" TAB_VERB "%.0" "list" COMPU_TAB_REF CRI_mchk_IAT3_COMPU_VTAB_REF /end COMPU_METHOD
/begin COMPU_VTAB CRI_mchk_IAT3_COMPU_VTAB_REF "Verbal Table" TAB_VERB 7 0 "X" 1 "<" 2 ">" 3 "<=" 4 ">=" 5 "=" 6 "<>" DEFAULT_VALUE "UNKNOWN" /end COMPU_VTAB
/begin CHARACTERISTIC CRI_mchk_IAT4 "and IAT is{CRI_mchk_IAT4&0xff=0:X}{CRI_mchk_IAT4&0xff=1:<}{CRI_mchk_IAT4&0xff=2:>}{CRI_mchk_IAT4&0xff=3:<=}{CRI_mchk_IAT4&0xff=4:>=}{CRI_mchk_IAT4&0xff=5:=}{CRI_mchk_IAT4&0xff=6:<>}" VALUE 0x001F1A22 /* @ECU_Address@CRI_mchk_IAT4@0x0100AB18@ */ ECIPP_ALIGNMENT_UBYTE 255 CRI_mchk_IAT4_COMPU_VTAB 0 255 BIT_MASK 0xff /end CHARACTERISTIC
/begin COMPU_METHOD CRI_mchk_IAT4_COMPU_VTAB "Verbal Table" TAB_VERB "%.0" "list" COMPU_TAB_REF CRI_mchk_IAT4_COMPU_VTAB_REF /end COMPU_METHOD
/begin COMPU_VTAB CRI_mchk_IAT4_COMPU_VTAB_REF "Verbal Table" TAB_VERB 7 0 "X" 1 "<" 2 ">" 3 "<=" 4 ">=" 5 "=" 6 "<>" DEFAULT_VALUE "UNKNOWN" /end COMPU_VTAB
/begin CHARACTERISTIC CRI_mchk_IAT5 "and IAT is{CRI_mchk_IAT5&0xff=0:X}{CRI_mchk_IAT5&0xff=1:<}{CRI_mchk_IAT5&0xff=2:>}{CRI_mchk_IAT5&0xff=3:<=}{CRI_mchk_IAT5&0xff=4:>=}{CRI_mchk_IAT5&0xff=5:=}{CRI_mchk_IAT5&0xff=6:<>}" VALUE 0x001F1A23 /* @ECU_Address@CRI_mchk_IAT5@0x0100AB20@ */ ECIPP_ALIGNMENT_UBYTE 255 CRI_mchk_IAT5_COMPU_VTAB 0 255 BIT_MASK 0xff /end CHARACTERISTIC
/begin COMPU_METHOD CRI_mchk_IAT5_COMPU_VTAB "Verbal Table" TAB_VERB "%.0" "list" COMPU_TAB_REF CRI_mchk_IAT5_COMPU_VTAB_REF /end COMPU_METHOD
/begin COMPU_VTAB CRI_mchk_IAT5_COMPU_VTAB_REF "Verbal Table" TAB_VERB 7 0 "X" 1 "<" 2 ">" 3 "<=" 4 ">=" 5 "=" 6 "<>" DEFAULT_VALUE "UNKNOWN" /end COMPU_VTAB
/begin CHARACTERISTIC CRI_mchk_IAT6 "and IAT is{CRI_mchk_IAT6&0xff=0:X}{CRI_mchk_IAT6&0xff=1:<}{CRI_mchk_IAT6&0xff=2:>}{CRI_mchk_IAT6&0xff=3:<=}{CRI_mchk_IAT6&0xff=4:>=}{CRI_mchk_IAT6&0xff=5:=}{CRI_mchk_IAT6&0xff=6:<>}" VALUE 0x001F1A24 /* @ECU_Address@CRI_mchk_IAT6@0x0100AB28@ */ ECIPP_ALIGNMENT_UBYTE 255 CRI_mchk_IAT6_COMPU_VTAB 0 255 BIT_MASK 0xff /end CHARACTERISTIC
/begin COMPU_METHOD CRI_mchk_IAT6_COMPU_VTAB "Verbal Table" TAB_VERB "%.0" "list" COMPU_TAB_REF CRI_mchk_IAT6_COMPU_VTAB_REF /end COMPU_METHOD
/begin COMPU_VTAB CRI_mchk_IAT6_COMPU_VTAB_REF "Verbal Table" TAB_VERB 7 0 "X" 1 "<" 2 ">" 3 "<=" 4 ">=" 5 "=" 6 "<>" DEFAULT_VALUE "UNKNOWN" /end COMPU_VTAB
/begin CHARACTERISTIC CRI_mchk_IAT7 "and IAT is{CRI_mchk_IAT7&0xff=0:X}{CRI_mchk_IAT7&0xff=1:<}{CRI_mchk_IAT7&0xff=2:>}{CRI_mchk_IAT7&0xff=3:<=}{CRI_mchk_IAT7&0xff=4:>=}{CRI_mchk_IAT7&0xff=5:=}{CRI_mchk_IAT7&0xff=6:<>}" VALUE 0x001F1A25 /* @ECU_Address@CRI_mchk_IAT7@0x0100AB30@ */ ECIPP_ALIGNMENT_UBYTE 255 CRI_mchk_IAT7_COMPU_VTAB 0 255 BIT_MASK 0xff /end CHARACTERISTIC
/begin COMPU_METHOD CRI_mchk_IAT7_COMPU_VTAB "Verbal Table" TAB_VERB "%.0" "list" COMPU_TAB_REF CRI_mchk_IAT7_COMPU_VTAB_REF /end COMPU_METHOD
/begin COMPU_VTAB CRI_mchk_IAT7_COMPU_VTAB_REF "Verbal Table" TAB_VERB 7 0 "X" 1 "<" 2 ">" 3 "<=" 4 ">=" 5 "=" 6 "<>" DEFAULT_VALUE "UNKNOWN" /end COMPU_VTAB
/begin CHARACTERISTIC CRI_mchk_IAT8 "and IAT is{CRI_mchk_IAT8&0xff=0:X}{CRI_mchk_IAT8&0xff=1:<}{CRI_mchk_IAT8&0xff=2:>}{CRI_mchk_IAT8&0xff=3:<=}{CRI_mchk_IAT8&0xff=4:>=}{CRI_mchk_IAT8&0xff=5:=}{CRI_mchk_IAT8&0xff=6:<>}" VALUE 0x001F1A26 /* @ECU_Address@CRI_mchk_IAT8@0x0100AB38@ */ ECIPP_ALIGNMENT_UBYTE 255 CRI_mchk_IAT8_COMPU_VTAB 0 255 BIT_MASK 0xff /end CHARACTERISTIC
/begin COMPU_METHOD CRI_mchk_IAT8_COMPU_VTAB "Verbal Table" TAB_VERB "%.0" "list" COMPU_TAB_REF CRI_mchk_IAT8_COMPU_VTAB_REF /end COMPU_METHOD
/begin COMPU_VTAB CRI_mchk_IAT8_COMPU_VTAB_REF "Verbal Table" TAB_VERB 7 0 "X" 1 "<" 2 ">" 3 "<=" 4 ">=" 5 "=" 6 "<>" DEFAULT_VALUE "UNKNOWN" /end COMPU_VTAB
/begin CHARACTERISTIC CRI_mchk_IAT9 "and IAT is{CRI_mchk_IAT9&0xff=0:X}{CRI_mchk_IAT9&0xff=1:<}{CRI_mchk_IAT9&0xff=2:>}{CRI_mchk_IAT9&0xff=3:<=}{CRI_mchk_IAT9&0xff=4:>=}{CRI_mchk_IAT9&0xff=5:=}{CRI_mchk_IAT9&0xff=6:<>}" VALUE 0x001F1A27 /* @ECU_Address@CRI_mchk_IAT9@0x0100AB40@ */ ECIPP_ALIGNMENT_UBYTE 255 CRI_mchk_IAT9_COMPU_VTAB 0 255 BIT_MASK 0xff /end CHARACTERISTIC
/begin COMPU_METHOD CRI_mchk_IAT9_COMPU_VTAB "Verbal Table" TAB_VERB "%.0" "list" COMPU_TAB_REF CRI_mchk_IAT9_COMPU_VTAB_REF /end COMPU_METHOD
/begin COMPU_VTAB CRI_mchk_IAT9_COMPU_VTAB_REF "Verbal Table" TAB_VERB 7 0 "X" 1 "<" 2 ">" 3 "<=" 4 ">=" 5 "=" 6 "<>" DEFAULT_VALUE "UNKNOWN" /end COMPU_VTAB
/begin CHARACTERISTIC CRI_mchk_DOCT0 "and DOCT is{CRI_mchk_DOCT0&0xff=0:X}{CRI_mchk_DOCT0&0xff=1:<}{CRI_mchk_DOCT0&0xff=2:>}{CRI_mchk_DOCT0&0xff=3:<=}{CRI_mchk_DOCT0&0xff=4:>=}{CRI_mchk_DOCT0&0xff=5:=}{CRI_mchk_DOCT0&0xff=6:<>}" VALUE 0x001F1A00 /* @ECU_Address@CRI_mchk_DOCT0@0x0100AB48@ */ ECIPP_ALIGNMENT_UBYTE 255 CRI_mchk_DOCT0_COMPU_VTAB 0 255 BIT_MASK 0xff /end CHARACTERISTIC
/begin COMPU_METHOD CRI_mchk_DOCT0_COMPU_VTAB "Verbal Table" TAB_VERB "%.0" "list" COMPU_TAB_REF CRI_mchk_DOCT0_COMPU_VTAB_REF /end COMPU_METHOD
/begin COMPU_VTAB CRI_mchk_DOCT0_COMPU_VTAB_REF "Verbal Table" TAB_VERB 7 0 "X" 1 "<" 2 ">" 3 "<=" 4 ">=" 5 "=" 6 "<>" DEFAULT_VALUE "UNKNOWN" /end COMPU_VTAB
/begin CHARACTERISTIC CRI_mchk_DOCT1 "and DOCT is{CRI_mchk_DOCT1&0xff=0:X}{CRI_mchk_DOCT1&0xff=1:<}{CRI_mchk_DOCT1&0xff=2:>}{CRI_mchk_DOCT1&0xff=3:<=}{CRI_mchk_DOCT1&0xff=4:>=}{CRI_mchk_DOCT1&0xff=5:=}{CRI_mchk_DOCT1&0xff=6:<>}" VALUE 0x001F1A01 /* @ECU_Address@CRI_mchk_DOCT1@0x0100AB50@ */ ECIPP_ALIGNMENT_UBYTE 255 CRI_mchk_DOCT1_COMPU_VTAB 0 255 BIT_MASK 0xff /end CHARACTERISTIC
/begin COMPU_METHOD CRI_mchk_DOCT1_COMPU_VTAB "Verbal Table" TAB_VERB "%.0" "list" COMPU_TAB_REF CRI_mchk_DOCT1_COMPU_VTAB_REF /end COMPU_METHOD
/begin COMPU_VTAB CRI_mchk_DOCT1_COMPU_VTAB_REF "Verbal Table" TAB_VERB 7 0 "X" 1 "<" 2 ">" 3 "<=" 4 ">=" 5 "=" 6 "<>" DEFAULT_VALUE "UNKNOWN" /end COMPU_VTAB
/begin CHARACTERISTIC CRI_mchk_DOCT2 "and DOCT is{CRI_mchk_DOCT2&0xff=0:X}{CRI_mchk_DOCT2&0xff=1:<}{CRI_mchk_DOCT2&0xff=2:>}{CRI_mchk_DOCT2&0xff=3:<=}{CRI_mchk_DOCT2&0xff=4:>=}{CRI_mchk_DOCT2&0xff=5:=}{CRI_mchk_DOCT2&0xff=6:<>}" VALUE 0x001F1A02 /* @ECU_Address@CRI_mchk_DOCT2@0x0100AB58@ */ ECIPP_ALIGNMENT_UBYTE 255 CRI_mchk_DOCT2_COMPU_VTAB 0 255 BIT_MASK 0xff /end CHARACTERISTIC
/begin COMPU_METHOD CRI_mchk_DOCT2_COMPU_VTAB "Verbal Table" TAB_VERB "%.0" "list" COMPU_TAB_REF CRI_mchk_DOCT2_COMPU_VTAB_REF /end COMPU_METHOD
/begin COMPU_VTAB CRI_mchk_DOCT2_COMPU_VTAB_REF "Verbal Table" TAB_VERB 7 0 "X" 1 "<" 2 ">" 3 "<=" 4 ">=" 5 "=" 6 "<>" DEFAULT_VALUE "UNKNOWN" /end COMPU_VTAB
/begin CHARACTERISTIC CRI_mchk_DOCT3 "and DOCT is{CRI_mchk_DOCT3&0xff=0:X}{CRI_mchk_DOCT3&0xff=1:<}{CRI_mchk_DOCT3&0xff=2:>}{CRI_mchk_DOCT3&0xff=3:<=}{CRI_mchk_DOCT3&0xff=4:>=}{CRI_mchk_DOCT3&0xff=5:=}{CRI_mchk_DOCT3&0xff=6:<>}" VALUE 0x001F1A03 /* @ECU_Address@CRI_mchk_DOCT3@0x0100AB60@ */ ECIPP_ALIGNMENT_UBYTE 255 CRI_mchk_DOCT3_COMPU_VTAB 0 255 BIT_MASK 0xff /end CHARACTERISTIC
/begin COMPU_METHOD CRI_mchk_DOCT3_COMPU_VTAB "Verbal Table" TAB_VERB "%.0" "list" COMPU_TAB_REF CRI_mchk_DOCT3_COMPU_VTAB_REF /end COMPU_METHOD
/begin COMPU_VTAB CRI_mchk_DOCT3_COMPU_VTAB_REF "Verbal Table" TAB_VERB 7 0 "X" 1 "<" 2 ">" 3 "<=" 4 ">=" 5 "=" 6 "<>" DEFAULT_VALUE "UNKNOWN" /end COMPU_VTAB
/begin CHARACTERISTIC CRI_mchk_DOCT4 "and DOCT is{CRI_mchk_DOCT4&0xff=0:X}{CRI_mchk_DOCT4&0xff=1:<}{CRI_mchk_DOCT4&0xff=2:>}{CRI_mchk_DOCT4&0xff=3:<=}{CRI_mchk_DOCT4&0xff=4:>=}{CRI_mchk_DOCT4&0xff=5:=}{CRI_mchk_DOCT4&0xff=6:<>}" VALUE 0x001F1A04 /* @ECU_Address@CRI_mchk_DOCT4@0x0100AB68@ */ ECIPP_ALIGNMENT_UBYTE 255 CRI_mchk_DOCT4_COMPU_VTAB 0 255 BIT_MASK 0xff /end CHARACTERISTIC
/begin COMPU_METHOD CRI_mchk_DOCT4_COMPU_VTAB "Verbal Table" TAB_VERB "%.0" "list" COMPU_TAB_REF CRI_mchk_DOCT4_COMPU_VTAB_REF /end COMPU_METHOD
/begin COMPU_VTAB CRI_mchk_DOCT4_COMPU_VTAB_REF "Verbal Table" TAB_VERB 7 0 "X" 1 "<" 2 ">" 3 "<=" 4 ">=" 5 "=" 6 "<>" DEFAULT_VALUE "UNKNOWN" /end COMPU_VTAB
/begin CHARACTERISTIC CRI_mchk_DOCT5 "and DOCT is{CRI_mchk_DOCT5&0xff=0:X}{CRI_mchk_DOCT5&0xff=1:<}{CRI_mchk_DOCT5&0xff=2:>}{CRI_mchk_DOCT5&0xff=3:<=}{CRI_mchk_DOCT5&0xff=4:>=}{CRI_mchk_DOCT5&0xff=5:=}{CRI_mchk_DOCT5&0xff=6:<>}" VALUE 0x001F1A05 /* @ECU_Address@CRI_mchk_DOCT5@0x0100AB70@ */ ECIPP_ALIGNMENT_UBYTE 255 CRI_mchk_DOCT5_COMPU_VTAB 0 255 BIT_MASK 0xff /end CHARACTERISTIC
/begin COMPU_METHOD CRI_mchk_DOCT5_COMPU_VTAB "Verbal Table" TAB_VERB "%.0" "list" COMPU_TAB_REF CRI_mchk_DOCT5_COMPU_VTAB_REF /end COMPU_METHOD
/begin COMPU_VTAB CRI_mchk_DOCT5_COMPU_VTAB_REF "Verbal Table" TAB_VERB 7 0 "X" 1 "<" 2 ">" 3 "<=" 4 ">=" 5 "=" 6 "<>" DEFAULT_VALUE "UNKNOWN" /end COMPU_VTAB
/begin CHARACTERISTIC CRI_mchk_DOCT6 "and DOCT is{CRI_mchk_DOCT6&0xff=0:X}{CRI_mchk_DOCT6&0xff=1:<}{CRI_mchk_DOCT6&0xff=2:>}{CRI_mchk_DOCT6&0xff=3:<=}{CRI_mchk_DOCT6&0xff=4:>=}{CRI_mchk_DOCT6&0xff=5:=}{CRI_mchk_DOCT6&0xff=6:<>}" VALUE 0x001F1A06 /* @ECU_Address@CRI_mchk_DOCT6@0x0100AB78@ */ ECIPP_ALIGNMENT_UBYTE 255 CRI_mchk_DOCT6_COMPU_VTAB 0 255 BIT_MASK 0xff /end CHARACTERISTIC
/begin COMPU_METHOD CRI_mchk_DOCT6_COMPU_VTAB "Verbal Table" TAB_VERB "%.0" "list" COMPU_TAB_REF CRI_mchk_DOCT6_COMPU_VTAB_REF /end COMPU_METHOD
/begin COMPU_VTAB CRI_mchk_DOCT6_COMPU_VTAB_REF "Verbal Table" TAB_VERB 7 0 "X" 1 "<" 2 ">" 3 "<=" 4 ">=" 5 "=" 6 "<>" DEFAULT_VALUE "UNKNOWN" /end COMPU_VTAB
/begin CHARACTERISTIC CRI_mchk_DOCT7 "and DOCT is{CRI_mchk_DOCT7&0xff=0:X}{CRI_mchk_DOCT7&0xff=1:<}{CRI_mchk_DOCT7&0xff=2:>}{CRI_mchk_DOCT7&0xff=3:<=}{CRI_mchk_DOCT7&0xff=4:>=}{CRI_mchk_DOCT7&0xff=5:=}{CRI_mchk_DOCT7&0xff=6:<>}" VALUE 0x001F1A07 /* @ECU_Address@CRI_mchk_DOCT7@0x0100AB80@ */ ECIPP_ALIGNMENT_UBYTE 255 CRI_mchk_DOCT7_COMPU_VTAB 0 255 BIT_MASK 0xff /end CHARACTERISTIC
/begin COMPU_METHOD CRI_mchk_DOCT7_COMPU_VTAB "Verbal Table" TAB_VERB "%.0" "list" COMPU_TAB_REF CRI_mchk_DOCT7_COMPU_VTAB_REF /end COMPU_METHOD
/begin COMPU_VTAB CRI_mchk_DOCT7_COMPU_VTAB_REF "Verbal Table" TAB_VERB 7 0 "X" 1 "<" 2 ">" 3 "<=" 4 ">=" 5 "=" 6 "<>" DEFAULT_VALUE "UNKNOWN" /end COMPU_VTAB
/begin CHARACTERISTIC CRI_mchk_DOCT8 "and DOCT is{CRI_mchk_DOCT8&0xff=0:X}{CRI_mchk_DOCT8&0xff=1:<}{CRI_mchk_DOCT8&0xff=2:>}{CRI_mchk_DOCT8&0xff=3:<=}{CRI_mchk_DOCT8&0xff=4:>=}{CRI_mchk_DOCT8&0xff=5:=}{CRI_mchk_DOCT8&0xff=6:<>}" VALUE 0x001F1A08 /* @ECU_Address@CRI_mchk_DOCT8@0x0100AB88@ */ ECIPP_ALIGNMENT_UBYTE 255 CRI_mchk_DOCT8_COMPU_VTAB 0 255 BIT_MASK 0xff /end CHARACTERISTIC
/begin COMPU_METHOD CRI_mchk_DOCT8_COMPU_VTAB "Verbal Table" TAB_VERB "%.0" "list" COMPU_TAB_REF CRI_mchk_DOCT8_COMPU_VTAB_REF /end COMPU_METHOD
/begin COMPU_VTAB CRI_mchk_DOCT8_COMPU_VTAB_REF "Verbal Table" TAB_VERB 7 0 "X" 1 "<" 2 ">" 3 "<=" 4 ">=" 5 "=" 6 "<>" DEFAULT_VALUE "UNKNOWN" /end COMPU_VTAB
/begin CHARACTERISTIC CRI_mchk_DOCT9 "and DOCT is{CRI_mchk_DOCT9&0xff=0:X}{CRI_mchk_DOCT9&0xff=1:<}{CRI_mchk_DOCT9&0xff=2:>}{CRI_mchk_DOCT9&0xff=3:<=}{CRI_mchk_DOCT9&0xff=4:>=}{CRI_mchk_DOCT9&0xff=5:=}{CRI_mchk_DOCT9&0xff=6:<>}" VALUE 0x001F1A09 /* @ECU_Address@CRI_mchk_DOCT9@0x0100AB90@ */ ECIPP_ALIGNMENT_UBYTE 255 CRI_mchk_DOCT9_COMPU_VTAB 0 255 BIT_MASK 0xff /end CHARACTERISTIC
/begin COMPU_METHOD CRI_mchk_DOCT9_COMPU_VTAB "Verbal Table" TAB_VERB "%.0" "list" COMPU_TAB_REF CRI_mchk_DOCT9_COMPU_VTAB_REF /end COMPU_METHOD
/begin COMPU_VTAB CRI_mchk_DOCT9_COMPU_VTAB_REF "Verbal Table" TAB_VERB 7 0 "X" 1 "<" 2 ">" 3 "<=" 4 ">=" 5 "=" 6 "<>" DEFAULT_VALUE "UNKNOWN" /end COMPU_VTAB
/begin CHARACTERISTIC CRI_mchk_DPFT0 "and DPFT is{CRI_mchk_DPFT0&0xff=0:X}{CRI_mchk_DPFT0&0xff=1:<}{CRI_mchk_DPFT0&0xff=2:>}{CRI_mchk_DPFT0&0xff=3:<=}{CRI_mchk_DPFT0&0xff=4:>=}{CRI_mchk_DPFT0&0xff=5:=}{CRI_mchk_DPFT0&0xff=6:<>}" VALUE 0x001F1A0A /* @ECU_Address@CRI_mchk_DPFT0@0x0100AB98@ */ ECIPP_ALIGNMENT_UBYTE 255 CRI_mchk_DPFT0_COMPU_VTAB 0 255 BIT_MASK 0xff /end CHARACTERISTIC
/begin COMPU_METHOD CRI_mchk_DPFT0_COMPU_VTAB "Verbal Table" TAB_VERB "%.0" "list" COMPU_TAB_REF CRI_mchk_DPFT0_COMPU_VTAB_REF /end COMPU_METHOD
/begin COMPU_VTAB CRI_mchk_DPFT0_COMPU_VTAB_REF "Verbal Table" TAB_VERB 7 0 "X" 1 "<" 2 ">" 3 "<=" 4 ">=" 5 "=" 6 "<>" DEFAULT_VALUE "UNKNOWN" /end COMPU_VTAB
/begin CHARACTERISTIC CRI_mchk_DPFT1 "and DPFT is{CRI_mchk_DPFT1&0xff=0:X}{CRI_mchk_DPFT1&0xff=1:<}{CRI_mchk_DPFT1&0xff=2:>}{CRI_mchk_DPFT1&0xff=3:<=}{CRI_mchk_DPFT1&0xff=4:>=}{CRI_mchk_DPFT1&0xff=5:=}{CRI_mchk_DPFT1&0xff=6:<>}" VALUE 0x001F1A0B /* @ECU_Address@CRI_mchk_DPFT1@0x0100ABA0@ */ ECIPP_ALIGNMENT_UBYTE 255 CRI_mchk_DPFT1_COMPU_VTAB 0 255 BIT_MASK 0xff /end CHARACTERISTIC
/begin COMPU_METHOD CRI_mchk_DPFT1_COMPU_VTAB "Verbal Table" TAB_VERB "%.0" "list" COMPU_TAB_REF CRI_mchk_DPFT1_COMPU_VTAB_REF /end COMPU_METHOD
/begin COMPU_VTAB CRI_mchk_DPFT1_COMPU_VTAB_REF "Verbal Table" TAB_VERB 7 0 "X" 1 "<" 2 ">" 3 "<=" 4 ">=" 5 "=" 6 "<>" DEFAULT_VALUE "UNKNOWN" /end COMPU_VTAB
/begin CHARACTERISTIC CRI_mchk_DPFT2 "and DPFT is{CRI_mchk_DPFT2&0xff=0:X}{CRI_mchk_DPFT2&0xff=1:<}{CRI_mchk_DPFT2&0xff=2:>}{CRI_mchk_DPFT2&0xff=3:<=}{CRI_mchk_DPFT2&0xff=4:>=}{CRI_mchk_DPFT2&0xff=5:=}{CRI_mchk_DPFT2&0xff=6:<>}" VALUE 0x001F1A0C /* @ECU_Address@CRI_mchk_DPFT2@0x0100ABA8@ */ ECIPP_ALIGNMENT_UBYTE 255 CRI_mchk_DPFT2_COMPU_VTAB 0 255 BIT_MASK 0xff /end CHARACTERISTIC
/begin COMPU_METHOD CRI_mchk_DPFT2_COMPU_VTAB "Verbal Table" TAB_VERB "%.0" "list" COMPU_TAB_REF CRI_mchk_DPFT2_COMPU_VTAB_REF /end COMPU_METHOD
/begin COMPU_VTAB CRI_mchk_DPFT2_COMPU_VTAB_REF "Verbal Table" TAB_VERB 7 0 "X" 1 "<" 2 ">" 3 "<=" 4 ">=" 5 "=" 6 "<>" DEFAULT_VALUE "UNKNOWN" /end COMPU_VTAB
/begin CHARACTERISTIC CRI_mchk_DPFT3 "and DPFT is{CRI_mchk_DPFT3&0xff=0:X}{CRI_mchk_DPFT3&0xff=1:<}{CRI_mchk_DPFT3&0xff=2:>}{CRI_mchk_DPFT3&0xff=3:<=}{CRI_mchk_DPFT3&0xff=4:>=}{CRI_mchk_DPFT3&0xff=5:=}{CRI_mchk_DPFT3&0xff=6:<>}" VALUE 0x001F1A0D /* @ECU_Address@CRI_mchk_DPFT3@0x0100ABB0@ */ ECIPP_ALIGNMENT_UBYTE 255 CRI_mchk_DPFT3_COMPU_VTAB 0 255 BIT_MASK 0xff /end CHARACTERISTIC
/begin COMPU_METHOD CRI_mchk_DPFT3_COMPU_VTAB "Verbal Table" TAB_VERB "%.0" "list" COMPU_TAB_REF CRI_mchk_DPFT3_COMPU_VTAB_REF /end COMPU_METHOD
/begin COMPU_VTAB CRI_mchk_DPFT3_COMPU_VTAB_REF "Verbal Table" TAB_VERB 7 0 "X" 1 "<" 2 ">" 3 "<=" 4 ">=" 5 "=" 6 "<>" DEFAULT_VALUE "UNKNOWN" /end COMPU_VTAB
/begin CHARACTERISTIC CRI_mchk_DPFT4 "and DPFT is{CRI_mchk_DPFT4&0xff=0:X}{CRI_mchk_DPFT4&0xff=1:<}{CRI_mchk_DPFT4&0xff=2:>}{CRI_mchk_DPFT4&0xff=3:<=}{CRI_mchk_DPFT4&0xff=4:>=}{CRI_mchk_DPFT4&0xff=5:=}{CRI_mchk_DPFT4&0xff=6:<>}" VALUE 0x001F1A0E /* @ECU_Address@CRI_mchk_DPFT4@0x0100ABB8@ */ ECIPP_ALIGNMENT_UBYTE 255 CRI_mchk_DPFT4_COMPU_VTAB 0 255 BIT_MASK 0xff /end CHARACTERISTIC
/begin COMPU_METHOD CRI_mchk_DPFT4_COMPU_VTAB "Verbal Table" TAB_VERB "%.0" "list" COMPU_TAB_REF CRI_mchk_DPFT4_COMPU_VTAB_REF /end COMPU_METHOD
/begin COMPU_VTAB CRI_mchk_DPFT4_COMPU_VTAB_REF "Verbal Table" TAB_VERB 7 0 "X" 1 "<" 2 ">" 3 "<=" 4 ">=" 5 "=" 6 "<>" DEFAULT_VALUE "UNKNOWN" /end COMPU_VTAB
/begin CHARACTERISTIC CRI_mchk_DPFT5 "and DPFT is{CRI_mchk_DPFT5&0xff=0:X}{CRI_mchk_DPFT5&0xff=1:<}{CRI_mchk_DPFT5&0xff=2:>}{CRI_mchk_DPFT5&0xff=3:<=}{CRI_mchk_DPFT5&0xff=4:>=}{CRI_mchk_DPFT5&0xff=5:=}{CRI_mchk_DPFT5&0xff=6:<>}" VALUE 0x001F1A0F /* @ECU_Address@CRI_mchk_DPFT5@0x0100ABC0@ */ ECIPP_ALIGNMENT_UBYTE 255 CRI_mchk_DPFT5_COMPU_VTAB 0 255 BIT_MASK 0xff /end CHARACTERISTIC
/begin COMPU_METHOD CRI_mchk_DPFT5_COMPU_VTAB "Verbal Table" TAB_VERB "%.0" "list" COMPU_TAB_REF CRI_mchk_DPFT5_COMPU_VTAB_REF /end COMPU_METHOD
/begin COMPU_VTAB CRI_mchk_DPFT5_COMPU_VTAB_REF "Verbal Table" TAB_VERB 7 0 "X" 1 "<" 2 ">" 3 "<=" 4 ">=" 5 "=" 6 "<>" DEFAULT_VALUE "UNKNOWN" /end COMPU_VTAB
/begin CHARACTERISTIC CRI_mchk_DPFT6 "and DPFT is{CRI_mchk_DPFT6&0xff=0:X}{CRI_mchk_DPFT6&0xff=1:<}{CRI_mchk_DPFT6&0xff=2:>}{CRI_mchk_DPFT6&0xff=3:<=}{CRI_mchk_DPFT6&0xff=4:>=}{CRI_mchk_DPFT6&0xff=5:=}{CRI_mchk_DPFT6&0xff=6:<>}" VALUE 0x001F1A10 /* @ECU_Address@CRI_mchk_DPFT6@0x0100ABC8@ */ ECIPP_ALIGNMENT_UBYTE 255 CRI_mchk_DPFT6_COMPU_VTAB 0 255 BIT_MASK 0xff /end CHARACTERISTIC
/begin COMPU_METHOD CRI_mchk_DPFT6_COMPU_VTAB "Verbal Table" TAB_VERB "%.0" "list" COMPU_TAB_REF CRI_mchk_DPFT6_COMPU_VTAB_REF /end COMPU_METHOD
/begin COMPU_VTAB CRI_mchk_DPFT6_COMPU_VTAB_REF "Verbal Table" TAB_VERB 7 0 "X" 1 "<" 2 ">" 3 "<=" 4 ">=" 5 "=" 6 "<>" DEFAULT_VALUE "UNKNOWN" /end COMPU_VTAB
/begin CHARACTERISTIC CRI_mchk_DPFT7 "and DPFT is{CRI_mchk_DPFT7&0xff=0:X}{CRI_mchk_DPFT7&0xff=1:<}{CRI_mchk_DPFT7&0xff=2:>}{CRI_mchk_DPFT7&0xff=3:<=}{CRI_mchk_DPFT7&0xff=4:>=}{CRI_mchk_DPFT7&0xff=5:=}{CRI_mchk_DPFT7&0xff=6:<>}" VALUE 0x001F1A11 /* @ECU_Address@CRI_mchk_DPFT7@0x0100ABD0@ */ ECIPP_ALIGNMENT_UBYTE 255 CRI_mchk_DPFT7_COMPU_VTAB 0 255 BIT_MASK 0xff /end CHARACTERISTIC
/begin COMPU_METHOD CRI_mchk_DPFT7_COMPU_VTAB "Verbal Table" TAB_VERB "%.0" "list" COMPU_TAB_REF CRI_mchk_DPFT7_COMPU_VTAB_REF /end COMPU_METHOD
/begin COMPU_VTAB CRI_mchk_DPFT7_COMPU_VTAB_REF "Verbal Table" TAB_VERB 7 0 "X" 1 "<" 2 ">" 3 "<=" 4 ">=" 5 "=" 6 "<>" DEFAULT_VALUE "UNKNOWN" /end COMPU_VTAB
/begin CHARACTERISTIC CRI_mchk_DPFT8 "and DPFT is{CRI_mchk_DPFT8&0xff=0:X}{CRI_mchk_DPFT8&0xff=1:<}{CRI_mchk_DPFT8&0xff=2:>}{CRI_mchk_DPFT8&0xff=3:<=}{CRI_mchk_DPFT8&0xff=4:>=}{CRI_mchk_DPFT8&0xff=5:=}{CRI_mchk_DPFT8&0xff=6:<>}" VALUE 0x001F1A12 /* @ECU_Address@CRI_mchk_DPFT8@0x0100ABD8@ */ ECIPP_ALIGNMENT_UBYTE 255 CRI_mchk_DPFT8_COMPU_VTAB 0 255 BIT_MASK 0xff /end CHARACTERISTIC
/begin COMPU_METHOD CRI_mchk_DPFT8_COMPU_VTAB "Verbal Table" TAB_VERB "%.0" "list" COMPU_TAB_REF CRI_mchk_DPFT8_COMPU_VTAB_REF /end COMPU_METHOD
/begin COMPU_VTAB CRI_mchk_DPFT8_COMPU_VTAB_REF "Verbal Table" TAB_VERB 7 0 "X" 1 "<" 2 ">" 3 "<=" 4 ">=" 5 "=" 6 "<>" DEFAULT_VALUE "UNKNOWN" /end COMPU_VTAB
/begin CHARACTERISTIC CRI_mchk_DPFT9 "and DPFT is{CRI_mchk_DPFT9&0xff=0:X}{CRI_mchk_DPFT9&0xff=1:<}{CRI_mchk_DPFT9&0xff=2:>}{CRI_mchk_DPFT9&0xff=3:<=}{CRI_mchk_DPFT9&0xff=4:>=}{CRI_mchk_DPFT9&0xff=5:=}{CRI_mchk_DPFT9&0xff=6:<>}" VALUE 0x001F1A13 /* @ECU_Address@CRI_mchk_DPFT9@0x0100ABE0@ */ ECIPP_ALIGNMENT_UBYTE 255 CRI_mchk_DPFT9_COMPU_VTAB 0 255 BIT_MASK 0xff /end CHARACTERISTIC
/begin COMPU_METHOD CRI_mchk_DPFT9_COMPU_VTAB "Verbal Table" TAB_VERB "%.0" "list" COMPU_TAB_REF CRI_mchk_DPFT9_COMPU_VTAB_REF /end COMPU_METHOD
/begin COMPU_VTAB CRI_mchk_DPFT9_COMPU_VTAB_REF "Verbal Table" TAB_VERB 7 0 "X" 1 "<" 2 ">" 3 "<=" 4 ">=" 5 "=" 6 "<>" DEFAULT_VALUE "UNKNOWN" /end COMPU_VTAB
/begin CHARACTERISTIC CRI_mchk_soot0 "and soot loading is{CRI_mchk_soot0&0xff=0:X}{CRI_mchk_soot0&0xff=1:<}{CRI_mchk_soot0&0xff=2:>}{CRI_mchk_soot0&0xff=3:<=}{CRI_mchk_soot0&0xff=4:>=}{CRI_mchk_soot0&0xff=5:=}{CRI_mchk_soot0&0xff=6:<>}" VALUE 0x001F1A3C /* @ECU_Address@CRI_mchk_soot0@0x0100ABE8@ */ ECIPP_ALIGNMENT_UBYTE 255 CRI_mchk_soot0_COMPU_VTAB 0 255 BIT_MASK 0xff /end CHARACTERISTIC
/begin COMPU_METHOD CRI_mchk_soot0_COMPU_VTAB "Verbal Table" TAB_VERB "%.0" "list" COMPU_TAB_REF CRI_mchk_soot0_COMPU_VTAB_REF /end COMPU_METHOD
/begin COMPU_VTAB CRI_mchk_soot0_COMPU_VTAB_REF "Verbal Table" TAB_VERB 7 0 "X" 1 "<" 2 ">" 3 "<=" 4 ">=" 5 "=" 6 "<>" DEFAULT_VALUE "UNKNOWN" /end COMPU_VTAB
/begin CHARACTERISTIC CRI_mchk_soot1 "and soot loading is{CRI_mchk_soot1&0xff=0:X}{CRI_mchk_soot1&0xff=1:<}{CRI_mchk_soot1&0xff=2:>}{CRI_mchk_soot1&0xff=3:<=}{CRI_mchk_soot1&0xff=4:>=}{CRI_mchk_soot1&0xff=5:=}{CRI_mchk_soot1&0xff=6:<>}" VALUE 0x001F1A3D /* @ECU_Address@CRI_mchk_soot1@0x0100ABF0@ */ ECIPP_ALIGNMENT_UBYTE 255 CRI_mchk_soot1_COMPU_VTAB 0 255 BIT_MASK 0xff /end CHARACTERISTIC
/begin COMPU_METHOD CRI_mchk_soot1_COMPU_VTAB "Verbal Table" TAB_VERB "%.0" "list" COMPU_TAB_REF CRI_mchk_soot1_COMPU_VTAB_REF /end COMPU_METHOD
/begin COMPU_VTAB CRI_mchk_soot1_COMPU_VTAB_REF "Verbal Table" TAB_VERB 7 0 "X" 1 "<" 2 ">" 3 "<=" 4 ">=" 5 "=" 6 "<>" DEFAULT_VALUE "UNKNOWN" /end COMPU_VTAB
/begin CHARACTERISTIC CRI_mchk_soot2 "and soot loading is{CRI_mchk_soot2&0xff=0:X}{CRI_mchk_soot2&0xff=1:<}{CRI_mchk_soot2&0xff=2:>}{CRI_mchk_soot2&0xff=3:<=}{CRI_mchk_soot2&0xff=4:>=}{CRI_mchk_soot2&0xff=5:=}{CRI_mchk_soot2&0xff=6:<>}" VALUE 0x001F1A3E /* @ECU_Address@CRI_mchk_soot2@0x0100ABF8@ */ ECIPP_ALIGNMENT_UBYTE 255 CRI_mchk_soot2_COMPU_VTAB 0 255 BIT_MASK 0xff /end CHARACTERISTIC
/begin COMPU_METHOD CRI_mchk_soot2_COMPU_VTAB "Verbal Table" TAB_VERB "%.0" "list" COMPU_TAB_REF CRI_mchk_soot2_COMPU_VTAB_REF /end COMPU_METHOD
/begin COMPU_VTAB CRI_mchk_soot2_COMPU_VTAB_REF "Verbal Table" TAB_VERB 7 0 "X" 1 "<" 2 ">" 3 "<=" 4 ">=" 5 "=" 6 "<>" DEFAULT_VALUE "UNKNOWN" /end COMPU_VTAB
/begin CHARACTERISTIC CRI_mchk_soot3 "and soot loading is{CRI_mchk_soot3&0xff=0:X}{CRI_mchk_soot3&0xff=1:<}{CRI_mchk_soot3&0xff=2:>}{CRI_mchk_soot3&0xff=3:<=}{CRI_mchk_soot3&0xff=4:>=}{CRI_mchk_soot3&0xff=5:=}{CRI_mchk_soot3&0xff=6:<>}" VALUE 0x001F1A3F /* @ECU_Address@CRI_mchk_soot3@0x0100AC00@ */ ECIPP_ALIGNMENT_UBYTE 255 CRI_mchk_soot3_COMPU_VTAB 0 255 BIT_MASK 0xff /end CHARACTERISTIC
/begin COMPU_METHOD CRI_mchk_soot3_COMPU_VTAB "Verbal Table" TAB_VERB "%.0" "list" COMPU_TAB_REF CRI_mchk_soot3_COMPU_VTAB_REF /end COMPU_METHOD
/begin COMPU_VTAB CRI_mchk_soot3_COMPU_VTAB_REF "Verbal Table" TAB_VERB 7 0 "X" 1 "<" 2 ">" 3 "<=" 4 ">=" 5 "=" 6 "<>" DEFAULT_VALUE "UNKNOWN" /end COMPU_VTAB
/begin CHARACTERISTIC CRI_mchk_soot4 "and soot loading is{CRI_mchk_soot4&0xff=0:X}{CRI_mchk_soot4&0xff=1:<}{CRI_mchk_soot4&0xff=2:>}{CRI_mchk_soot4&0xff=3:<=}{CRI_mchk_soot4&0xff=4:>=}{CRI_mchk_soot4&0xff=5:=}{CRI_mchk_soot4&0xff=6:<>}" VALUE 0x001F1A40 /* @ECU_Address@CRI_mchk_soot4@0x0100AC08@ */ ECIPP_ALIGNMENT_UBYTE 255 CRI_mchk_soot4_COMPU_VTAB 0 255 BIT_MASK 0xff /end CHARACTERISTIC
/begin COMPU_METHOD CRI_mchk_soot4_COMPU_VTAB "Verbal Table" TAB_VERB "%.0" "list" COMPU_TAB_REF CRI_mchk_soot4_COMPU_VTAB_REF /end COMPU_METHOD
/begin COMPU_VTAB CRI_mchk_soot4_COMPU_VTAB_REF "Verbal Table" TAB_VERB 7 0 "X" 1 "<" 2 ">" 3 "<=" 4 ">=" 5 "=" 6 "<>" DEFAULT_VALUE "UNKNOWN" /end COMPU_VTAB
/begin CHARACTERISTIC CRI_mchk_soot5 "and soot loading is{CRI_mchk_soot5&0xff=0:X}{CRI_mchk_soot5&0xff=1:<}{CRI_mchk_soot5&0xff=2:>}{CRI_mchk_soot5&0xff=3:<=}{CRI_mchk_soot5&0xff=4:>=}{CRI_mchk_soot5&0xff=5:=}{CRI_mchk_soot5&0xff=6:<>}" VALUE 0x001F1A41 /* @ECU_Address@CRI_mchk_soot5@0x0100AC10@ */ ECIPP_ALIGNMENT_UBYTE 255 CRI_mchk_soot5_COMPU_VTAB 0 255 BIT_MASK 0xff /end CHARACTERISTIC
/begin COMPU_METHOD CRI_mchk_soot5_COMPU_VTAB "Verbal Table" TAB_VERB "%.0" "list" COMPU_TAB_REF CRI_mchk_soot5_COMPU_VTAB_REF /end COMPU_METHOD
/begin COMPU_VTAB CRI_mchk_soot5_COMPU_VTAB_REF "Verbal Table" TAB_VERB 7 0 "X" 1 "<" 2 ">" 3 "<=" 4 ">=" 5 "=" 6 "<>" DEFAULT_VALUE "UNKNOWN" /end COMPU_VTAB
/begin CHARACTERISTIC CRI_mchk_soot6 "and soot loading is{CRI_mchk_soot6&0xff=0:X}{CRI_mchk_soot6&0xff=1:<}{CRI_mchk_soot6&0xff=2:>}{CRI_mchk_soot6&0xff=3:<=}{CRI_mchk_soot6&0xff=4:>=}{CRI_mchk_soot6&0xff=5:=}{CRI_mchk_soot6&0xff=6:<>}" VALUE 0x001F1A42 /* @ECU_Address@CRI_mchk_soot6@0x0100AC18@ */ ECIPP_ALIGNMENT_UBYTE 255 CRI_mchk_soot6_COMPU_VTAB 0 255 BIT_MASK 0xff /end CHARACTERISTIC
/begin COMPU_METHOD CRI_mchk_soot6_COMPU_VTAB "Verbal Table" TAB_VERB "%.0" "list" COMPU_TAB_REF CRI_mchk_soot6_COMPU_VTAB_REF /end COMPU_METHOD
/begin COMPU_VTAB CRI_mchk_soot6_COMPU_VTAB_REF "Verbal Table" TAB_VERB 7 0 "X" 1 "<" 2 ">" 3 "<=" 4 ">=" 5 "=" 6 "<>" DEFAULT_VALUE "UNKNOWN" /end COMPU_VTAB
/begin CHARACTERISTIC CRI_mchk_soot7 "and soot loading is{CRI_mchk_soot7&0xff=0:X}{CRI_mchk_soot7&0xff=1:<}{CRI_mchk_soot7&0xff=2:>}{CRI_mchk_soot7&0xff=3:<=}{CRI_mchk_soot7&0xff=4:>=}{CRI_mchk_soot7&0xff=5:=}{CRI_mchk_soot7&0xff=6:<>}" VALUE 0x001F1A43 /* @ECU_Address@CRI_mchk_soot7@0x0100AC20@ */ ECIPP_ALIGNMENT_UBYTE 255 CRI_mchk_soot7_COMPU_VTAB 0 255 BIT_MASK 0xff /end CHARACTERISTIC
/begin COMPU_METHOD CRI_mchk_soot7_COMPU_VTAB "Verbal Table" TAB_VERB "%.0" "list" COMPU_TAB_REF CRI_mchk_soot7_COMPU_VTAB_REF /end COMPU_METHOD
/begin COMPU_VTAB CRI_mchk_soot7_COMPU_VTAB_REF "Verbal Table" TAB_VERB 7 0 "X" 1 "<" 2 ">" 3 "<=" 4 ">=" 5 "=" 6 "<>" DEFAULT_VALUE "UNKNOWN" /end COMPU_VTAB
/begin CHARACTERISTIC CRI_mchk_soot8 "and soot loading is{CRI_mchk_soot8&0xff=0:X}{CRI_mchk_soot8&0xff=1:<}{CRI_mchk_soot8&0xff=2:>}{CRI_mchk_soot8&0xff=3:<=}{CRI_mchk_soot8&0xff=4:>=}{CRI_mchk_soot8&0xff=5:=}{CRI_mchk_soot8&0xff=6:<>}" VALUE 0x001F1A44 /* @ECU_Address@CRI_mchk_soot8@0x0100AC28@ */ ECIPP_ALIGNMENT_UBYTE 255 CRI_mchk_soot8_COMPU_VTAB 0 255 BIT_MASK 0xff /end CHARACTERISTIC
/begin COMPU_METHOD CRI_mchk_soot8_COMPU_VTAB "Verbal Table" TAB_VERB "%.0" "list" COMPU_TAB_REF CRI_mchk_soot8_COMPU_VTAB_REF /end COMPU_METHOD
/begin COMPU_VTAB CRI_mchk_soot8_COMPU_VTAB_REF "Verbal Table" TAB_VERB 7 0 "X" 1 "<" 2 ">" 3 "<=" 4 ">=" 5 "=" 6 "<>" DEFAULT_VALUE "UNKNOWN" /end COMPU_VTAB
/begin CHARACTERISTIC CRI_mchk_soot9 "and soot loading is{CRI_mchk_soot9&0xff=0:X}{CRI_mchk_soot9&0xff=1:<}{CRI_mchk_soot9&0xff=2:>}{CRI_mchk_soot9&0xff=3:<=}{CRI_mchk_soot9&0xff=4:>=}{CRI_mchk_soot9&0xff=5:=}{CRI_mchk_soot9&0xff=6:<>}" VALUE 0x001F1A45 /* @ECU_Address@CRI_mchk_soot9@0x0100AC30@ */ ECIPP_ALIGNMENT_UBYTE 255 CRI_mchk_soot9_COMPU_VTAB 0 255 BIT_MASK 0xff /end CHARACTERISTIC
/begin COMPU_METHOD CRI_mchk_soot9_COMPU_VTAB "Verbal Table" TAB_VERB "%.0" "list" COMPU_TAB_REF CRI_mchk_soot9_COMPU_VTAB_REF /end COMPU_METHOD
/begin COMPU_VTAB CRI_mchk_soot9_COMPU_VTAB_REF "Verbal Table" TAB_VERB 7 0 "X" 1 "<" 2 ">" 3 "<=" 4 ">=" 5 "=" 6 "<>" DEFAULT_VALUE "UNKNOWN" /end COMPU_VTAB
/begin CHARACTERISTIC CRI_mchk_RS_speed0 "and vehicle speed is{CRI_mchk_RS_speed0&0xff=0:X}{CRI_mchk_RS_speed0&0xff=1:<}{CRI_mchk_RS_speed0&0xff=2:>}{CRI_mchk_RS_speed0&0xff=3:<=}{CRI_mchk_RS_speed0&0xff=4:>=}{CRI_mchk_RS_speed0&0xff=5:=}{CRI_mchk_RS_speed0&0xff=6:<>}" VALUE 0x001F1A32 /* @ECU_Address@CRI_mchk_RS_speed0@0x0100AC38@ */ ECIPP_ALIGNMENT_UBYTE 255 CRI_mchk_RS_speed0_COMPU_VTAB 0 255 BIT_MASK 0xff /end CHARACTERISTIC
/begin COMPU_METHOD CRI_mchk_RS_speed0_COMPU_VTAB "Verbal Table" TAB_VERB "%.0" "list" COMPU_TAB_REF CRI_mchk_RS_speed0_COMPU_VTAB_REF /end COMPU_METHOD
/begin COMPU_VTAB CRI_mchk_RS_speed0_COMPU_VTAB_REF "Verbal Table" TAB_VERB 7 0 "X" 1 "<" 2 ">" 3 "<=" 4 ">=" 5 "=" 6 "<>" DEFAULT_VALUE "UNKNOWN" /end COMPU_VTAB
/begin CHARACTERISTIC CRI_mchk_RS_speed1 "and vehicle speed is{CRI_mchk_RS_speed1&0xff=0:X}{CRI_mchk_RS_speed1&0xff=1:<}{CRI_mchk_RS_speed1&0xff=2:>}{CRI_mchk_RS_speed1&0xff=3:<=}{CRI_mchk_RS_speed1&0xff=4:>=}{CRI_mchk_RS_speed1&0xff=5:=}{CRI_mchk_RS_speed1&0xff=6:<>}" VALUE 0x001F1A33 /* @ECU_Address@CRI_mchk_RS_speed1@0x0100AC40@ */ ECIPP_ALIGNMENT_UBYTE 255 CRI_mchk_RS_speed1_COMPU_VTAB 0 255 BIT_MASK 0xff /end CHARACTERISTIC
/begin COMPU_METHOD CRI_mchk_RS_speed1_COMPU_VTAB "Verbal Table" TAB_VERB "%.0" "list" COMPU_TAB_REF CRI_mchk_RS_speed1_COMPU_VTAB_REF /end COMPU_METHOD
/begin COMPU_VTAB CRI_mchk_RS_speed1_COMPU_VTAB_REF "Verbal Table" TAB_VERB 7 0 "X" 1 "<" 2 ">" 3 "<=" 4 ">=" 5 "=" 6 "<>" DEFAULT_VALUE "UNKNOWN" /end COMPU_VTAB
/begin CHARACTERISTIC CRI_mchk_RS_speed2 "and vehicle speed is{CRI_mchk_RS_speed2&0xff=0:X}{CRI_mchk_RS_speed2&0xff=1:<}{CRI_mchk_RS_speed2&0xff=2:>}{CRI_mchk_RS_speed2&0xff=3:<=}{CRI_mchk_RS_speed2&0xff=4:>=}{CRI_mchk_RS_speed2&0xff=5:=}{CRI_mchk_RS_speed2&0xff=6:<>}" VALUE 0x001F1A34 /* @ECU_Address@CRI_mchk_RS_speed2@0x0100AC48@ */ ECIPP_ALIGNMENT_UBYTE 255 CRI_mchk_RS_speed2_COMPU_VTAB 0 255 BIT_MASK 0xff /end CHARACTERISTIC
/begin COMPU_METHOD CRI_mchk_RS_speed2_COMPU_VTAB "Verbal Table" TAB_VERB "%.0" "list" COMPU_TAB_REF CRI_mchk_RS_speed2_COMPU_VTAB_REF /end COMPU_METHOD
/begin COMPU_VTAB CRI_mchk_RS_speed2_COMPU_VTAB_REF "Verbal Table" TAB_VERB 7 0 "X" 1 "<" 2 ">" 3 "<=" 4 ">=" 5 "=" 6 "<>" DEFAULT_VALUE "UNKNOWN" /end COMPU_VTAB
/begin CHARACTERISTIC CRI_mchk_RS_speed3 "and vehicle speed is{CRI_mchk_RS_speed3&0xff=0:X}{CRI_mchk_RS_speed3&0xff=1:<}{CRI_mchk_RS_speed3&0xff=2:>}{CRI_mchk_RS_speed3&0xff=3:<=}{CRI_mchk_RS_speed3&0xff=4:>=}{CRI_mchk_RS_speed3&0xff=5:=}{CRI_mchk_RS_speed3&0xff=6:<>}" VALUE 0x001F1A35 /* @ECU_Address@CRI_mchk_RS_speed3@0x0100AC50@ */ ECIPP_ALIGNMENT_UBYTE 255 CRI_mchk_RS_speed3_COMPU_VTAB 0 255 BIT_MASK 0xff /end CHARACTERISTIC
/begin COMPU_METHOD CRI_mchk_RS_speed3_COMPU_VTAB "Verbal Table" TAB_VERB "%.0" "list" COMPU_TAB_REF CRI_mchk_RS_speed3_COMPU_VTAB_REF /end COMPU_METHOD
/begin COMPU_VTAB CRI_mchk_RS_speed3_COMPU_VTAB_REF "Verbal Table" TAB_VERB 7 0 "X" 1 "<" 2 ">" 3 "<=" 4 ">=" 5 "=" 6 "<>" DEFAULT_VALUE "UNKNOWN" /end COMPU_VTAB
/begin CHARACTERISTIC CRI_mchk_RS_speed4 "and vehicle speed is{CRI_mchk_RS_speed4&0xff=0:X}{CRI_mchk_RS_speed4&0xff=1:<}{CRI_mchk_RS_speed4&0xff=2:>}{CRI_mchk_RS_speed4&0xff=3:<=}{CRI_mchk_RS_speed4&0xff=4:>=}{CRI_mchk_RS_speed4&0xff=5:=}{CRI_mchk_RS_speed4&0xff=6:<>}" VALUE 0x001F1A36 /* @ECU_Address@CRI_mchk_RS_speed4@0x0100AC58@ */ ECIPP_ALIGNMENT_UBYTE 255 CRI_mchk_RS_speed4_COMPU_VTAB 0 255 BIT_MASK 0xff /end CHARACTERISTIC
/begin COMPU_METHOD CRI_mchk_RS_speed4_COMPU_VTAB "Verbal Table" TAB_VERB "%.0" "list" COMPU_TAB_REF CRI_mchk_RS_speed4_COMPU_VTAB_REF /end COMPU_METHOD
/begin COMPU_VTAB CRI_mchk_RS_speed4_COMPU_VTAB_REF "Verbal Table" TAB_VERB 7 0 "X" 1 "<" 2 ">" 3 "<=" 4 ">=" 5 "=" 6 "<>" DEFAULT_VALUE "UNKNOWN" /end COMPU_VTAB
/begin CHARACTERISTIC CRI_mchk_RS_speed5 "and vehicle speed is{CRI_mchk_RS_speed5&0xff=0:X}{CRI_mchk_RS_speed5&0xff=1:<}{CRI_mchk_RS_speed5&0xff=2:>}{CRI_mchk_RS_speed5&0xff=3:<=}{CRI_mchk_RS_speed5&0xff=4:>=}{CRI_mchk_RS_speed5&0xff=5:=}{CRI_mchk_RS_speed5&0xff=6:<>}" VALUE 0x001F1A37 /* @ECU_Address@CRI_mchk_RS_speed5@0x0100AC60@ */ ECIPP_ALIGNMENT_UBYTE 255 CRI_mchk_RS_speed5_COMPU_VTAB 0 255 BIT_MASK 0xff /end CHARACTERISTIC
/begin COMPU_METHOD CRI_mchk_RS_speed5_COMPU_VTAB "Verbal Table" TAB_VERB "%.0" "list" COMPU_TAB_REF CRI_mchk_RS_speed5_COMPU_VTAB_REF /end COMPU_METHOD
/begin COMPU_VTAB CRI_mchk_RS_speed5_COMPU_VTAB_REF "Verbal Table" TAB_VERB 7 0 "X" 1 "<" 2 ">" 3 "<=" 4 ">=" 5 "=" 6 "<>" DEFAULT_VALUE "UNKNOWN" /end COMPU_VTAB
/begin CHARACTERISTIC CRI_mchk_RS_speed6 "and vehicle speed is{CRI_mchk_RS_speed6&0xff=0:X}{CRI_mchk_RS_speed6&0xff=1:<}{CRI_mchk_RS_speed6&0xff=2:>}{CRI_mchk_RS_speed6&0xff=3:<=}{CRI_mchk_RS_speed6&0xff=4:>=}{CRI_mchk_RS_speed6&0xff=5:=}{CRI_mchk_RS_speed6&0xff=6:<>}" VALUE 0x001F1A38 /* @ECU_Address@CRI_mchk_RS_speed6@0x0100AC68@ */ ECIPP_ALIGNMENT_UBYTE 255 CRI_mchk_RS_speed6_COMPU_VTAB 0 255 BIT_MASK 0xff /end CHARACTERISTIC
/begin COMPU_METHOD CRI_mchk_RS_speed6_COMPU_VTAB "Verbal Table" TAB_VERB "%.0" "list" COMPU_TAB_REF CRI_mchk_RS_speed6_COMPU_VTAB_REF /end COMPU_METHOD
/begin COMPU_VTAB CRI_mchk_RS_speed6_COMPU_VTAB_REF "Verbal Table" TAB_VERB 7 0 "X" 1 "<" 2 ">" 3 "<=" 4 ">=" 5 "=" 6 "<>" DEFAULT_VALUE "UNKNOWN" /end COMPU_VTAB
/begin CHARACTERISTIC CRI_mchk_RS_speed7 "and vehicle speed is{CRI_mchk_RS_speed7&0xff=0:X}{CRI_mchk_RS_speed7&0xff=1:<}{CRI_mchk_RS_speed7&0xff=2:>}{CRI_mchk_RS_speed7&0xff=3:<=}{CRI_mchk_RS_speed7&0xff=4:>=}{CRI_mchk_RS_speed7&0xff=5:=}{CRI_mchk_RS_speed7&0xff=6:<>}" VALUE 0x001F1A39 /* @ECU_Address@CRI_mchk_RS_speed7@0x0100AC70@ */ ECIPP_ALIGNMENT_UBYTE 255 CRI_mchk_RS_speed7_COMPU_VTAB 0 255 BIT_MASK 0xff /end CHARACTERISTIC
/begin COMPU_METHOD CRI_mchk_RS_speed7_COMPU_VTAB "Verbal Table" TAB_VERB "%.0" "list" COMPU_TAB_REF CRI_mchk_RS_speed7_COMPU_VTAB_REF /end COMPU_METHOD
/begin COMPU_VTAB CRI_mchk_RS_speed7_COMPU_VTAB_REF "Verbal Table" TAB_VERB 7 0 "X" 1 "<" 2 ">" 3 "<=" 4 ">=" 5 "=" 6 "<>" DEFAULT_VALUE "UNKNOWN" /end COMPU_VTAB
/begin CHARACTERISTIC CRI_mchk_RS_speed8 "and vehicle speed is{CRI_mchk_RS_speed8&0xff=0:X}{CRI_mchk_RS_speed8&0xff=1:<}{CRI_mchk_RS_speed8&0xff=2:>}{CRI_mchk_RS_speed8&0xff=3:<=}{CRI_mchk_RS_speed8&0xff=4:>=}{CRI_mchk_RS_speed8&0xff=5:=}{CRI_mchk_RS_speed8&0xff=6:<>}" VALUE 0x001F1A3A /* @ECU_Address@CRI_mchk_RS_speed8@0x0100AC78@ */ ECIPP_ALIGNMENT_UBYTE 255 CRI_mchk_RS_speed8_COMPU_VTAB 0 255 BIT_MASK 0xff /end CHARACTERISTIC
/begin COMPU_METHOD CRI_mchk_RS_speed8_COMPU_VTAB "Verbal Table" TAB_VERB "%.0" "list" COMPU_TAB_REF CRI_mchk_RS_speed8_COMPU_VTAB_REF /end COMPU_METHOD
/begin COMPU_VTAB CRI_mchk_RS_speed8_COMPU_VTAB_REF "Verbal Table" TAB_VERB 7 0 "X" 1 "<" 2 ">" 3 "<=" 4 ">=" 5 "=" 6 "<>" DEFAULT_VALUE "UNKNOWN" /end COMPU_VTAB
/begin CHARACTERISTIC CRI_mchk_RS_speed9 "and vehicle speed is{CRI_mchk_RS_speed9&0xff=0:X}{CRI_mchk_RS_speed9&0xff=1:<}{CRI_mchk_RS_speed9&0xff=2:>}{CRI_mchk_RS_speed9&0xff=3:<=}{CRI_mchk_RS_speed9&0xff=4:>=}{CRI_mchk_RS_speed9&0xff=5:=}{CRI_mchk_RS_speed9&0xff=6:<>}" VALUE 0x001F1A3B /* @ECU_Address@CRI_mchk_RS_speed9@0x0100AC80@ */ ECIPP_ALIGNMENT_UBYTE 255 CRI_mchk_RS_speed9_COMPU_VTAB 0 255 BIT_MASK 0xff /end CHARACTERISTIC
/begin COMPU_METHOD CRI_mchk_RS_speed9_COMPU_VTAB "Verbal Table" TAB_VERB "%.0" "list" COMPU_TAB_REF CRI_mchk_RS_speed9_COMPU_VTAB_REF /end COMPU_METHOD
/begin COMPU_VTAB CRI_mchk_RS_speed9_COMPU_VTAB_REF "Verbal Table" TAB_VERB 7 0 "X" 1 "<" 2 ">" 3 "<=" 4 ">=" 5 "=" 6 "<>" DEFAULT_VALUE "UNKNOWN" /end COMPU_VTAB
/begin CHARACTERISTIC CRI_mlmt_RPM0 "RPM limit" VALUE 0x001F1918 /* @ECU_Address@CRI_mlmt_RPM0@0x0100AC88@ */ ECIPP_ALIGNMENT_UWORD 65535 Compu_CRI_mlmt_RPM0 0 65535 /end CHARACTERISTIC
/begin COMPU_METHOD Compu_CRI_mlmt_RPM0 " " RAT_FUNC "%.0" "rpm" COEFFS 0 1 0 0 0 1 /end COMPU_METHOD
/begin CHARACTERISTIC CRI_mlmt_RPM1 "RPM limit" VALUE 0x001F191A /* @ECU_Address@CRI_mlmt_RPM1@0x0100AC90@ */ ECIPP_ALIGNMENT_UWORD 65535 Compu_CRI_mlmt_RPM1 0 65535 /end CHARACTERISTIC
/begin COMPU_METHOD Compu_CRI_mlmt_RPM1 " " RAT_FUNC "%.0" "rpm" COEFFS 0 1 0 0 0 1 /end COMPU_METHOD
/begin CHARACTERISTIC CRI_mlmt_RPM2 "RPM limit" VALUE 0x001F191C /* @ECU_Address@CRI_mlmt_RPM2@0x0100AC98@ */ ECIPP_ALIGNMENT_UWORD 65535 Compu_CRI_mlmt_RPM2 0 65535 /end CHARACTERISTIC
/begin COMPU_METHOD Compu_CRI_mlmt_RPM2 " " RAT_FUNC "%.0" "rpm" COEFFS 0 1 0 0 0 1 /end COMPU_METHOD
/begin CHARACTERISTIC CRI_mlmt_RPM3 "RPM limit" VALUE 0x001F191E /* @ECU_Address@CRI_mlmt_RPM3@0x0100ACA0@ */ ECIPP_ALIGNMENT_UWORD 65535 Compu_CRI_mlmt_RPM3 0 65535 /end CHARACTERISTIC
/begin COMPU_METHOD Compu_CRI_mlmt_RPM3 " " RAT_FUNC "%.0" "rpm" COEFFS 0 1 0 0 0 1 /end COMPU_METHOD
/begin CHARACTERISTIC CRI_mlmt_RPM4 "RPM limit" VALUE 0x001F1920 /* @ECU_Address@CRI_mlmt_RPM4@0x0100ACA8@ */ ECIPP_ALIGNMENT_UWORD 65535 Compu_CRI_mlmt_RPM4 0 65535 /end CHARACTERISTIC
/begin COMPU_METHOD Compu_CRI_mlmt_RPM4 " " RAT_FUNC "%.0" "rpm" COEFFS 0 1 0 0 0 1 /end COMPU_METHOD
/begin CHARACTERISTIC CRI_mlmt_RPM5 "RPM limit" VALUE 0x001F1922 /* @ECU_Address@CRI_mlmt_RPM5@0x0100ACB0@ */ ECIPP_ALIGNMENT_UWORD 65535 Compu_CRI_mlmt_RPM5 0 65535 /end CHARACTERISTIC
/begin COMPU_METHOD Compu_CRI_mlmt_RPM5 " " RAT_FUNC "%.0" "rpm" COEFFS 0 1 0 0 0 1 /end COMPU_METHOD
/begin CHARACTERISTIC CRI_mlmt_RPM6 "RPM limit" VALUE 0x001F1924 /* @ECU_Address@CRI_mlmt_RPM6@0x0100ACB8@ */ ECIPP_ALIGNMENT_UWORD 65535 Compu_CRI_mlmt_RPM6 0 65535 /end CHARACTERISTIC
/begin COMPU_METHOD Compu_CRI_mlmt_RPM6 " " RAT_FUNC "%.0" "rpm" COEFFS 0 1 0 0 0 1 /end COMPU_METHOD
/begin CHARACTERISTIC CRI_mlmt_RPM7 "RPM limit" VALUE 0x001F1926 /* @ECU_Address@CRI_mlmt_RPM7@0x0100ACC0@ */ ECIPP_ALIGNMENT_UWORD 65535 Compu_CRI_mlmt_RPM7 0 65535 /end CHARACTERISTIC
/begin COMPU_METHOD Compu_CRI_mlmt_RPM7 " " RAT_FUNC "%.0" "rpm" COEFFS 0 1 0 0 0 1 /end COMPU_METHOD
/begin CHARACTERISTIC CRI_mlmt_RPM8 "RPM limit" VALUE 0x001F1928 /* @ECU_Address@CRI_mlmt_RPM8@0x0100ACC8@ */ ECIPP_ALIGNMENT_UWORD 65535 Compu_CRI_mlmt_RPM8 0 65535 /end CHARACTERISTIC
/begin COMPU_METHOD Compu_CRI_mlmt_RPM8 " " RAT_FUNC "%.0" "rpm" COEFFS 0 1 0 0 0 1 /end COMPU_METHOD
/begin CHARACTERISTIC CRI_mlmt_RPM9 "RPM limit" VALUE 0x001F192A /* @ECU_Address@CRI_mlmt_RPM9@0x0100ACD0@ */ ECIPP_ALIGNMENT_UWORD 65535 Compu_CRI_mlmt_RPM9 0 65535 /end CHARACTERISTIC
/begin COMPU_METHOD Compu_CRI_mlmt_RPM9 " " RAT_FUNC "%.0" "rpm" COEFFS 0 1 0 0 0 1 /end COMPU_METHOD
/begin CHARACTERISTIC CRI_mlmt_ECT0 "ECT limit" VALUE 0x001F18F0 /* @ECU_Address@CRI_mlmt_ECT0@0x0100ACD8@ */ ECIPP_ALIGNMENT_UWORD 564 Compu_CRI_mlmt_ECT0 -460 563.984375 /end CHARACTERISTIC
/begin COMPU_METHOD Compu_CRI_mlmt_ECT0 " " RAT_FUNC "%.1" "deg F" COEFFS 0 64 29440 0 0 1 /end COMPU_METHOD
/begin CHARACTERISTIC CRI_mlmt_ECT1 "ECT limit" VALUE 0x001F18F2 /* @ECU_Address@CRI_mlmt_ECT1@0x0100ACE0@ */ ECIPP_ALIGNMENT_UWORD 564 Compu_CRI_mlmt_ECT1 -460 563.984375 /end CHARACTERISTIC
/begin COMPU_METHOD Compu_CRI_mlmt_ECT1 " " RAT_FUNC "%.1" "deg F" COEFFS 0 64 29440 0 0 1 /end COMPU_METHOD
/begin CHARACTERISTIC CRI_mlmt_ECT2 "ECT limit" VALUE 0x001F18F4 /* @ECU_Address@CRI_mlmt_ECT2@0x0100ACE8@ */ ECIPP_ALIGNMENT_UWORD 564 Compu_CRI_mlmt_ECT2 -460 563.984375 /end CHARACTERISTIC
/begin COMPU_METHOD Compu_CRI_mlmt_ECT2 " " RAT_FUNC "%.1" "deg F" COEFFS 0 64 29440 0 0 1 /end COMPU_METHOD
/begin CHARACTERISTIC CRI_mlmt_ECT3 "ECT limit" VALUE 0x001F18F6 /* @ECU_Address@CRI_mlmt_ECT3@0x0100ACF0@ */ ECIPP_ALIGNMENT_UWORD 564 Compu_CRI_mlmt_ECT3 -460 563.984375 /end CHARACTERISTIC
/begin COMPU_METHOD Compu_CRI_mlmt_ECT3 " " RAT_FUNC "%.1" "deg F" COEFFS 0 64 29440 0 0 1 /end COMPU_METHOD
/begin CHARACTERISTIC CRI_mlmt_ECT4 "ECT limit" VALUE 0x001F18F8 /* @ECU_Address@CRI_mlmt_ECT4@0x0100ACF8@ */ ECIPP_ALIGNMENT_UWORD 564 Compu_CRI_mlmt_ECT4 -460 563.984375 /end CHARACTERISTIC
/begin COMPU_METHOD Compu_CRI_mlmt_ECT4 " " RAT_FUNC "%.1" "deg F" COEFFS 0 64 29440 0 0 1 /end COMPU_METHOD
/begin CHARACTERISTIC CRI_mlmt_ECT5 "ECT limit" VALUE 0x001F18FA /* @ECU_Address@CRI_mlmt_ECT5@0x0100AD00@ */ ECIPP_ALIGNMENT_UWORD 564 Compu_CRI_mlmt_ECT5 -460 563.984375 /end CHARACTERISTIC
/begin COMPU_METHOD Compu_CRI_mlmt_ECT5 " " RAT_FUNC "%.1" "deg F" COEFFS 0 64 29440 0 0 1 /end COMPU_METHOD
/begin CHARACTERISTIC CRI_mlmt_ECT6 "ECT limit" VALUE 0x001F18FC /* @ECU_Address@CRI_mlmt_ECT6@0x0100AD08@ */ ECIPP_ALIGNMENT_UWORD 564 Compu_CRI_mlmt_ECT6 -460 563.984375 /end CHARACTERISTIC
/begin COMPU_METHOD Compu_CRI_mlmt_ECT6 " " RAT_FUNC "%.1" "deg F" COEFFS 0 64 29440 0 0 1 /end COMPU_METHOD
/begin CHARACTERISTIC CRI_mlmt_ECT7 "ECT limit" VALUE 0x001F18FE /* @ECU_Address@CRI_mlmt_ECT7@0x0100AD10@ */ ECIPP_ALIGNMENT_UWORD 564 Compu_CRI_mlmt_ECT7 -460 563.984375 /end CHARACTERISTIC
/begin COMPU_METHOD Compu_CRI_mlmt_ECT7 " " RAT_FUNC "%.1" "deg F" COEFFS 0 64 29440 0 0 1 /end COMPU_METHOD
/begin CHARACTERISTIC CRI_mlmt_ECT8 "ECT limit" VALUE 0x001F1900 /* @ECU_Address@CRI_mlmt_ECT8@0x0100AD18@ */ ECIPP_ALIGNMENT_UWORD 564 Compu_CRI_mlmt_ECT8 -460 563.984375 /end CHARACTERISTIC
/begin COMPU_METHOD Compu_CRI_mlmt_ECT8 " " RAT_FUNC "%.1" "deg F" COEFFS 0 64 29440 0 0 1 /end COMPU_METHOD
/begin CHARACTERISTIC CRI_mlmt_ECT9 "ECT limit" VALUE 0x001F1902 /* @ECU_Address@CRI_mlmt_ECT9@0x0100AD20@ */ ECIPP_ALIGNMENT_UWORD 564 Compu_CRI_mlmt_ECT9 -460 563.984375 /end CHARACTERISTIC
/begin COMPU_METHOD Compu_CRI_mlmt_ECT9 " " RAT_FUNC "%.1" "deg F" COEFFS 0 64 29440 0 0 1 /end COMPU_METHOD
/begin CHARACTERISTIC CRI_mlmt_IAT0 "IAT limit" VALUE 0x001F1904 /* @ECU_Address@CRI_mlmt_IAT0@0x0100AD28@ */ ECIPP_ALIGNMENT_UWORD 564 Compu_CRI_mlmt_IAT0 -460 563.984375 /end CHARACTERISTIC
/begin COMPU_METHOD Compu_CRI_mlmt_IAT0 " " RAT_FUNC "%.1" "deg F" COEFFS 0 64 29440 0 0 1 /end COMPU_METHOD
/begin CHARACTERISTIC CRI_mlmt_IAT1 "IAT limit" VALUE 0x001F1906 /* @ECU_Address@CRI_mlmt_IAT1@0x0100AD30@ */ ECIPP_ALIGNMENT_UWORD 564 Compu_CRI_mlmt_IAT1 -460 563.984375 /end CHARACTERISTIC
/begin COMPU_METHOD Compu_CRI_mlmt_IAT1 " " RAT_FUNC "%.1" "deg F" COEFFS 0 64 29440 0 0 1 /end COMPU_METHOD
/begin CHARACTERISTIC CRI_mlmt_IAT2 "IAT limit" VALUE 0x001F1908 /* @ECU_Address@CRI_mlmt_IAT2@0x0100AD38@ */ ECIPP_ALIGNMENT_UWORD 564 Compu_CRI_mlmt_IAT2 -460 563.984375 /end CHARACTERISTIC
/begin COMPU_METHOD Compu_CRI_mlmt_IAT2 " " RAT_FUNC "%.1" "deg F" COEFFS 0 64 29440 0 0 1 /end COMPU_METHOD
/begin CHARACTERISTIC CRI_mlmt_IAT3 "IAT limit" VALUE 0x001F190A /* @ECU_Address@CRI_mlmt_IAT3@0x0100AD40@ */ ECIPP_ALIGNMENT_UWORD 564 Compu_CRI_mlmt_IAT3 -460 563.984375 /end CHARACTERISTIC
/begin COMPU_METHOD Compu_CRI_mlmt_IAT3 " " RAT_FUNC "%.1" "deg F" COEFFS 0 64 29440 0 0 1 /end COMPU_METHOD
/begin CHARACTERISTIC CRI_mlmt_IAT4 "IAT limit" VALUE 0x001F190C /* @ECU_Address@CRI_mlmt_IAT4@0x0100AD48@ */ ECIPP_ALIGNMENT_UWORD 564 Compu_CRI_mlmt_IAT4 -460 563.984375 /end CHARACTERISTIC
/begin COMPU_METHOD Compu_CRI_mlmt_IAT4 " " RAT_FUNC "%.1" "deg F" COEFFS 0 64 29440 0 0 1 /end COMPU_METHOD
/begin CHARACTERISTIC CRI_mlmt_IAT5 "IAT limit" VALUE 0x001F190E /* @ECU_Address@CRI_mlmt_IAT5@0x0100AD50@ */ ECIPP_ALIGNMENT_UWORD 564 Compu_CRI_mlmt_IAT5 -460 563.984375 /end CHARACTERISTIC
/begin COMPU_METHOD Compu_CRI_mlmt_IAT5 " " RAT_FUNC "%.1" "deg F" COEFFS 0 64 29440 0 0 1 /end COMPU_METHOD
/begin CHARACTERISTIC CRI_mlmt_IAT6 "IAT limit" VALUE 0x001F1910 /* @ECU_Address@CRI_mlmt_IAT6@0x0100AD58@ */ ECIPP_ALIGNMENT_UWORD 564 Compu_CRI_mlmt_IAT6 -460 563.984375 /end CHARACTERISTIC
/begin COMPU_METHOD Compu_CRI_mlmt_IAT6 " " RAT_FUNC "%.1" "deg F" COEFFS 0 64 29440 0 0 1 /end COMPU_METHOD
/begin CHARACTERISTIC CRI_mlmt_IAT7 "IAT limit" VALUE 0x001F1912 /* @ECU_Address@CRI_mlmt_IAT7@0x0100AD60@ */ ECIPP_ALIGNMENT_UWORD 564 Compu_CRI_mlmt_IAT7 -460 563.984375 /end CHARACTERISTIC
/begin COMPU_METHOD Compu_CRI_mlmt_IAT7 " " RAT_FUNC "%.1" "deg F" COEFFS 0 64 29440 0 0 1 /end COMPU_METHOD
/begin CHARACTERISTIC CRI_mlmt_IAT8 "IAT limit" VALUE 0x001F1914 /* @ECU_Address@CRI_mlmt_IAT8@0x0100AD68@ */ ECIPP_ALIGNMENT_UWORD 564 Compu_CRI_mlmt_IAT8 -460 563.984375 /end CHARACTERISTIC
/begin COMPU_METHOD Compu_CRI_mlmt_IAT8 " " RAT_FUNC "%.1" "deg F" COEFFS 0 64 29440 0 0 1 /end COMPU_METHOD
/begin CHARACTERISTIC CRI_mlmt_IAT9 "IAT limit" VALUE 0x001F1916 /* @ECU_Address@CRI_mlmt_IAT9@0x0100AD70@ */ ECIPP_ALIGNMENT_UWORD 564 Compu_CRI_mlmt_IAT9 -460 563.984375 /end CHARACTERISTIC
/begin COMPU_METHOD Compu_CRI_mlmt_IAT9 " " RAT_FUNC "%.1" "deg F" COEFFS 0 64 29440 0 0 1 /end COMPU_METHOD
/begin CHARACTERISTIC CRI_mlmt_DOCT0 "DOCT limit" VALUE 0x001F18C8 /* @ECU_Address@CRI_mlmt_DOCT0@0x0100AD78@ */ ECIPP_ALIGNMENT_UWORD 7732 Compu_CRI_mlmt_DOCT0 -460 7731.875 /end CHARACTERISTIC
/begin COMPU_METHOD Compu_CRI_mlmt_DOCT0 " " RAT_FUNC "%.0" "deg F" COEFFS 0 8 3680 0 0 1 /end COMPU_METHOD
/begin CHARACTERISTIC CRI_mlmt_DOCT1 "DOCT limit" VALUE 0x001F18CA /* @ECU_Address@CRI_mlmt_DOCT1@0x0100AD80@ */ ECIPP_ALIGNMENT_UWORD 7732 Compu_CRI_mlmt_DOCT1 -460 7731.875 /end CHARACTERISTIC
/begin COMPU_METHOD Compu_CRI_mlmt_DOCT1 " " RAT_FUNC "%.0" "deg F" COEFFS 0 8 3680 0 0 1 /end COMPU_METHOD
/begin CHARACTERISTIC CRI_mlmt_DOCT2 "DOCT limit" VALUE 0x001F18CC /* @ECU_Address@CRI_mlmt_DOCT2@0x0100AD88@ */ ECIPP_ALIGNMENT_UWORD 7732 Compu_CRI_mlmt_DOCT2 -460 7731.875 /end CHARACTERISTIC
/begin COMPU_METHOD Compu_CRI_mlmt_DOCT2 " " RAT_FUNC "%.0" "deg F" COEFFS 0 8 3680 0 0 1 /end COMPU_METHOD
/begin CHARACTERISTIC CRI_mlmt_DOCT3 "DOCT limit" VALUE 0x001F18CE /* @ECU_Address@CRI_mlmt_DOCT3@0x0100AD90@ */ ECIPP_ALIGNMENT_UWORD 7732 Compu_CRI_mlmt_DOCT3 -460 7731.875 /end CHARACTERISTIC
/begin COMPU_METHOD Compu_CRI_mlmt_DOCT3 " " RAT_FUNC "%.0" "deg F" COEFFS 0 8 3680 0 0 1 /end COMPU_METHOD
/begin CHARACTERISTIC CRI_mlmt_DOCT4 "DOCT limit" VALUE 0x001F18D0 /* @ECU_Address@CRI_mlmt_DOCT4@0x0100AD98@ */ ECIPP_ALIGNMENT_UWORD 7732 Compu_CRI_mlmt_DOCT4 -460 7731.875 /end CHARACTERISTIC
/begin COMPU_METHOD Compu_CRI_mlmt_DOCT4 " " RAT_FUNC "%.0" "deg F" COEFFS 0 8 3680 0 0 1 /end COMPU_METHOD
/begin CHARACTERISTIC CRI_mlmt_DOCT5 "DOCT limit" VALUE 0x001F18D2 /* @ECU_Address@CRI_mlmt_DOCT5@0x0100ADA0@ */ ECIPP_ALIGNMENT_UWORD 7732 Compu_CRI_mlmt_DOCT5 -460 7731.875 /end CHARACTERISTIC
/begin COMPU_METHOD Compu_CRI_mlmt_DOCT5 " " RAT_FUNC "%.0" "deg F" COEFFS 0 8 3680 0 0 1 /end COMPU_METHOD
/begin CHARACTERISTIC CRI_mlmt_DOCT6 "DOCT limit" VALUE 0x001F18D4 /* @ECU_Address@CRI_mlmt_DOCT6@0x0100ADA8@ */ ECIPP_ALIGNMENT_UWORD 7732 Compu_CRI_mlmt_DOCT6 -460 7731.875 /end CHARACTERISTIC
/begin COMPU_METHOD Compu_CRI_mlmt_DOCT6 " " RAT_FUNC "%.0" "deg F" COEFFS 0 8 3680 0 0 1 /end COMPU_METHOD
/begin CHARACTERISTIC CRI_mlmt_DOCT7 "DOCT limit" VALUE 0x001F18D6 /* @ECU_Address@CRI_mlmt_DOCT7@0x0100ADB0@ */ ECIPP_ALIGNMENT_UWORD 7732 Compu_CRI_mlmt_DOCT7 -460 7731.875 /end CHARACTERISTIC
/begin COMPU_METHOD Compu_CRI_mlmt_DOCT7 " " RAT_FUNC "%.0" "deg F" COEFFS 0 8 3680 0 0 1 /end COMPU_METHOD
/begin CHARACTERISTIC CRI_mlmt_DOCT8 "DOCT limit" VALUE 0x001F18D8 /* @ECU_Address@CRI_mlmt_DOCT8@0x0100ADB8@ */ ECIPP_ALIGNMENT_UWORD 7732 Compu_CRI_mlmt_DOCT8 -460 7731.875 /end CHARACTERISTIC
/begin COMPU_METHOD Compu_CRI_mlmt_DOCT8 " " RAT_FUNC "%.0" "deg F" COEFFS 0 8 3680 0 0 1 /end COMPU_METHOD
/begin CHARACTERISTIC CRI_mlmt_DOCT9 "DOCT limit" VALUE 0x001F18DA /* @ECU_Address@CRI_mlmt_DOCT9@0x0100ADC0@ */ ECIPP_ALIGNMENT_UWORD 7732 Compu_CRI_mlmt_DOCT9 -460 7731.875 /end CHARACTERISTIC
/begin COMPU_METHOD Compu_CRI_mlmt_DOCT9 " " RAT_FUNC "%.0" "deg F" COEFFS 0 8 3680 0 0 1 /end COMPU_METHOD
/begin CHARACTERISTIC CRI_mlmt_DPFT0 "DPFT limit" VALUE 0x001F18DC /* @ECU_Address@CRI_mlmt_DPFT0@0x0100ADC8@ */ ECIPP_ALIGNMENT_UWORD 7732 Compu_CRI_mlmt_DPFT0 -460 7731.875 /end CHARACTERISTIC
/begin COMPU_METHOD Compu_CRI_mlmt_DPFT0 " " RAT_FUNC "%.0" "deg F" COEFFS 0 8 3680 0 0 1 /end COMPU_METHOD
/begin CHARACTERISTIC CRI_mlmt_DPFT1 "DPFT limit" VALUE 0x001F18DE /* @ECU_Address@CRI_mlmt_DPFT1@0x0100ADD0@ */ ECIPP_ALIGNMENT_UWORD 7732 Compu_CRI_mlmt_DPFT1 -460 7731.875 /end CHARACTERISTIC
/begin COMPU_METHOD Compu_CRI_mlmt_DPFT1 " " RAT_FUNC "%.0" "deg F" COEFFS 0 8 3680 0 0 1 /end COMPU_METHOD
/begin CHARACTERISTIC CRI_mlmt_DPFT2 "DPFT limit" VALUE 0x001F18E0 /* @ECU_Address@CRI_mlmt_DPFT2@0x0100ADD8@ */ ECIPP_ALIGNMENT_UWORD 7732 Compu_CRI_mlmt_DPFT2 -460 7731.875 /end CHARACTERISTIC
/begin COMPU_METHOD Compu_CRI_mlmt_DPFT2 " " RAT_FUNC "%.0" "deg F" COEFFS 0 8 3680 0 0 1 /end COMPU_METHOD
/begin CHARACTERISTIC CRI_mlmt_DPFT3 "DPFT limit" VALUE 0x001F18E2 /* @ECU_Address@CRI_mlmt_DPFT3@0x0100ADE0@ */ ECIPP_ALIGNMENT_UWORD 7732 Compu_CRI_mlmt_DPFT3 -460 7731.875 /end CHARACTERISTIC
/begin COMPU_METHOD Compu_CRI_mlmt_DPFT3 " " RAT_FUNC "%.0" "deg F" COEFFS 0 8 3680 0 0 1 /end COMPU_METHOD
/begin CHARACTERISTIC CRI_mlmt_DPFT4 "DPFT limit" VALUE 0x001F18E4 /* @ECU_Address@CRI_mlmt_DPFT4@0x0100ADE8@ */ ECIPP_ALIGNMENT_UWORD 7732 Compu_CRI_mlmt_DPFT4 -460 7731.875 /end CHARACTERISTIC
/begin COMPU_METHOD Compu_CRI_mlmt_DPFT4 " " RAT_FUNC "%.0" "deg F" COEFFS 0 8 3680 0 0 1 /end COMPU_METHOD
/begin CHARACTERISTIC CRI_mlmt_DPFT5 "DPFT limit" VALUE 0x001F18E6 /* @ECU_Address@CRI_mlmt_DPFT5@0x0100ADF0@ */ ECIPP_ALIGNMENT_UWORD 7732 Compu_CRI_mlmt_DPFT5 -460 7731.875 /end CHARACTERISTIC
/begin COMPU_METHOD Compu_CRI_mlmt_DPFT5 " " RAT_FUNC "%.0" "deg F" COEFFS 0 8 3680 0 0 1 /end COMPU_METHOD
/begin CHARACTERISTIC CRI_mlmt_DPFT6 "DPFT limit" VALUE 0x001F18E8 /* @ECU_Address@CRI_mlmt_DPFT6@0x0100ADF8@ */ ECIPP_ALIGNMENT_UWORD 7732 Compu_CRI_mlmt_DPFT6 -460 7731.875 /end CHARACTERISTIC
/begin COMPU_METHOD Compu_CRI_mlmt_DPFT6 " " RAT_FUNC "%.0" "deg F" COEFFS 0 8 3680 0 0 1 /end COMPU_METHOD
/begin CHARACTERISTIC CRI_mlmt_DPFT7 "DPFT limit" VALUE 0x001F18EA /* @ECU_Address@CRI_mlmt_DPFT7@0x0100AE00@ */ ECIPP_ALIGNMENT_UWORD 7732 Compu_CRI_mlmt_DPFT7 -460 7731.875 /end CHARACTERISTIC
/begin COMPU_METHOD Compu_CRI_mlmt_DPFT7 " " RAT_FUNC "%.0" "deg F" COEFFS 0 8 3680 0 0 1 /end COMPU_METHOD
/begin CHARACTERISTIC CRI_mlmt_DPFT8 "DPFT limit" VALUE 0x001F18EC /* @ECU_Address@CRI_mlmt_DPFT8@0x0100AE08@ */ ECIPP_ALIGNMENT_UWORD 7732 Compu_CRI_mlmt_DPFT8 -460 7731.875 /end CHARACTERISTIC
/begin COMPU_METHOD Compu_CRI_mlmt_DPFT8 " " RAT_FUNC "%.0" "deg F" COEFFS 0 8 3680 0 0 1 /end COMPU_METHOD
/begin CHARACTERISTIC CRI_mlmt_DPFT9 "DPFT limit" VALUE 0x001F18EE /* @ECU_Address@CRI_mlmt_DPFT9@0x0100AE10@ */ ECIPP_ALIGNMENT_UWORD 7732 Compu_CRI_mlmt_DPFT9 -460 7731.875 /end CHARACTERISTIC
/begin COMPU_METHOD Compu_CRI_mlmt_DPFT9 " " RAT_FUNC "%.0" "deg F" COEFFS 0 8 3680 0 0 1 /end COMPU_METHOD
/begin CHARACTERISTIC CRI_mlmt_soot0 "Soot loading limit" VALUE 0x001F1940 /* @ECU_Address@CRI_mlmt_soot0@0x0100AE18@ */ ECIPP_ALIGNMENT_UWORD 64 Compu_CRI_mlmt_soot0 0 63.9990234375 /end CHARACTERISTIC
/begin COMPU_METHOD Compu_CRI_mlmt_soot0 " " RAT_FUNC "%.1" "g/L" COEFFS 0 1024 0 0 0 1 /end COMPU_METHOD
/begin CHARACTERISTIC CRI_mlmt_soot1 "Soot loading limit" VALUE 0x001F1942 /* @ECU_Address@CRI_mlmt_soot1@0x0100AE20@ */ ECIPP_ALIGNMENT_UWORD 64 Compu_CRI_mlmt_soot1 0 63.9990234375 /end CHARACTERISTIC
/begin COMPU_METHOD Compu_CRI_mlmt_soot1 " " RAT_FUNC "%.1" "g/L" COEFFS 0 1024 0 0 0 1 /end COMPU_METHOD
/begin CHARACTERISTIC CRI_mlmt_soot2 "Soot loading limit" VALUE 0x001F1944 /* @ECU_Address@CRI_mlmt_soot2@0x0100AE28@ */ ECIPP_ALIGNMENT_UWORD 64 Compu_CRI_mlmt_soot2 0 63.9990234375 /end CHARACTERISTIC
/begin COMPU_METHOD Compu_CRI_mlmt_soot2 " " RAT_FUNC "%.1" "g/L" COEFFS 0 1024 0 0 0 1 /end COMPU_METHOD
/begin CHARACTERISTIC CRI_mlmt_soot3 "Soot loading limit" VALUE 0x001F1946 /* @ECU_Address@CRI_mlmt_soot3@0x0100AE30@ */ ECIPP_ALIGNMENT_UWORD 64 Compu_CRI_mlmt_soot3 0 63.9990234375 /end CHARACTERISTIC
/begin COMPU_METHOD Compu_CRI_mlmt_soot3 " " RAT_FUNC "%.1" "g/L" COEFFS 0 1024 0 0 0 1 /end COMPU_METHOD
/begin CHARACTERISTIC CRI_mlmt_soot4 "Soot loading limit" VALUE 0x001F1948 /* @ECU_Address@CRI_mlmt_soot4@0x0100AE38@ */ ECIPP_ALIGNMENT_UWORD 64 Compu_CRI_mlmt_soot4 0 63.9990234375 /end CHARACTERISTIC
/begin COMPU_METHOD Compu_CRI_mlmt_soot4 " " RAT_FUNC "%.1" "g/L" COEFFS 0 1024 0 0 0 1 /end COMPU_METHOD
/begin CHARACTERISTIC CRI_mlmt_soot5 "Soot loading limit" VALUE 0x001F194A /* @ECU_Address@CRI_mlmt_soot5@0x0100AE40@ */ ECIPP_ALIGNMENT_UWORD 64 Compu_CRI_mlmt_soot5 0 63.9990234375 /end CHARACTERISTIC
/begin COMPU_METHOD Compu_CRI_mlmt_soot5 " " RAT_FUNC "%.1" "g/L" COEFFS 0 1024 0 0 0 1 /end COMPU_METHOD
/begin CHARACTERISTIC CRI_mlmt_soot6 "Soot loading limit" VALUE 0x001F194C /* @ECU_Address@CRI_mlmt_soot6@0x0100AE48@ */ ECIPP_ALIGNMENT_UWORD 64 Compu_CRI_mlmt_soot6 0 63.9990234375 /end CHARACTERISTIC
/begin COMPU_METHOD Compu_CRI_mlmt_soot6 " " RAT_FUNC "%.1" "g/L" COEFFS 0 1024 0 0 0 1 /end COMPU_METHOD
/begin CHARACTERISTIC CRI_mlmt_soot7 "Soot loading limit" VALUE 0x001F194E /* @ECU_Address@CRI_mlmt_soot7@0x0100AE50@ */ ECIPP_ALIGNMENT_UWORD 64 Compu_CRI_mlmt_soot7 0 63.9990234375 /end CHARACTERISTIC
/begin COMPU_METHOD Compu_CRI_mlmt_soot7 " " RAT_FUNC "%.1" "g/L" COEFFS 0 1024 0 0 0 1 /end COMPU_METHOD
/begin CHARACTERISTIC CRI_mlmt_soot8 "Soot loading limit" VALUE 0x001F1950 /* @ECU_Address@CRI_mlmt_soot8@0x0100AE58@ */ ECIPP_ALIGNMENT_UWORD 64 Compu_CRI_mlmt_soot8 0 63.9990234375 /end CHARACTERISTIC
/begin COMPU_METHOD Compu_CRI_mlmt_soot8 " " RAT_FUNC "%.1" "g/L" COEFFS 0 1024 0 0 0 1 /end COMPU_METHOD
/begin CHARACTERISTIC CRI_mlmt_soot9 "Soot loading limit" VALUE 0x001F1952 /* @ECU_Address@CRI_mlmt_soot9@0x0100AE60@ */ ECIPP_ALIGNMENT_UWORD 64 Compu_CRI_mlmt_soot9 0 63.9990234375 /end CHARACTERISTIC
/begin COMPU_METHOD Compu_CRI_mlmt_soot9 " " RAT_FUNC "%.1" "g/L" COEFFS 0 1024 0 0 0 1 /end COMPU_METHOD
/begin CHARACTERISTIC CRI_mlmt_RS_speed0 "RS speed limit" VALUE 0x001F192C /* @ECU_Address@CRI_mlmt_RS_speed0@0x0100AE68@ */ ECIPP_ALIGNMENT_UWORD 256 Compu_CRI_mlmt_RS_speed0 0 255.99609375 /end CHARACTERISTIC
/begin COMPU_METHOD Compu_CRI_mlmt_RS_speed0 " " RAT_FUNC "%.1" "km/hr" COEFFS 0 256 0 0 0 1 /end COMPU_METHOD
/begin CHARACTERISTIC CRI_mlmt_RS_speed1 "RS speed limit" VALUE 0x001F192E /* @ECU_Address@CRI_mlmt_RS_speed1@0x0100AE70@ */ ECIPP_ALIGNMENT_UWORD 256 Compu_CRI_mlmt_RS_speed1 0 255.99609375 /end CHARACTERISTIC
/begin COMPU_METHOD Compu_CRI_mlmt_RS_speed1 " " RAT_FUNC "%.1" "km/hr" COEFFS 0 256 0 0 0 1 /end COMPU_METHOD
/begin CHARACTERISTIC CRI_mlmt_RS_speed2 "RS speed limit" VALUE 0x001F1930 /* @ECU_Address@CRI_mlmt_RS_speed2@0x0100AE78@ */ ECIPP_ALIGNMENT_UWORD 256 Compu_CRI_mlmt_RS_speed2 0 255.99609375 /end CHARACTERISTIC
/begin COMPU_METHOD Compu_CRI_mlmt_RS_speed2 " " RAT_FUNC "%.1" "km/hr" COEFFS 0 256 0 0 0 1 /end COMPU_METHOD
/begin CHARACTERISTIC CRI_mlmt_RS_speed3 "RS speed limit" VALUE 0x001F1932 /* @ECU_Address@CRI_mlmt_RS_speed3@0x0100AE80@ */ ECIPP_ALIGNMENT_UWORD 256 Compu_CRI_mlmt_RS_speed3 0 255.99609375 /end CHARACTERISTIC
/begin COMPU_METHOD Compu_CRI_mlmt_RS_speed3 " " RAT_FUNC "%.1" "km/hr" COEFFS 0 256 0 0 0 1 /end COMPU_METHOD
/begin CHARACTERISTIC CRI_mlmt_RS_speed4 "RS speed limit" VALUE 0x001F1934 /* @ECU_Address@CRI_mlmt_RS_speed4@0x0100AE88@ */ ECIPP_ALIGNMENT_UWORD 256 Compu_CRI_mlmt_RS_speed4 0 255.99609375 /end CHARACTERISTIC
/begin COMPU_METHOD Compu_CRI_mlmt_RS_speed4 " " RAT_FUNC "%.1" "km/hr" COEFFS 0 256 0 0 0 1 /end COMPU_METHOD
/begin CHARACTERISTIC CRI_mlmt_RS_speed5 "RS speed limit" VALUE 0x001F1936 /* @ECU_Address@CRI_mlmt_RS_speed5@0x0100AE90@ */ ECIPP_ALIGNMENT_UWORD 256 Compu_CRI_mlmt_RS_speed5 0 255.99609375 /end CHARACTERISTIC
/begin COMPU_METHOD Compu_CRI_mlmt_RS_speed5 " " RAT_FUNC "%.1" "km/hr" COEFFS 0 256 0 0 0 1 /end COMPU_METHOD
/begin CHARACTERISTIC CRI_mlmt_RS_speed6 "RS speed limit" VALUE 0x001F1938 /* @ECU_Address@CRI_mlmt_RS_speed6@0x0100AE98@ */ ECIPP_ALIGNMENT_UWORD 256 Compu_CRI_mlmt_RS_speed6 0 255.99609375 /end CHARACTERISTIC
/begin COMPU_METHOD Compu_CRI_mlmt_RS_speed6 " " RAT_FUNC "%.1" "km/hr" COEFFS 0 256 0 0 0 1 /end COMPU_METHOD
/begin CHARACTERISTIC CRI_mlmt_RS_speed7 "RS speed limit" VALUE 0x001F193A /* @ECU_Address@CRI_mlmt_RS_speed7@0x0100AEA0@ */ ECIPP_ALIGNMENT_UWORD 256 Compu_CRI_mlmt_RS_speed7 0 255.99609375 /end CHARACTERISTIC
/begin COMPU_METHOD Compu_CRI_mlmt_RS_speed7 " " RAT_FUNC "%.1" "km/hr" COEFFS 0 256 0 0 0 1 /end COMPU_METHOD
/begin CHARACTERISTIC CRI_mlmt_RS_speed8 "RS speed limit" VALUE 0x001F193C /* @ECU_Address@CRI_mlmt_RS_speed8@0x0100AEA8@ */ ECIPP_ALIGNMENT_UWORD 256 Compu_CRI_mlmt_RS_speed8 0 255.99609375 /end CHARACTERISTIC
/begin COMPU_METHOD Compu_CRI_mlmt_RS_speed8 " " RAT_FUNC "%.1" "km/hr" COEFFS 0 256 0 0 0 1 /end COMPU_METHOD
/begin CHARACTERISTIC CRI_mlmt_RS_speed9 "RS speed limit" VALUE 0x001F193E /* @ECU_Address@CRI_mlmt_RS_speed9@0x0100AEB0@ */ ECIPP_ALIGNMENT_UWORD 256 Compu_CRI_mlmt_RS_speed9 0 255.99609375 /end CHARACTERISTIC
/begin COMPU_METHOD Compu_CRI_mlmt_RS_speed9 " " RAT_FUNC "%.1" "km/hr" COEFFS 0 256 0 0 0 1 /end COMPU_METHOD
/begin CHARACTERISTIC CRI_mchk_persist0 "for persistently longer than" VALUE 0x001EE534 /* @ECU_Address@CRI_mchk_persist0@0x0100AEB8@ */ ECIPP_ALIGNMENT_ULONG 4294967 Compu_CRI_mchk_persist0 0 4294967.295 /end CHARACTERISTIC
/begin COMPU_METHOD Compu_CRI_mchk_persist0 " " RAT_FUNC "%.1" "sec" COEFFS 0 1000 0 0 0 1 /end COMPU_METHOD
/begin CHARACTERISTIC CRI_mchk_persist1 "for persistently longer than" VALUE 0x001EE538 /* @ECU_Address@CRI_mchk_persist1@0x0100AEC0@ */ ECIPP_ALIGNMENT_ULONG 4294967 Compu_CRI_mchk_persist1 0 4294967.295 /end CHARACTERISTIC
/begin COMPU_METHOD Compu_CRI_mchk_persist1 " " RAT_FUNC "%.1" "sec" COEFFS 0 1000 0 0 0 1 /end COMPU_METHOD
/begin CHARACTERISTIC CRI_mchk_persist2 "for persistently longer than" VALUE 0x001EE53C /* @ECU_Address@CRI_mchk_persist2@0x0100AEC8@ */ ECIPP_ALIGNMENT_ULONG 4294967 Compu_CRI_mchk_persist2 0 4294967.295 /end CHARACTERISTIC
/begin COMPU_METHOD Compu_CRI_mchk_persist2 " " RAT_FUNC "%.1" "sec" COEFFS 0 1000 0 0 0 1 /end COMPU_METHOD
/begin CHARACTERISTIC CRI_mchk_persist3 "for persistently longer than" VALUE 0x001EE540 /* @ECU_Address@CRI_mchk_persist3@0x0100AED0@ */ ECIPP_ALIGNMENT_ULONG 4294967 Compu_CRI_mchk_persist3 0 4294967.295 /end CHARACTERISTIC
/begin COMPU_METHOD Compu_CRI_mchk_persist3 " " RAT_FUNC "%.1" "sec" COEFFS 0 1000 0 0 0 1 /end COMPU_METHOD
/begin CHARACTERISTIC CRI_mchk_persist4 "for persistently longer than" VALUE 0x001EE544 /* @ECU_Address@CRI_mchk_persist4@0x0100AED8@ */ ECIPP_ALIGNMENT_ULONG 4294967 Compu_CRI_mchk_persist4 0 4294967.295 /end CHARACTERISTIC
/begin COMPU_METHOD Compu_CRI_mchk_persist4 " " RAT_FUNC "%.1" "sec" COEFFS 0 1000 0 0 0 1 /end COMPU_METHOD
/begin CHARACTERISTIC CRI_mchk_persist5 "for persistently longer than" VALUE 0x001EE548 /* @ECU_Address@CRI_mchk_persist5@0x0100AEE0@ */ ECIPP_ALIGNMENT_ULONG 4294967 Compu_CRI_mchk_persist5 0 4294967.295 /end CHARACTERISTIC
/begin COMPU_METHOD Compu_CRI_mchk_persist5 " " RAT_FUNC "%.1" "sec" COEFFS 0 1000 0 0 0 1 /end COMPU_METHOD
/begin CHARACTERISTIC CRI_mchk_persist6 "for persistently longer than" VALUE 0x001EE54C /* @ECU_Address@CRI_mchk_persist6@0x0100AEE8@ */ ECIPP_ALIGNMENT_ULONG 4294967 Compu_CRI_mchk_persist6 0 4294967.295 /end CHARACTERISTIC
/begin COMPU_METHOD Compu_CRI_mchk_persist6 " " RAT_FUNC "%.1" "sec" COEFFS 0 1000 0 0 0 1 /end COMPU_METHOD
/begin CHARACTERISTIC CRI_mchk_persist7 "for persistently longer than" VALUE 0x001EE550 /* @ECU_Address@CRI_mchk_persist7@0x0100AEF0@ */ ECIPP_ALIGNMENT_ULONG 4294967 Compu_CRI_mchk_persist7 0 4294967.295 /end CHARACTERISTIC
/begin COMPU_METHOD Compu_CRI_mchk_persist7 " " RAT_FUNC "%.1" "sec" COEFFS 0 1000 0 0 0 1 /end COMPU_METHOD
/begin CHARACTERISTIC CRI_mchk_persist8 "for persistently longer than" VALUE 0x001EE554 /* @ECU_Address@CRI_mchk_persist8@0x0100AEF8@ */ ECIPP_ALIGNMENT_ULONG 4294967 Compu_CRI_mchk_persist8 0 4294967.295 /end CHARACTERISTIC
/begin COMPU_METHOD Compu_CRI_mchk_persist8 " " RAT_FUNC "%.1" "sec" COEFFS 0 1000 0 0 0 1 /end COMPU_METHOD
/begin CHARACTERISTIC CRI_mchk_persist9 "for persistently longer than" VALUE 0x001EE558 /* @ECU_Address@CRI_mchk_persist9@0x0100AF00@ */ ECIPP_ALIGNMENT_ULONG 4294967 Compu_CRI_mchk_persist9 0 4294967.295 /end CHARACTERISTIC
/begin COMPU_METHOD Compu_CRI_mchk_persist9 " " RAT_FUNC "%.1" "sec" COEFFS 0 1000 0 0 0 1 /end COMPU_METHOD
/begin CHARACTERISTIC CRI_mtranA_chk0 "Check for transitioning to{CRI_mtranA_chk0&0xff=0:Inactive}{CRI_mtranA_chk0&0xff=1:Mode 0}{CRI_mtranA_chk0&0xff=2:Mode 1}{CRI_mtranA_chk0&0xff=3:Mode 2}{CRI_mtranA_chk0&0xff=4:Mode 3}{CRI_mtranA_chk0&0xff=5:Mode 4}{CRI_mtranA_chk0&0xff=6:Mode 5}{CRI_mtran" VALUE 0x001F1A46 /* @ECU_Address@CRI_mtranA_chk0@0x0100AF08@ */ ECIPP_ALIGNMENT_UBYTE 255 CRI_mtranA_chk0_COMPU_VTAB 0 255 BIT_MASK 0xff /end CHARACTERISTIC
/begin COMPU_METHOD CRI_mtranA_chk0_COMPU_VTAB "Verbal Table" TAB_VERB "%.0" "list" COMPU_TAB_REF CRI_mtranA_chk0_COMPU_VTAB_REF /end COMPU_METHOD
/begin COMPU_VTAB CRI_mtranA_chk0_COMPU_VTAB_REF "Verbal Table" TAB_VERB 11 0 "Inactive" 1 "Mode 0" 2 "Mode 1" 3 "Mode 2" 4 "Mode 3" 5 "Mode 4" 6 "Mode 5" 7 "Mode 6" 8 "Mode 7" 9 "Mode 8" 10 "Mode 9" DEFAULT_VALUE "UNKNOWN" /end COMPU_VTAB
/begin CHARACTERISTIC CRI_mtranA_chk1 "Check for transitioning to{CRI_mtranA_chk1&0xff=0:Inactive}{CRI_mtranA_chk1&0xff=1:Mode 0}{CRI_mtranA_chk1&0xff=2:Mode 1}{CRI_mtranA_chk1&0xff=3:Mode 2}{CRI_mtranA_chk1&0xff=4:Mode 3}{CRI_mtranA_chk1&0xff=5:Mode 4}{CRI_mtranA_chk1&0xff=6:Mode 5}{CRI_mtran" VALUE 0x001F1A47 /* @ECU_Address@CRI_mtranA_chk1@0x0100AF10@ */ ECIPP_ALIGNMENT_UBYTE 255 CRI_mtranA_chk1_COMPU_VTAB 0 255 BIT_MASK 0xff /end CHARACTERISTIC
/begin COMPU_METHOD CRI_mtranA_chk1_COMPU_VTAB "Verbal Table" TAB_VERB "%.0" "list" COMPU_TAB_REF CRI_mtranA_chk1_COMPU_VTAB_REF /end COMPU_METHOD
/begin COMPU_VTAB CRI_mtranA_chk1_COMPU_VTAB_REF "Verbal Table" TAB_VERB 11 0 "Inactive" 1 "Mode 0" 2 "Mode 1" 3 "Mode 2" 4 "Mode 3" 5 "Mode 4" 6 "Mode 5" 7 "Mode 6" 8 "Mode 7" 9 "Mode 8" 10 "Mode 9" DEFAULT_VALUE "UNKNOWN" /end COMPU_VTAB
/begin CHARACTERISTIC CRI_mtranA_chk2 "Check for transitioning to{CRI_mtranA_chk2&0xff=0:Inactive}{CRI_mtranA_chk2&0xff=1:Mode 0}{CRI_mtranA_chk2&0xff=2:Mode 1}{CRI_mtranA_chk2&0xff=3:Mode 2}{CRI_mtranA_chk2&0xff=4:Mode 3}{CRI_mtranA_chk2&0xff=5:Mode 4}{CRI_mtranA_chk2&0xff=6:Mode 5}{CRI_mtran" VALUE 0x001F1A48 /* @ECU_Address@CRI_mtranA_chk2@0x0100AF18@ */ ECIPP_ALIGNMENT_UBYTE 255 CRI_mtranA_chk2_COMPU_VTAB 0 255 BIT_MASK 0xff /end CHARACTERISTIC
/begin COMPU_METHOD CRI_mtranA_chk2_COMPU_VTAB "Verbal Table" TAB_VERB "%.0" "list" COMPU_TAB_REF CRI_mtranA_chk2_COMPU_VTAB_REF /end COMPU_METHOD
/begin COMPU_VTAB CRI_mtranA_chk2_COMPU_VTAB_REF "Verbal Table" TAB_VERB 11 0 "Inactive" 1 "Mode 0" 2 "Mode 1" 3 "Mode 2" 4 "Mode 3" 5 "Mode 4" 6 "Mode 5" 7 "Mode 6" 8 "Mode 7" 9 "Mode 8" 10 "Mode 9" DEFAULT_VALUE "UNKNOWN" /end COMPU_VTAB
/begin CHARACTERISTIC CRI_mtranA_chk3 "Check for transitioning to{CRI_mtranA_chk3&0xff=0:Inactive}{CRI_mtranA_chk3&0xff=1:Mode 0}{CRI_mtranA_chk3&0xff=2:Mode 1}{CRI_mtranA_chk3&0xff=3:Mode 2}{CRI_mtranA_chk3&0xff=4:Mode 3}{CRI_mtranA_chk3&0xff=5:Mode 4}{CRI_mtranA_chk3&0xff=6:Mode 5}{CRI_mtran" VALUE 0x001F1A49 /* @ECU_Address@CRI_mtranA_chk3@0x0100AF20@ */ ECIPP_ALIGNMENT_UBYTE 255 CRI_mtranA_chk3_COMPU_VTAB 0 255 BIT_MASK 0xff /end CHARACTERISTIC
/begin COMPU_METHOD CRI_mtranA_chk3_COMPU_VTAB "Verbal Table" TAB_VERB "%.0" "list" COMPU_TAB_REF CRI_mtranA_chk3_COMPU_VTAB_REF /end COMPU_METHOD
/begin COMPU_VTAB CRI_mtranA_chk3_COMPU_VTAB_REF "Verbal Table" TAB_VERB 11 0 "Inactive" 1 "Mode 0" 2 "Mode 1" 3 "Mode 2" 4 "Mode 3" 5 "Mode 4" 6 "Mode 5" 7 "Mode 6" 8 "Mode 7" 9 "Mode 8" 10 "Mode 9" DEFAULT_VALUE "UNKNOWN" /end COMPU_VTAB
/begin CHARACTERISTIC CRI_mtranA_chk4 "Check for transitioning to{CRI_mtranA_chk4&0xff=0:Inactive}{CRI_mtranA_chk4&0xff=1:Mode 0}{CRI_mtranA_chk4&0xff=2:Mode 1}{CRI_mtranA_chk4&0xff=3:Mode 2}{CRI_mtranA_chk4&0xff=4:Mode 3}{CRI_mtranA_chk4&0xff=5:Mode 4}{CRI_mtranA_chk4&0xff=6:Mode 5}{CRI_mtran" VALUE 0x001F1A4A /* @ECU_Address@CRI_mtranA_chk4@0x0100AF28@ */ ECIPP_ALIGNMENT_UBYTE 255 CRI_mtranA_chk4_COMPU_VTAB 0 255 BIT_MASK 0xff /end CHARACTERISTIC
/begin COMPU_METHOD CRI_mtranA_chk4_COMPU_VTAB "Verbal Table" TAB_VERB "%.0" "list" COMPU_TAB_REF CRI_mtranA_chk4_COMPU_VTAB_REF /end COMPU_METHOD
/begin COMPU_VTAB CRI_mtranA_chk4_COMPU_VTAB_REF "Verbal Table" TAB_VERB 11 0 "Inactive" 1 "Mode 0" 2 "Mode 1" 3 "Mode 2" 4 "Mode 3" 5 "Mode 4" 6 "Mode 5" 7 "Mode 6" 8 "Mode 7" 9 "Mode 8" 10 "Mode 9" DEFAULT_VALUE "UNKNOWN" /end COMPU_VTAB
/begin CHARACTERISTIC CRI_mtranA_chk5 "Check for transitioning to{CRI_mtranA_chk5&0xff=0:Inactive}{CRI_mtranA_chk5&0xff=1:Mode 0}{CRI_mtranA_chk5&0xff=2:Mode 1}{CRI_mtranA_chk5&0xff=3:Mode 2}{CRI_mtranA_chk5&0xff=4:Mode 3}{CRI_mtranA_chk5&0xff=5:Mode 4}{CRI_mtranA_chk5&0xff=6:Mode 5}{CRI_mtran" VALUE 0x001F1A4B /* @ECU_Address@CRI_mtranA_chk5@0x0100AF30@ */ ECIPP_ALIGNMENT_UBYTE 255 CRI_mtranA_chk5_COMPU_VTAB 0 255 BIT_MASK 0xff /end CHARACTERISTIC
/begin COMPU_METHOD CRI_mtranA_chk5_COMPU_VTAB "Verbal Table" TAB_VERB "%.0" "list" COMPU_TAB_REF CRI_mtranA_chk5_COMPU_VTAB_REF /end COMPU_METHOD
/begin COMPU_VTAB CRI_mtranA_chk5_COMPU_VTAB_REF "Verbal Table" TAB_VERB 11 0 "Inactive" 1 "Mode 0" 2 "Mode 1" 3 "Mode 2" 4 "Mode 3" 5 "Mode 4" 6 "Mode 5" 7 "Mode 6" 8 "Mode 7" 9 "Mode 8" 10 "Mode 9" DEFAULT_VALUE "UNKNOWN" /end COMPU_VTAB
/begin CHARACTERISTIC CRI_mtranA_chk6 "Check for transitioning to{CRI_mtranA_chk6&0xff=0:Inactive}{CRI_mtranA_chk6&0xff=1:Mode 0}{CRI_mtranA_chk6&0xff=2:Mode 1}{CRI_mtranA_chk6&0xff=3:Mode 2}{CRI_mtranA_chk6&0xff=4:Mode 3}{CRI_mtranA_chk6&0xff=5:Mode 4}{CRI_mtranA_chk6&0xff=6:Mode 5}{CRI_mtran" VALUE 0x001F1A4C /* @ECU_Address@CRI_mtranA_chk6@0x0100AF38@ */ ECIPP_ALIGNMENT_UBYTE 255 CRI_mtranA_chk6_COMPU_VTAB 0 255 BIT_MASK 0xff /end CHARACTERISTIC
/begin COMPU_METHOD CRI_mtranA_chk6_COMPU_VTAB "Verbal Table" TAB_VERB "%.0" "list" COMPU_TAB_REF CRI_mtranA_chk6_COMPU_VTAB_REF /end COMPU_METHOD
/begin COMPU_VTAB CRI_mtranA_chk6_COMPU_VTAB_REF "Verbal Table" TAB_VERB 11 0 "Inactive" 1 "Mode 0" 2 "Mode 1" 3 "Mode 2" 4 "Mode 3" 5 "Mode 4" 6 "Mode 5" 7 "Mode 6" 8 "Mode 7" 9 "Mode 8" 10 "Mode 9" DEFAULT_VALUE "UNKNOWN" /end COMPU_VTAB
/begin CHARACTERISTIC CRI_mtranA_chk7 "Check for transitioning to{CRI_mtranA_chk7&0xff=0:Inactive}{CRI_mtranA_chk7&0xff=1:Mode 0}{CRI_mtranA_chk7&0xff=2:Mode 1}{CRI_mtranA_chk7&0xff=3:Mode 2}{CRI_mtranA_chk7&0xff=4:Mode 3}{CRI_mtranA_chk7&0xff=5:Mode 4}{CRI_mtranA_chk7&0xff=6:Mode 5}{CRI_mtran" VALUE 0x001F1A4D /* @ECU_Address@CRI_mtranA_chk7@0x0100AF40@ */ ECIPP_ALIGNMENT_UBYTE 255 CRI_mtranA_chk7_COMPU_VTAB 0 255 BIT_MASK 0xff /end CHARACTERISTIC
/begin COMPU_METHOD CRI_mtranA_chk7_COMPU_VTAB "Verbal Table" TAB_VERB "%.0" "list" COMPU_TAB_REF CRI_mtranA_chk7_COMPU_VTAB_REF /end COMPU_METHOD
/begin COMPU_VTAB CRI_mtranA_chk7_COMPU_VTAB_REF "Verbal Table" TAB_VERB 11 0 "Inactive" 1 "Mode 0" 2 "Mode 1" 3 "Mode 2" 4 "Mode 3" 5 "Mode 4" 6 "Mode 5" 7 "Mode 6" 8 "Mode 7" 9 "Mode 8" 10 "Mode 9" DEFAULT_VALUE "UNKNOWN" /end COMPU_VTAB
/begin CHARACTERISTIC CRI_mtranA_chk8 "Check for transitioning to{CRI_mtranA_chk8&0xff=0:Inactive}{CRI_mtranA_chk8&0xff=1:Mode 0}{CRI_mtranA_chk8&0xff=2:Mode 1}{CRI_mtranA_chk8&0xff=3:Mode 2}{CRI_mtranA_chk8&0xff=4:Mode 3}{CRI_mtranA_chk8&0xff=5:Mode 4}{CRI_mtranA_chk8&0xff=6:Mode 5}{CRI_mtran" VALUE 0x001F1A4E /* @ECU_Address@CRI_mtranA_chk8@0x0100AF48@ */ ECIPP_ALIGNMENT_UBYTE 255 CRI_mtranA_chk8_COMPU_VTAB 0 255 BIT_MASK 0xff /end CHARACTERISTIC
/begin COMPU_METHOD CRI_mtranA_chk8_COMPU_VTAB "Verbal Table" TAB_VERB "%.0" "list" COMPU_TAB_REF CRI_mtranA_chk8_COMPU_VTAB_REF /end COMPU_METHOD
/begin COMPU_VTAB CRI_mtranA_chk8_COMPU_VTAB_REF "Verbal Table" TAB_VERB 11 0 "Inactive" 1 "Mode 0" 2 "Mode 1" 3 "Mode 2" 4 "Mode 3" 5 "Mode 4" 6 "Mode 5" 7 "Mode 6" 8 "Mode 7" 9 "Mode 8" 10 "Mode 9" DEFAULT_VALUE "UNKNOWN" /end COMPU_VTAB
/begin CHARACTERISTIC CRI_mtranA_chk9 "Check for transitioning to{CRI_mtranA_chk9&0xff=0:Inactive}{CRI_mtranA_chk9&0xff=1:Mode 0}{CRI_mtranA_chk9&0xff=2:Mode 1}{CRI_mtranA_chk9&0xff=3:Mode 2}{CRI_mtranA_chk9&0xff=4:Mode 3}{CRI_mtranA_chk9&0xff=5:Mode 4}{CRI_mtranA_chk9&0xff=6:Mode 5}{CRI_mtran" VALUE 0x001F1A4F /* @ECU_Address@CRI_mtranA_chk9@0x0100AF50@ */ ECIPP_ALIGNMENT_UBYTE 255 CRI_mtranA_chk9_COMPU_VTAB 0 255 BIT_MASK 0xff /end CHARACTERISTIC
/begin COMPU_METHOD CRI_mtranA_chk9_COMPU_VTAB "Verbal Table" TAB_VERB "%.0" "list" COMPU_TAB_REF CRI_mtranA_chk9_COMPU_VTAB_REF /end COMPU_METHOD
/begin COMPU_VTAB CRI_mtranA_chk9_COMPU_VTAB_REF "Verbal Table" TAB_VERB 11 0 "Inactive" 1 "Mode 0" 2 "Mode 1" 3 "Mode 2" 4 "Mode 3" 5 "Mode 4" 6 "Mode 5" 7 "Mode 6" 8 "Mode 7" 9 "Mode 8" 10 "Mode 9" DEFAULT_VALUE "UNKNOWN" /end COMPU_VTAB
/begin CHARACTERISTIC CRI_mtranB_chk0 "then check for transitioning to{CRI_mtranB_chk0&0xff=0:Inactive}{CRI_mtranB_chk0&0xff=1:Mode 0}{CRI_mtranB_chk0&0xff=2:Mode 1}{CRI_mtranB_chk0&0xff=3:Mode 2}{CRI_mtranB_chk0&0xff=4:Mode 3}{CRI_mtranB_chk0&0xff=5:Mode 4}{CRI_mtranB_chk0&0xff=6:Mode 5}{CRI_" VALUE 0x001F1A50 /* @ECU_Address@CRI_mtranB_chk0@0x0100AF58@ */ ECIPP_ALIGNMENT_UBYTE 255 CRI_mtranB_chk0_COMPU_VTAB 0 255 BIT_MASK 0xff /end CHARACTERISTIC
/begin COMPU_METHOD CRI_mtranB_chk0_COMPU_VTAB "Verbal Table" TAB_VERB "%.0" "list" COMPU_TAB_REF CRI_mtranB_chk0_COMPU_VTAB_REF /end COMPU_METHOD
/begin COMPU_VTAB CRI_mtranB_chk0_COMPU_VTAB_REF "Verbal Table" TAB_VERB 11 0 "Inactive" 1 "Mode 0" 2 "Mode 1" 3 "Mode 2" 4 "Mode 3" 5 "Mode 4" 6 "Mode 5" 7 "Mode 6" 8 "Mode 7" 9 "Mode 8" 10 "Mode 9" DEFAULT_VALUE "UNKNOWN" /end COMPU_VTAB
/begin CHARACTERISTIC CRI_mtranB_chk1 "then check for transitioning to{CRI_mtranB_chk1&0xff=0:Inactive}{CRI_mtranB_chk1&0xff=1:Mode 0}{CRI_mtranB_chk1&0xff=2:Mode 1}{CRI_mtranB_chk1&0xff=3:Mode 2}{CRI_mtranB_chk1&0xff=4:Mode 3}{CRI_mtranB_chk1&0xff=5:Mode 4}{CRI_mtranB_chk1&0xff=6:Mode 5}{CRI_" VALUE 0x001F1A51 /* @ECU_Address@CRI_mtranB_chk1@0x0100AF60@ */ ECIPP_ALIGNMENT_UBYTE 255 CRI_mtranB_chk1_COMPU_VTAB 0 255 BIT_MASK 0xff /end CHARACTERISTIC
/begin COMPU_METHOD CRI_mtranB_chk1_COMPU_VTAB "Verbal Table" TAB_VERB "%.0" "list" COMPU_TAB_REF CRI_mtranB_chk1_COMPU_VTAB_REF /end COMPU_METHOD
/begin COMPU_VTAB CRI_mtranB_chk1_COMPU_VTAB_REF "Verbal Table" TAB_VERB 11 0 "Inactive" 1 "Mode 0" 2 "Mode 1" 3 "Mode 2" 4 "Mode 3" 5 "Mode 4" 6 "Mode 5" 7 "Mode 6" 8 "Mode 7" 9 "Mode 8" 10 "Mode 9" DEFAULT_VALUE "UNKNOWN" /end COMPU_VTAB
/begin CHARACTERISTIC CRI_mtranB_chk2 "then check for transitioning to{CRI_mtranB_chk2&0xff=0:Inactive}{CRI_mtranB_chk2&0xff=1:Mode 0}{CRI_mtranB_chk2&0xff=2:Mode 1}{CRI_mtranB_chk2&0xff=3:Mode 2}{CRI_mtranB_chk2&0xff=4:Mode 3}{CRI_mtranB_chk2&0xff=5:Mode 4}{CRI_mtranB_chk2&0xff=6:Mode 5}{CRI_" VALUE 0x001F1A52 /* @ECU_Address@CRI_mtranB_chk2@0x0100AF68@ */ ECIPP_ALIGNMENT_UBYTE 255 CRI_mtranB_chk2_COMPU_VTAB 0 255 BIT_MASK 0xff /end CHARACTERISTIC
/begin COMPU_METHOD CRI_mtranB_chk2_COMPU_VTAB "Verbal Table" TAB_VERB "%.0" "list" COMPU_TAB_REF CRI_mtranB_chk2_COMPU_VTAB_REF /end COMPU_METHOD
/begin COMPU_VTAB CRI_mtranB_chk2_COMPU_VTAB_REF "Verbal Table" TAB_VERB 11 0 "Inactive" 1 "Mode 0" 2 "Mode 1" 3 "Mode 2" 4 "Mode 3" 5 "Mode 4" 6 "Mode 5" 7 "Mode 6" 8 "Mode 7" 9 "Mode 8" 10 "Mode 9" DEFAULT_VALUE "UNKNOWN" /end COMPU_VTAB
/begin CHARACTERISTIC CRI_mtranB_chk3 "then check for transitioning to{CRI_mtranB_chk3&0xff=0:Inactive}{CRI_mtranB_chk3&0xff=1:Mode 0}{CRI_mtranB_chk3&0xff=2:Mode 1}{CRI_mtranB_chk3&0xff=3:Mode 2}{CRI_mtranB_chk3&0xff=4:Mode 3}{CRI_mtranB_chk3&0xff=5:Mode 4}{CRI_mtranB_chk3&0xff=6:Mode 5}{CRI_" VALUE 0x001F1A53 /* @ECU_Address@CRI_mtranB_chk3@0x0100AF70@ */ ECIPP_ALIGNMENT_UBYTE 255 CRI_mtranB_chk3_COMPU_VTAB 0 255 BIT_MASK 0xff /end CHARACTERISTIC
/begin COMPU_METHOD CRI_mtranB_chk3_COMPU_VTAB "Verbal Table" TAB_VERB "%.0" "list" COMPU_TAB_REF CRI_mtranB_chk3_COMPU_VTAB_REF /end COMPU_METHOD
/begin COMPU_VTAB CRI_mtranB_chk3_COMPU_VTAB_REF "Verbal Table" TAB_VERB 11 0 "Inactive" 1 "Mode 0" 2 "Mode 1" 3 "Mode 2" 4 "Mode 3" 5 "Mode 4" 6 "Mode 5" 7 "Mode 6" 8 "Mode 7" 9 "Mode 8" 10 "Mode 9" DEFAULT_VALUE "UNKNOWN" /end COMPU_VTAB
/begin CHARACTERISTIC CRI_mtranB_chk4 "then check for transitioning to{CRI_mtranB_chk4&0xff=0:Inactive}{CRI_mtranB_chk4&0xff=1:Mode 0}{CRI_mtranB_chk4&0xff=2:Mode 1}{CRI_mtranB_chk4&0xff=3:Mode 2}{CRI_mtranB_chk4&0xff=4:Mode 3}{CRI_mtranB_chk4&0xff=5:Mode 4}{CRI_mtranB_chk4&0xff=6:Mode 5}{CRI_" VALUE 0x001F1A54 /* @ECU_Address@CRI_mtranB_chk4@0x0100AF78@ */ ECIPP_ALIGNMENT_UBYTE 255 CRI_mtranB_chk4_COMPU_VTAB 0 255 BIT_MASK 0xff /end CHARACTERISTIC
/begin COMPU_METHOD CRI_mtranB_chk4_COMPU_VTAB "Verbal Table" TAB_VERB "%.0" "list" COMPU_TAB_REF CRI_mtranB_chk4_COMPU_VTAB_REF /end COMPU_METHOD
/begin COMPU_VTAB CRI_mtranB_chk4_COMPU_VTAB_REF "Verbal Table" TAB_VERB 11 0 "Inactive" 1 "Mode 0" 2 "Mode 1" 3 "Mode 2" 4 "Mode 3" 5 "Mode 4" 6 "Mode 5" 7 "Mode 6" 8 "Mode 7" 9 "Mode 8" 10 "Mode 9" DEFAULT_VALUE "UNKNOWN" /end COMPU_VTAB
/begin CHARACTERISTIC CRI_mtranB_chk5 "then check for transitioning to{CRI_mtranB_chk5&0xff=0:Inactive}{CRI_mtranB_chk5&0xff=1:Mode 0}{CRI_mtranB_chk5&0xff=2:Mode 1}{CRI_mtranB_chk5&0xff=3:Mode 2}{CRI_mtranB_chk5&0xff=4:Mode 3}{CRI_mtranB_chk5&0xff=5:Mode 4}{CRI_mtranB_chk5&0xff=6:Mode 5}{CRI_" VALUE 0x001F1A55 /* @ECU_Address@CRI_mtranB_chk5@0x0100AF80@ */ ECIPP_ALIGNMENT_UBYTE 255 CRI_mtranB_chk5_COMPU_VTAB 0 255 BIT_MASK 0xff /end CHARACTERISTIC
/begin COMPU_METHOD CRI_mtranB_chk5_COMPU_VTAB "Verbal Table" TAB_VERB "%.0" "list" COMPU_TAB_REF CRI_mtranB_chk5_COMPU_VTAB_REF /end COMPU_METHOD
/begin COMPU_VTAB CRI_mtranB_chk5_COMPU_VTAB_REF "Verbal Table" TAB_VERB 11 0 "Inactive" 1 "Mode 0" 2 "Mode 1" 3 "Mode 2" 4 "Mode 3" 5 "Mode 4" 6 "Mode 5" 7 "Mode 6" 8 "Mode 7" 9 "Mode 8" 10 "Mode 9" DEFAULT_VALUE "UNKNOWN" /end COMPU_VTAB
/begin CHARACTERISTIC CRI_mtranB_chk6 "then check for transitioning to{CRI_mtranB_chk6&0xff=0:Inactive}{CRI_mtranB_chk6&0xff=1:Mode 0}{CRI_mtranB_chk6&0xff=2:Mode 1}{CRI_mtranB_chk6&0xff=3:Mode 2}{CRI_mtranB_chk6&0xff=4:Mode 3}{CRI_mtranB_chk6&0xff=5:Mode 4}{CRI_mtranB_chk6&0xff=6:Mode 5}{CRI_" VALUE 0x001F1A56 /* @ECU_Address@CRI_mtranB_chk6@0x0100AF88@ */ ECIPP_ALIGNMENT_UBYTE 255 CRI_mtranB_chk6_COMPU_VTAB 0 255 BIT_MASK 0xff /end CHARACTERISTIC
/begin COMPU_METHOD CRI_mtranB_chk6_COMPU_VTAB "Verbal Table" TAB_VERB "%.0" "list" COMPU_TAB_REF CRI_mtranB_chk6_COMPU_VTAB_REF /end COMPU_METHOD
/begin COMPU_VTAB CRI_mtranB_chk6_COMPU_VTAB_REF "Verbal Table" TAB_VERB 11 0 "Inactive" 1 "Mode 0" 2 "Mode 1" 3 "Mode 2" 4 "Mode 3" 5 "Mode 4" 6 "Mode 5" 7 "Mode 6" 8 "Mode 7" 9 "Mode 8" 10 "Mode 9" DEFAULT_VALUE "UNKNOWN" /end COMPU_VTAB
/begin CHARACTERISTIC CRI_mtranB_chk7 "then check for transitioning to{CRI_mtranB_chk7&0xff=0:Inactive}{CRI_mtranB_chk7&0xff=1:Mode 0}{CRI_mtranB_chk7&0xff=2:Mode 1}{CRI_mtranB_chk7&0xff=3:Mode 2}{CRI_mtranB_chk7&0xff=4:Mode 3}{CRI_mtranB_chk7&0xff=5:Mode 4}{CRI_mtranB_chk7&0xff=6:Mode 5}{CRI_" VALUE 0x001F1A57 /* @ECU_Address@CRI_mtranB_chk7@0x0100AF90@ */ ECIPP_ALIGNMENT_UBYTE 255 CRI_mtranB_chk7_COMPU_VTAB 0 255 BIT_MASK 0xff /end CHARACTERISTIC
/begin COMPU_METHOD CRI_mtranB_chk7_COMPU_VTAB "Verbal Table" TAB_VERB "%.0" "list" COMPU_TAB_REF CRI_mtranB_chk7_COMPU_VTAB_REF /end COMPU_METHOD
/begin COMPU_VTAB CRI_mtranB_chk7_COMPU_VTAB_REF "Verbal Table" TAB_VERB 11 0 "Inactive" 1 "Mode 0" 2 "Mode 1" 3 "Mode 2" 4 "Mode 3" 5 "Mode 4" 6 "Mode 5" 7 "Mode 6" 8 "Mode 7" 9 "Mode 8" 10 "Mode 9" DEFAULT_VALUE "UNKNOWN" /end COMPU_VTAB
/begin CHARACTERISTIC CRI_mtranB_chk8 "then check for transitioning to{CRI_mtranB_chk8&0xff=0:Inactive}{CRI_mtranB_chk8&0xff=1:Mode 0}{CRI_mtranB_chk8&0xff=2:Mode 1}{CRI_mtranB_chk8&0xff=3:Mode 2}{CRI_mtranB_chk8&0xff=4:Mode 3}{CRI_mtranB_chk8&0xff=5:Mode 4}{CRI_mtranB_chk8&0xff=6:Mode 5}{CRI_" VALUE 0x001F1A58 /* @ECU_Address@CRI_mtranB_chk8@0x0100AF98@ */ ECIPP_ALIGNMENT_UBYTE 255 CRI_mtranB_chk8_COMPU_VTAB 0 255 BIT_MASK 0xff /end CHARACTERISTIC
/begin COMPU_METHOD CRI_mtranB_chk8_COMPU_VTAB "Verbal Table" TAB_VERB "%.0" "list" COMPU_TAB_REF CRI_mtranB_chk8_COMPU_VTAB_REF /end COMPU_METHOD
/begin COMPU_VTAB CRI_mtranB_chk8_COMPU_VTAB_REF "Verbal Table" TAB_VERB 11 0 "Inactive" 1 "Mode 0" 2 "Mode 1" 3 "Mode 2" 4 "Mode 3" 5 "Mode 4" 6 "Mode 5" 7 "Mode 6" 8 "Mode 7" 9 "Mode 8" 10 "Mode 9" DEFAULT_VALUE "UNKNOWN" /end COMPU_VTAB
/begin CHARACTERISTIC CRI_mtranB_chk9 "then check for transitioning to{CRI_mtranB_chk9&0xff=0:Inactive}{CRI_mtranB_chk9&0xff=1:Mode 0}{CRI_mtranB_chk9&0xff=2:Mode 1}{CRI_mtranB_chk9&0xff=3:Mode 2}{CRI_mtranB_chk9&0xff=4:Mode 3}{CRI_mtranB_chk9&0xff=5:Mode 4}{CRI_mtranB_chk9&0xff=6:Mode 5}{CRI_" VALUE 0x001F1A59 /* @ECU_Address@CRI_mtranB_chk9@0x0100AFA0@ */ ECIPP_ALIGNMENT_UBYTE 255 CRI_mtranB_chk9_COMPU_VTAB 0 255 BIT_MASK 0xff /end CHARACTERISTIC
/begin COMPU_METHOD CRI_mtranB_chk9_COMPU_VTAB "Verbal Table" TAB_VERB "%.0" "list" COMPU_TAB_REF CRI_mtranB_chk9_COMPU_VTAB_REF /end COMPU_METHOD
/begin COMPU_VTAB CRI_mtranB_chk9_COMPU_VTAB_REF "Verbal Table" TAB_VERB 11 0 "Inactive" 1 "Mode 0" 2 "Mode 1" 3 "Mode 2" 4 "Mode 3" 5 "Mode 4" 6 "Mode 5" 7 "Mode 6" 8 "Mode 7" 9 "Mode 8" 10 "Mode 9" DEFAULT_VALUE "UNKNOWN" /end COMPU_VTAB
/begin CHARACTERISTIC CRI_mtranC_chk0 "then check for transitioning to{CRI_mtranC_chk0&0xff=0:Inactive}{CRI_mtranC_chk0&0xff=1:Mode 0}{CRI_mtranC_chk0&0xff=2:Mode 1}{CRI_mtranC_chk0&0xff=3:Mode 2}{CRI_mtranC_chk0&0xff=4:Mode 3}{CRI_mtranC_chk0&0xff=5:Mode 4}{CRI_mtranC_chk0&0xff=6:Mode 5}{CRI_" VALUE 0x001F1A5A /* @ECU_Address@CRI_mtranC_chk0@0x0100AFA8@ */ ECIPP_ALIGNMENT_UBYTE 255 CRI_mtranC_chk0_COMPU_VTAB 0 255 BIT_MASK 0xff /end CHARACTERISTIC
/begin COMPU_METHOD CRI_mtranC_chk0_COMPU_VTAB "Verbal Table" TAB_VERB "%.0" "list" COMPU_TAB_REF CRI_mtranC_chk0_COMPU_VTAB_REF /end COMPU_METHOD
/begin COMPU_VTAB CRI_mtranC_chk0_COMPU_VTAB_REF "Verbal Table" TAB_VERB 11 0 "Inactive" 1 "Mode 0" 2 "Mode 1" 3 "Mode 2" 4 "Mode 3" 5 "Mode 4" 6 "Mode 5" 7 "Mode 6" 8 "Mode 7" 9 "Mode 8" 10 "Mode 9" DEFAULT_VALUE "UNKNOWN" /end COMPU_VTAB
/begin CHARACTERISTIC CRI_mtranC_chk1 "then check for transitioning to{CRI_mtranC_chk1&0xff=0:Inactive}{CRI_mtranC_chk1&0xff=1:Mode 0}{CRI_mtranC_chk1&0xff=2:Mode 1}{CRI_mtranC_chk1&0xff=3:Mode 2}{CRI_mtranC_chk1&0xff=4:Mode 3}{CRI_mtranC_chk1&0xff=5:Mode 4}{CRI_mtranC_chk1&0xff=6:Mode 5}{CRI_" VALUE 0x001F1A5B /* @ECU_Address@CRI_mtranC_chk1@0x0100AFB0@ */ ECIPP_ALIGNMENT_UBYTE 255 CRI_mtranC_chk1_COMPU_VTAB 0 255 BIT_MASK 0xff /end CHARACTERISTIC
/begin COMPU_METHOD CRI_mtranC_chk1_COMPU_VTAB "Verbal Table" TAB_VERB "%.0" "list" COMPU_TAB_REF CRI_mtranC_chk1_COMPU_VTAB_REF /end COMPU_METHOD
/begin COMPU_VTAB CRI_mtranC_chk1_COMPU_VTAB_REF "Verbal Table" TAB_VERB 11 0 "Inactive" 1 "Mode 0" 2 "Mode 1" 3 "Mode 2" 4 "Mode 3" 5 "Mode 4" 6 "Mode 5" 7 "Mode 6" 8 "Mode 7" 9 "Mode 8" 10 "Mode 9" DEFAULT_VALUE "UNKNOWN" /end COMPU_VTAB
/begin CHARACTERISTIC CRI_mtranC_chk2 "then check for transitioning to{CRI_mtranC_chk2&0xff=0:Inactive}{CRI_mtranC_chk2&0xff=1:Mode 0}{CRI_mtranC_chk2&0xff=2:Mode 1}{CRI_mtranC_chk2&0xff=3:Mode 2}{CRI_mtranC_chk2&0xff=4:Mode 3}{CRI_mtranC_chk2&0xff=5:Mode 4}{CRI_mtranC_chk2&0xff=6:Mode 5}{CRI_" VALUE 0x001F1A5C /* @ECU_Address@CRI_mtranC_chk2@0x0100AFB8@ */ ECIPP_ALIGNMENT_UBYTE 255 CRI_mtranC_chk2_COMPU_VTAB 0 255 BIT_MASK 0xff /end CHARACTERISTIC
/begin COMPU_METHOD CRI_mtranC_chk2_COMPU_VTAB "Verbal Table" TAB_VERB "%.0" "list" COMPU_TAB_REF CRI_mtranC_chk2_COMPU_VTAB_REF /end COMPU_METHOD
/begin COMPU_VTAB CRI_mtranC_chk2_COMPU_VTAB_REF "Verbal Table" TAB_VERB 11 0 "Inactive" 1 "Mode 0" 2 "Mode 1" 3 "Mode 2" 4 "Mode 3" 5 "Mode 4" 6 "Mode 5" 7 "Mode 6" 8 "Mode 7" 9 "Mode 8" 10 "Mode 9" DEFAULT_VALUE "UNKNOWN" /end COMPU_VTAB
/begin CHARACTERISTIC CRI_mtranC_chk3 "then check for transitioning to{CRI_mtranC_chk3&0xff=0:Inactive}{CRI_mtranC_chk3&0xff=1:Mode 0}{CRI_mtranC_chk3&0xff=2:Mode 1}{CRI_mtranC_chk3&0xff=3:Mode 2}{CRI_mtranC_chk3&0xff=4:Mode 3}{CRI_mtranC_chk3&0xff=5:Mode 4}{CRI_mtranC_chk3&0xff=6:Mode 5}{CRI_" VALUE 0x001F1A5D /* @ECU_Address@CRI_mtranC_chk3@0x0100AFC0@ */ ECIPP_ALIGNMENT_UBYTE 255 CRI_mtranC_chk3_COMPU_VTAB 0 255 BIT_MASK 0xff /end CHARACTERISTIC
/begin COMPU_METHOD CRI_mtranC_chk3_COMPU_VTAB "Verbal Table" TAB_VERB "%.0" "list" COMPU_TAB_REF CRI_mtranC_chk3_COMPU_VTAB_REF /end COMPU_METHOD
/begin COMPU_VTAB CRI_mtranC_chk3_COMPU_VTAB_REF "Verbal Table" TAB_VERB 11 0 "Inactive" 1 "Mode 0" 2 "Mode 1" 3 "Mode 2" 4 "Mode 3" 5 "Mode 4" 6 "Mode 5" 7 "Mode 6" 8 "Mode 7" 9 "Mode 8" 10 "Mode 9" DEFAULT_VALUE "UNKNOWN" /end COMPU_VTAB
/begin CHARACTERISTIC CRI_mtranC_chk4 "then check for transitioning to{CRI_mtranC_chk4&0xff=0:Inactive}{CRI_mtranC_chk4&0xff=1:Mode 0}{CRI_mtranC_chk4&0xff=2:Mode 1}{CRI_mtranC_chk4&0xff=3:Mode 2}{CRI_mtranC_chk4&0xff=4:Mode 3}{CRI_mtranC_chk4&0xff=5:Mode 4}{CRI_mtranC_chk4&0xff=6:Mode 5}{CRI_" VALUE 0x001F1A5E /* @ECU_Address@CRI_mtranC_chk4@0x0100AFC8@ */ ECIPP_ALIGNMENT_UBYTE 255 CRI_mtranC_chk4_COMPU_VTAB 0 255 BIT_MASK 0xff /end CHARACTERISTIC
/begin COMPU_METHOD CRI_mtranC_chk4_COMPU_VTAB "Verbal Table" TAB_VERB "%.0" "list" COMPU_TAB_REF CRI_mtranC_chk4_COMPU_VTAB_REF /end COMPU_METHOD
/begin COMPU_VTAB CRI_mtranC_chk4_COMPU_VTAB_REF "Verbal Table" TAB_VERB 11 0 "Inactive" 1 "Mode 0" 2 "Mode 1" 3 "Mode 2" 4 "Mode 3" 5 "Mode 4" 6 "Mode 5" 7 "Mode 6" 8 "Mode 7" 9 "Mode 8" 10 "Mode 9" DEFAULT_VALUE "UNKNOWN" /end COMPU_VTAB
/begin CHARACTERISTIC CRI_mtranC_chk5 "then check for transitioning to{CRI_mtranC_chk5&0xff=0:Inactive}{CRI_mtranC_chk5&0xff=1:Mode 0}{CRI_mtranC_chk5&0xff=2:Mode 1}{CRI_mtranC_chk5&0xff=3:Mode 2}{CRI_mtranC_chk5&0xff=4:Mode 3}{CRI_mtranC_chk5&0xff=5:Mode 4}{CRI_mtranC_chk5&0xff=6:Mode 5}{CRI_" VALUE 0x001F1A5F /* @ECU_Address@CRI_mtranC_chk5@0x0100AFD0@ */ ECIPP_ALIGNMENT_UBYTE 255 CRI_mtranC_chk5_COMPU_VTAB 0 255 BIT_MASK 0xff /end CHARACTERISTIC
/begin COMPU_METHOD CRI_mtranC_chk5_COMPU_VTAB "Verbal Table" TAB_VERB "%.0" "list" COMPU_TAB_REF CRI_mtranC_chk5_COMPU_VTAB_REF /end COMPU_METHOD
/begin COMPU_VTAB CRI_mtranC_chk5_COMPU_VTAB_REF "Verbal Table" TAB_VERB 11 0 "Inactive" 1 "Mode 0" 2 "Mode 1" 3 "Mode 2" 4 "Mode 3" 5 "Mode 4" 6 "Mode 5" 7 "Mode 6" 8 "Mode 7" 9 "Mode 8" 10 "Mode 9" DEFAULT_VALUE "UNKNOWN" /end COMPU_VTAB
/begin CHARACTERISTIC CRI_mtranC_chk6 "then check for transitioning to{CRI_mtranC_chk6&0xff=0:Inactive}{CRI_mtranC_chk6&0xff=1:Mode 0}{CRI_mtranC_chk6&0xff=2:Mode 1}{CRI_mtranC_chk6&0xff=3:Mode 2}{CRI_mtranC_chk6&0xff=4:Mode 3}{CRI_mtranC_chk6&0xff=5:Mode 4}{CRI_mtranC_chk6&0xff=6:Mode 5}{CRI_" VALUE 0x001F1A60 /* @ECU_Address@CRI_mtranC_chk6@0x0100AFD8@ */ ECIPP_ALIGNMENT_UBYTE 255 CRI_mtranC_chk6_COMPU_VTAB 0 255 BIT_MASK 0xff /end CHARACTERISTIC
/begin COMPU_METHOD CRI_mtranC_chk6_COMPU_VTAB "Verbal Table" TAB_VERB "%.0" "list" COMPU_TAB_REF CRI_mtranC_chk6_COMPU_VTAB_REF /end COMPU_METHOD
/begin COMPU_VTAB CRI_mtranC_chk6_COMPU_VTAB_REF "Verbal Table" TAB_VERB 11 0 "Inactive" 1 "Mode 0" 2 "Mode 1" 3 "Mode 2" 4 "Mode 3" 5 "Mode 4" 6 "Mode 5" 7 "Mode 6" 8 "Mode 7" 9 "Mode 8" 10 "Mode 9" DEFAULT_VALUE "UNKNOWN" /end COMPU_VTAB
/begin CHARACTERISTIC CRI_mtranC_chk7 "then check for transitioning to{CRI_mtranC_chk7&0xff=0:Inactive}{CRI_mtranC_chk7&0xff=1:Mode 0}{CRI_mtranC_chk7&0xff=2:Mode 1}{CRI_mtranC_chk7&0xff=3:Mode 2}{CRI_mtranC_chk7&0xff=4:Mode 3}{CRI_mtranC_chk7&0xff=5:Mode 4}{CRI_mtranC_chk7&0xff=6:Mode 5}{CRI_" VALUE 0x001F1A61 /* @ECU_Address@CRI_mtranC_chk7@0x0100AFE0@ */ ECIPP_ALIGNMENT_UBYTE 255 CRI_mtranC_chk7_COMPU_VTAB 0 255 BIT_MASK 0xff /end CHARACTERISTIC
/begin COMPU_METHOD CRI_mtranC_chk7_COMPU_VTAB "Verbal Table" TAB_VERB "%.0" "list" COMPU_TAB_REF CRI_mtranC_chk7_COMPU_VTAB_REF /end COMPU_METHOD
/begin COMPU_VTAB CRI_mtranC_chk7_COMPU_VTAB_REF "Verbal Table" TAB_VERB 11 0 "Inactive" 1 "Mode 0" 2 "Mode 1" 3 "Mode 2" 4 "Mode 3" 5 "Mode 4" 6 "Mode 5" 7 "Mode 6" 8 "Mode 7" 9 "Mode 8" 10 "Mode 9" DEFAULT_VALUE "UNKNOWN" /end COMPU_VTAB
/begin CHARACTERISTIC CRI_mtranC_chk8 "then check for transitioning to{CRI_mtranC_chk8&0xff=0:Inactive}{CRI_mtranC_chk8&0xff=1:Mode 0}{CRI_mtranC_chk8&0xff=2:Mode 1}{CRI_mtranC_chk8&0xff=3:Mode 2}{CRI_mtranC_chk8&0xff=4:Mode 3}{CRI_mtranC_chk8&0xff=5:Mode 4}{CRI_mtranC_chk8&0xff=6:Mode 5}{CRI_" VALUE 0x001F1A62 /* @ECU_Address@CRI_mtranC_chk8@0x0100AFE8@ */ ECIPP_ALIGNMENT_UBYTE 255 CRI_mtranC_chk8_COMPU_VTAB 0 255 BIT_MASK 0xff /end CHARACTERISTIC
/begin COMPU_METHOD CRI_mtranC_chk8_COMPU_VTAB "Verbal Table" TAB_VERB "%.0" "list" COMPU_TAB_REF CRI_mtranC_chk8_COMPU_VTAB_REF /end COMPU_METHOD
/begin COMPU_VTAB CRI_mtranC_chk8_COMPU_VTAB_REF "Verbal Table" TAB_VERB 11 0 "Inactive" 1 "Mode 0" 2 "Mode 1" 3 "Mode 2" 4 "Mode 3" 5 "Mode 4" 6 "Mode 5" 7 "Mode 6" 8 "Mode 7" 9 "Mode 8" 10 "Mode 9" DEFAULT_VALUE "UNKNOWN" /end COMPU_VTAB
/begin CHARACTERISTIC CRI_mtranC_chk9 "then check for transitioning to{CRI_mtranC_chk9&0xff=0:Inactive}{CRI_mtranC_chk9&0xff=1:Mode 0}{CRI_mtranC_chk9&0xff=2:Mode 1}{CRI_mtranC_chk9&0xff=3:Mode 2}{CRI_mtranC_chk9&0xff=4:Mode 3}{CRI_mtranC_chk9&0xff=5:Mode 4}{CRI_mtranC_chk9&0xff=6:Mode 5}{CRI_" VALUE 0x001F1A63 /* @ECU_Address@CRI_mtranC_chk9@0x0100AFF0@ */ ECIPP_ALIGNMENT_UBYTE 255 CRI_mtranC_chk9_COMPU_VTAB 0 255 BIT_MASK 0xff /end CHARACTERISTIC
/begin COMPU_METHOD CRI_mtranC_chk9_COMPU_VTAB "Verbal Table" TAB_VERB "%.0" "list" COMPU_TAB_REF CRI_mtranC_chk9_COMPU_VTAB_REF /end COMPU_METHOD
/begin COMPU_VTAB CRI_mtranC_chk9_COMPU_VTAB_REF "Verbal Table" TAB_VERB 11 0 "Inactive" 1 "Mode 0" 2 "Mode 1" 3 "Mode 2" 4 "Mode 3" 5 "Mode 4" 6 "Mode 5" 7 "Mode 6" 8 "Mode 7" 9 "Mode 8" 10 "Mode 9" DEFAULT_VALUE "UNKNOWN" /end COMPU_VTAB
/begin CHARACTERISTIC CRI_mtranA_persist0 "after being in this mode for" VALUE 0x001EE55C /* @ECU_Address@CRI_mtranA_persist0@0x0100AFF8@ */ ECIPP_ALIGNMENT_ULONG 4294967 Compu_CRI_mtranA_persist0 0 4294967.295 /end CHARACTERISTIC
/begin COMPU_METHOD Compu_CRI_mtranA_persist0 " " RAT_FUNC "%.1" "sec" COEFFS 0 1000 0 0 0 1 /end COMPU_METHOD
/begin CHARACTERISTIC CRI_mtranA_persist1 "after being in this mode for" VALUE 0x001EE560 /* @ECU_Address@CRI_mtranA_persist1@0x0100B000@ */ ECIPP_ALIGNMENT_ULONG 4294967 Compu_CRI_mtranA_persist1 0 4294967.295 /end CHARACTERISTIC
/begin COMPU_METHOD Compu_CRI_mtranA_persist1 " " RAT_FUNC "%.1" "sec" COEFFS 0 1000 0 0 0 1 /end COMPU_METHOD
/begin CHARACTERISTIC CRI_mtranA_persist2 "after being in this mode for" VALUE 0x001EE564 /* @ECU_Address@CRI_mtranA_persist2@0x0100B008@ */ ECIPP_ALIGNMENT_ULONG 4294967 Compu_CRI_mtranA_persist2 0 4294967.295 /end CHARACTERISTIC
/begin COMPU_METHOD Compu_CRI_mtranA_persist2 " " RAT_FUNC "%.1" "sec" COEFFS 0 1000 0 0 0 1 /end COMPU_METHOD
/begin CHARACTERISTIC CRI_mtranA_persist3 "after being in this mode for" VALUE 0x001EE568 /* @ECU_Address@CRI_mtranA_persist3@0x0100B010@ */ ECIPP_ALIGNMENT_ULONG 4294967 Compu_CRI_mtranA_persist3 0 4294967.295 /end CHARACTERISTIC
/begin COMPU_METHOD Compu_CRI_mtranA_persist3 " " RAT_FUNC "%.1" "sec" COEFFS 0 1000 0 0 0 1 /end COMPU_METHOD
/begin CHARACTERISTIC CRI_mtranA_persist4 "after being in this mode for" VALUE 0x001EE56C /* @ECU_Address@CRI_mtranA_persist4@0x0100B018@ */ ECIPP_ALIGNMENT_ULONG 4294967 Compu_CRI_mtranA_persist4 0 4294967.295 /end CHARACTERISTIC
/begin COMPU_METHOD Compu_CRI_mtranA_persist4 " " RAT_FUNC "%.1" "sec" COEFFS 0 1000 0 0 0 1 /end COMPU_METHOD
/begin CHARACTERISTIC CRI_mtranA_persist5 "after being in this mode for" VALUE 0x001EE570 /* @ECU_Address@CRI_mtranA_persist5@0x0100B020@ */ ECIPP_ALIGNMENT_ULONG 4294967 Compu_CRI_mtranA_persist5 0 4294967.295 /end CHARACTERISTIC
/begin COMPU_METHOD Compu_CRI_mtranA_persist5 " " RAT_FUNC "%.1" "sec" COEFFS 0 1000 0 0 0 1 /end COMPU_METHOD
/begin CHARACTERISTIC CRI_mtranA_persist6 "after being in this mode for" VALUE 0x001EE574 /* @ECU_Address@CRI_mtranA_persist6@0x0100B028@ */ ECIPP_ALIGNMENT_ULONG 4294967 Compu_CRI_mtranA_persist6 0 4294967.295 /end CHARACTERISTIC
/begin COMPU_METHOD Compu_CRI_mtranA_persist6 " " RAT_FUNC "%.1" "sec" COEFFS 0 1000 0 0 0 1 /end COMPU_METHOD
/begin CHARACTERISTIC CRI_mtranA_persist7 "after being in this mode for" VALUE 0x001EE578 /* @ECU_Address@CRI_mtranA_persist7@0x0100B030@ */ ECIPP_ALIGNMENT_ULONG 4294967 Compu_CRI_mtranA_persist7 0 4294967.295 /end CHARACTERISTIC
/begin COMPU_METHOD Compu_CRI_mtranA_persist7 " " RAT_FUNC "%.1" "sec" COEFFS 0 1000 0 0 0 1 /end COMPU_METHOD
/begin CHARACTERISTIC CRI_mtranA_persist8 "after being in this mode for" VALUE 0x001EE57C /* @ECU_Address@CRI_mtranA_persist8@0x0100B038@ */ ECIPP_ALIGNMENT_ULONG 4294967 Compu_CRI_mtranA_persist8 0 4294967.295 /end CHARACTERISTIC
/begin COMPU_METHOD Compu_CRI_mtranA_persist8 " " RAT_FUNC "%.1" "sec" COEFFS 0 1000 0 0 0 1 /end COMPU_METHOD
/begin CHARACTERISTIC CRI_mtranA_persist9 "after being in this mode for" VALUE 0x001EE580 /* @ECU_Address@CRI_mtranA_persist9@0x0100B040@ */ ECIPP_ALIGNMENT_ULONG 4294967 Compu_CRI_mtranA_persist9 0 4294967.295 /end CHARACTERISTIC
/begin COMPU_METHOD Compu_CRI_mtranA_persist9 " " RAT_FUNC "%.1" "sec" COEFFS 0 1000 0 0 0 1 /end COMPU_METHOD
/begin CHARACTERISTIC CRI_mtranB_persist0 "after being in this mode for" VALUE 0x001EE584 /* @ECU_Address@CRI_mtranB_persist0@0x0100B048@ */ ECIPP_ALIGNMENT_ULONG 4294967 Compu_CRI_mtranB_persist0 0 4294967.295 /end CHARACTERISTIC
/begin COMPU_METHOD Compu_CRI_mtranB_persist0 " " RAT_FUNC "%.1" "sec" COEFFS 0 1000 0 0 0 1 /end COMPU_METHOD
/begin CHARACTERISTIC CRI_mtranB_persist1 "after being in this mode for" VALUE 0x001EE588 /* @ECU_Address@CRI_mtranB_persist1@0x0100B050@ */ ECIPP_ALIGNMENT_ULONG 4294967 Compu_CRI_mtranB_persist1 0 4294967.295 /end CHARACTERISTIC
/begin COMPU_METHOD Compu_CRI_mtranB_persist1 " " RAT_FUNC "%.1" "sec" COEFFS 0 1000 0 0 0 1 /end COMPU_METHOD
/begin CHARACTERISTIC CRI_mtranB_persist2 "after being in this mode for" VALUE 0x001EE58C /* @ECU_Address@CRI_mtranB_persist2@0x0100B058@ */ ECIPP_ALIGNMENT_ULONG 4294967 Compu_CRI_mtranB_persist2 0 4294967.295 /end CHARACTERISTIC
/begin COMPU_METHOD Compu_CRI_mtranB_persist2 " " RAT_FUNC "%.1" "sec" COEFFS 0 1000 0 0 0 1 /end COMPU_METHOD
/begin CHARACTERISTIC CRI_mtranB_persist3 "after being in this mode for" VALUE 0x001EE590 /* @ECU_Address@CRI_mtranB_persist3@0x0100B060@ */ ECIPP_ALIGNMENT_ULONG 4294967 Compu_CRI_mtranB_persist3 0 4294967.295 /end CHARACTERISTIC
/begin COMPU_METHOD Compu_CRI_mtranB_persist3 " " RAT_FUNC "%.1" "sec" COEFFS 0 1000 0 0 0 1 /end COMPU_METHOD
/begin CHARACTERISTIC CRI_mtranB_persist4 "after being in this mode for" VALUE 0x001EE594 /* @ECU_Address@CRI_mtranB_persist4@0x0100B068@ */ ECIPP_ALIGNMENT_ULONG 4294967 Compu_CRI_mtranB_persist4 0 4294967.295 /end CHARACTERISTIC
/begin COMPU_METHOD Compu_CRI_mtranB_persist4 " " RAT_FUNC "%.1" "sec" COEFFS 0 1000 0 0 0 1 /end COMPU_METHOD
/begin CHARACTERISTIC CRI_mtranB_persist5 "after being in this mode for" VALUE 0x001EE598 /* @ECU_Address@CRI_mtranB_persist5@0x0100B070@ */ ECIPP_ALIGNMENT_ULONG 4294967 Compu_CRI_mtranB_persist5 0 4294967.295 /end CHARACTERISTIC
/begin COMPU_METHOD Compu_CRI_mtranB_persist5 " " RAT_FUNC "%.1" "sec" COEFFS 0 1000 0 0 0 1 /end COMPU_METHOD
/begin CHARACTERISTIC CRI_mtranB_persist6 "after being in this mode for" VALUE 0x001EE59C /* @ECU_Address@CRI_mtranB_persist6@0x0100B078@ */ ECIPP_ALIGNMENT_ULONG 4294967 Compu_CRI_mtranB_persist6 0 4294967.295 /end CHARACTERISTIC
/begin COMPU_METHOD Compu_CRI_mtranB_persist6 " " RAT_FUNC "%.1" "sec" COEFFS 0 1000 0 0 0 1 /end COMPU_METHOD
/begin CHARACTERISTIC CRI_mtranB_persist7 "after being in this mode for" VALUE 0x001EE5A0 /* @ECU_Address@CRI_mtranB_persist7@0x0100B080@ */ ECIPP_ALIGNMENT_ULONG 4294967 Compu_CRI_mtranB_persist7 0 4294967.295 /end CHARACTERISTIC
/begin COMPU_METHOD Compu_CRI_mtranB_persist7 " " RAT_FUNC "%.1" "sec" COEFFS 0 1000 0 0 0 1 /end COMPU_METHOD
/begin CHARACTERISTIC CRI_mtranB_persist8 "after being in this mode for" VALUE 0x001EE5A4 /* @ECU_Address@CRI_mtranB_persist8@0x0100B088@ */ ECIPP_ALIGNMENT_ULONG 4294967 Compu_CRI_mtranB_persist8 0 4294967.295 /end CHARACTERISTIC
/begin COMPU_METHOD Compu_CRI_mtranB_persist8 " " RAT_FUNC "%.1" "sec" COEFFS 0 1000 0 0 0 1 /end COMPU_METHOD
/begin CHARACTERISTIC CRI_mtranB_persist9 "after being in this mode for" VALUE 0x001EE5A8 /* @ECU_Address@CRI_mtranB_persist9@0x0100B090@ */ ECIPP_ALIGNMENT_ULONG 4294967 Compu_CRI_mtranB_persist9 0 4294967.295 /end CHARACTERISTIC
/begin COMPU_METHOD Compu_CRI_mtranB_persist9 " " RAT_FUNC "%.1" "sec" COEFFS 0 1000 0 0 0 1 /end COMPU_METHOD
/begin CHARACTERISTIC CRI_mtranC_persist0 "after being in this mode for" VALUE 0x001EE5AC /* @ECU_Address@CRI_mtranC_persist0@0x0100B098@ */ ECIPP_ALIGNMENT_ULONG 4294967 Compu_CRI_mtranC_persist0 0 4294967.295 /end CHARACTERISTIC
/begin COMPU_METHOD Compu_CRI_mtranC_persist0 " " RAT_FUNC "%.1" "sec" COEFFS 0 1000 0 0 0 1 /end COMPU_METHOD
/begin CHARACTERISTIC CRI_mtranC_persist1 "after being in this mode for" VALUE 0x001EE5B0 /* @ECU_Address@CRI_mtranC_persist1@0x0100B0A0@ */ ECIPP_ALIGNMENT_ULONG 4294967 Compu_CRI_mtranC_persist1 0 4294967.295 /end CHARACTERISTIC
/begin COMPU_METHOD Compu_CRI_mtranC_persist1 " " RAT_FUNC "%.1" "sec" COEFFS 0 1000 0 0 0 1 /end COMPU_METHOD
/begin CHARACTERISTIC CRI_mtranC_persist2 "after being in this mode for" VALUE 0x001EE5B4 /* @ECU_Address@CRI_mtranC_persist2@0x0100B0A8@ */ ECIPP_ALIGNMENT_ULONG 4294967 Compu_CRI_mtranC_persist2 0 4294967.295 /end CHARACTERISTIC
/begin COMPU_METHOD Compu_CRI_mtranC_persist2 " " RAT_FUNC "%.1" "sec" COEFFS 0 1000 0 0 0 1 /end COMPU_METHOD
/begin CHARACTERISTIC CRI_mtranC_persist3 "after being in this mode for" VALUE 0x001EE5B8 /* @ECU_Address@CRI_mtranC_persist3@0x0100B0B0@ */ ECIPP_ALIGNMENT_ULONG 4294967 Compu_CRI_mtranC_persist3 0 4294967.295 /end CHARACTERISTIC
/begin COMPU_METHOD Compu_CRI_mtranC_persist3 " " RAT_FUNC "%.1" "sec" COEFFS 0 1000 0 0 0 1 /end COMPU_METHOD
/begin CHARACTERISTIC CRI_mtranC_persist4 "after being in this mode for" VALUE 0x001EE5BC /* @ECU_Address@CRI_mtranC_persist4@0x0100B0B8@ */ ECIPP_ALIGNMENT_ULONG 4294967 Compu_CRI_mtranC_persist4 0 4294967.295 /end CHARACTERISTIC
/begin COMPU_METHOD Compu_CRI_mtranC_persist4 " " RAT_FUNC "%.1" "sec" COEFFS 0 1000 0 0 0 1 /end COMPU_METHOD
/begin CHARACTERISTIC CRI_mtranC_persist5 "after being in this mode for" VALUE 0x001EE5C0 /* @ECU_Address@CRI_mtranC_persist5@0x0100B0C0@ */ ECIPP_ALIGNMENT_ULONG 4294967 Compu_CRI_mtranC_persist5 0 4294967.295 /end CHARACTERISTIC
/begin COMPU_METHOD Compu_CRI_mtranC_persist5 " " RAT_FUNC "%.1" "sec" COEFFS 0 1000 0 0 0 1 /end COMPU_METHOD
/begin CHARACTERISTIC CRI_mtranC_persist6 "after being in this mode for" VALUE 0x001EE5C4 /* @ECU_Address@CRI_mtranC_persist6@0x0100B0C8@ */ ECIPP_ALIGNMENT_ULONG 4294967 Compu_CRI_mtranC_persist6 0 4294967.295 /end CHARACTERISTIC
/begin COMPU_METHOD Compu_CRI_mtranC_persist6 " " RAT_FUNC "%.1" "sec" COEFFS 0 1000 0 0 0 1 /end COMPU_METHOD
/begin CHARACTERISTIC CRI_mtranC_persist7 "after being in this mode for" VALUE 0x001EE5C8 /* @ECU_Address@CRI_mtranC_persist7@0x0100B0D0@ */ ECIPP_ALIGNMENT_ULONG 4294967 Compu_CRI_mtranC_persist7 0 4294967.295 /end CHARACTERISTIC
/begin COMPU_METHOD Compu_CRI_mtranC_persist7 " " RAT_FUNC "%.1" "sec" COEFFS 0 1000 0 0 0 1 /end COMPU_METHOD
/begin CHARACTERISTIC CRI_mtranC_persist8 "after being in this mode for" VALUE 0x001EE5CC /* @ECU_Address@CRI_mtranC_persist8@0x0100B0D8@ */ ECIPP_ALIGNMENT_ULONG 4294967 Compu_CRI_mtranC_persist8 0 4294967.295 /end CHARACTERISTIC
/begin COMPU_METHOD Compu_CRI_mtranC_persist8 " " RAT_FUNC "%.1" "sec" COEFFS 0 1000 0 0 0 1 /end COMPU_METHOD
/begin CHARACTERISTIC CRI_mtranC_persist9 "after being in this mode for" VALUE 0x001EE5D0 /* @ECU_Address@CRI_mtranC_persist9@0x0100B0E0@ */ ECIPP_ALIGNMENT_ULONG 4294967 Compu_CRI_mtranC_persist9 0 4294967.295 /end CHARACTERISTIC
/begin COMPU_METHOD Compu_CRI_mtranC_persist9 " " RAT_FUNC "%.1" "sec" COEFFS 0 1000 0 0 0 1 /end COMPU_METHOD
/begin MEASUREMENT Vdot_cat "Catalyst volume flow rate" UWORD Compu_Vdot_cat 0 0 0 8191.875 ECU_ADDRESS 0x01013C78 /end MEASUREMENT
/begin COMPU_METHOD Compu_Vdot_cat " " RAT_FUNC "%.1" "L / s" COEFFS 0 8 0 0 0 1 /end COMPU_METHOD
/begin CHARACTERISTIC STR_CRI_mode_0 "Mode 0" ASCII 0x001E6DFB /* @ECU_Address@STR_CRI_mode_0@0x0231D000@ */ ECIPP_ALIGNMENT_UBYTE 255 Compu_ECIPP_STRINGS 0 255 MATRIX_DIM 19 1 1 /end CHARACTERISTIC
/begin CHARACTERISTIC STR_CRI_mode_1 "Mode 1" ASCII 0x001E6E0F /* @ECU_Address@STR_CRI_mode_1@0x0231E000@ */ ECIPP_ALIGNMENT_UBYTE 255 Compu_ECIPP_STRINGS 0 255 MATRIX_DIM 19 1 1 /end CHARACTERISTIC
/begin CHARACTERISTIC STR_CRI_mode_2 "Mode 2" ASCII 0x001E6E23 /* @ECU_Address@STR_CRI_mode_2@0x0231F000@ */ ECIPP_ALIGNMENT_UBYTE 255 Compu_ECIPP_STRINGS 0 255 MATRIX_DIM 19 1 1 /end CHARACTERISTIC
/begin CHARACTERISTIC STR_CRI_mode_3 "Mode 3" ASCII 0x001E6E37 /* @ECU_Address@STR_CRI_mode_3@0x02320000@ */ ECIPP_ALIGNMENT_UBYTE 255 Compu_ECIPP_STRINGS 0 255 MATRIX_DIM 19 1 1 /end CHARACTERISTIC
/begin CHARACTERISTIC STR_CRI_mode_4 "Mode 4" ASCII 0x001E6E4B /* @ECU_Address@STR_CRI_mode_4@0x02321000@ */ ECIPP_ALIGNMENT_UBYTE 255 Compu_ECIPP_STRINGS 0 255 MATRIX_DIM 19 1 1 /end CHARACTERISTIC
/begin CHARACTERISTIC STR_CRI_mode_5 "Mode 5" ASCII 0x001E6E5F /* @ECU_Address@STR_CRI_mode_5@0x02322000@ */ ECIPP_ALIGNMENT_UBYTE 255 Compu_ECIPP_STRINGS 0 255 MATRIX_DIM 19 1 1 /end CHARACTERISTIC
/begin CHARACTERISTIC STR_CRI_mode_6 "Mode 6" ASCII 0x001E6E73 /* @ECU_Address@STR_CRI_mode_6@0x02323000@ */ ECIPP_ALIGNMENT_UBYTE 255 Compu_ECIPP_STRINGS 0 255 MATRIX_DIM 19 1 1 /end CHARACTERISTIC
/begin CHARACTERISTIC STR_CRI_mode_7 "Mode 7" ASCII 0x001E6E87 /* @ECU_Address@STR_CRI_mode_7@0x02324000@ */ ECIPP_ALIGNMENT_UBYTE 255 Compu_ECIPP_STRINGS 0 255 MATRIX_DIM 19 1 1 /end CHARACTERISTIC
/begin CHARACTERISTIC STR_CRI_mode_8 "Mode 8" ASCII 0x001E6E9B /* @ECU_Address@STR_CRI_mode_8@0x02325000@ */ ECIPP_ALIGNMENT_UBYTE 255 Compu_ECIPP_STRINGS 0 255 MATRIX_DIM 19 1 1 /end CHARACTERISTIC
/begin CHARACTERISTIC STR_CRI_mode_9 "Mode 9" ASCII 0x001E6EAF /* @ECU_Address@STR_CRI_mode_9@0x02326000@ */ ECIPP_ALIGNMENT_UBYTE 255 Compu_ECIPP_STRINGS 0 255 MATRIX_DIM 19 1 1 /end CHARACTERISTIC
/begin GROUP EC_DieselMode "ECONTROLS" ROOT
 /begin REF_CHARACTERISTIC CRI_Tmain_slct1 CRI_Tmain_slct2 CRI_Tmain_slct3 CRI_Tmain_slct4 CRI_Tmain_slct5 CRI_Tmain_slct6 CRI_Tmain_slct7 CRI_Tpost1_slct0 CRI_Tpost1_slct1 CRI_Tpost1_slct2 CRI_Tpost1_slct3 CRI_Tpost1_slct4 CRI_Tpost1_slct5 CRI_Tpost1_slct6 CRI_Tpost1_slct7 CRI_Tpost2_slct0 CRI_Tpost2_slct1 CRI_Tpost2_slct2 CRI_Tpost2_slct3 CRI_Tpost2_slct4 CRI_Tpost2_slct5 CRI_Tpost2_slct6 CRI_Tpost2_slct7 CRI_pilot1_priority0 CRI_pulseoff_slct0 CRI_pulseoff_slct1 CRI_pulseoff_slct2 CRI_pulseoff_slct3 CRI_pulseoff_slct4 CRI_pulseoff_slct5 CRI_pulseoff_slct6 CRI_pulseoff_slct7 CRI_bst_dP_scalar0 CRI_bst_dP_slct0 CRI_bst_dP_slct1 CRI_bst_dP_slct2 CRI_bst_dP_slct3 CRI_bst_dP_slct4 CRI_bst_dP_slct5 CRI_bst_dP_slct6 CRI_bst_dP_slct7 CRI_EGR_dP_slct0 CRI_EGR_dP_slct1 CRI_EGR_dP_slct2 CRI_EGR_dP_slct3 CRI_EGR_dP_slct4 CRI_EGR_dP_slct5 CRI_EGR_dP_slct6 CRI_EGR_dP_slct7 CRI_air_slct8 CRI_P_slct8 CRI_dilpct_slct8 CRI_Qpilot2_slct8 CRI_Qpilot1_slct8 CRI_Qload_slct8 CRI_Qpost1_slct8 CRI_Qpost2_slct8 CRI_Tpilot2_slct8 CRI_Tpilot1_slct8 CRI_Tmain_slct8 CRI_Tpost1_slct8 CRI_Tpost2_slct8 CRI_pulseoff_slct8 CRI_bst_dP_slct8 CRI_EGR_dP_slct8 CRI_air_slct9 CRI_P_slct9 CRI_dilpct_slct9 CRI_Qpilot2_slct9 CRI_Qpilot1_slct9 CRI_Qload_slct9 CRI_Qpost1_slct9 CRI_Qpost2_slct9 CRI_Tpilot2_slct9 CRI_Tpilot1_slct9 CRI_Tmain_slct9 CRI_Tpost1_slct9 CRI_Tpost2_slct9 CRI_pulseoff_slct9 CRI_bst_dP_slct9 CRI_EGR_dP_slct9 CRI_bst_dP_scalar1 CRI_bst_dP_scalar2 CRI_bst_dP_scalar3 CRI_bst_dP_scalar4 CRI_bst_dP_scalar5 CRI_bst_dP_scalar6 CRI_bst_dP_scalar7 CRI_bst_dP_scalar8 CRI_bst_dP_scalar9 CRI_pilot1_priority1 CRI_pilot1_priority2 CRI_pilot1_priority3 CRI_pilot1_priority4 CRI_pilot1_priority5 CRI_pilot1_priority6 CRI_pilot1_priority7 CRI_pilot1_priority8 CRI_pilot1_priority9 CRI_DOC_Tcl_slct0 CRI_DOC_Tcl_slct1 CRI_DOC_Tcl_slct2 CRI_DOC_Tcl_slct3 CRI_DOC_Tcl_slct4 CRI_DOC_Tcl_slct5 CRI_DOC_Tcl_slct6 CRI_DOC_Tcl_slct7 CRI_DOC_Tcl_slct8 CRI_DOC_Tcl_slct9 CRI_mchk_RPM0 CRI_mchk_RPM1 CRI_mchk_RPM2 CRI_mchk_RPM3 CRI_mchk_RPM4 CRI_mchk_RPM5 CRI_mchk_RPM6 CRI_mchk_RPM7 CRI_mchk_RPM8 CRI_mchk_RPM9 CRI_mchk_ECT0 CRI_mchk_ECT1 CRI_mchk_ECT2 CRI_mchk_ECT3 CRI_mchk_ECT4 CRI_mchk_ECT5 CRI_mchk_ECT6 CRI_mchk_ECT7 CRI_mchk_ECT8 CRI_mchk_ECT9 CRI_mchk_IAT0 CRI_mchk_IAT1 CRI_mchk_IAT2 CRI_mchk_IAT3 CRI_mchk_IAT4 CRI_mchk_IAT5 CRI_mchk_IAT6 CRI_mchk_IAT7 CRI_mchk_IAT8 CRI_mchk_IAT9 CRI_mchk_DOCT0 CRI_mchk_DOCT1 CRI_mchk_DOCT2 CRI_mchk_DOCT3 CRI_mchk_DOCT4 CRI_mchk_DOCT5 CRI_mchk_DOCT6 CRI_mchk_DOCT7 CRI_mchk_DOCT8 CRI_mchk_DOCT9 CRI_mchk_DPFT0 CRI_mchk_DPFT1 CRI_mchk_DPFT2 CRI_mchk_DPFT3 CRI_mchk_DPFT4 CRI_mchk_DPFT5 CRI_mchk_DPFT6 CRI_mchk_DPFT7 CRI_mchk_DPFT8 CRI_mchk_DPFT9 CRI_mchk_soot0 CRI_mchk_soot1 CRI_mchk_soot2 CRI_mchk_soot3 CRI_mchk_soot4 CRI_mchk_soot5 CRI_mchk_soot6 CRI_mchk_soot7 CRI_mchk_soot8 CRI_mchk_soot9 CRI_mchk_RS_speed0 CRI_mchk_RS_speed1 CRI_mchk_RS_speed2 CRI_mchk_RS_speed3 CRI_mchk_RS_speed4 CRI_mchk_RS_speed5 CRI_mchk_RS_speed6 CRI_mchk_RS_speed7 CRI_mchk_RS_speed8 CRI_mchk_RS_speed9 CRI_mlmt_RPM0 CRI_mlmt_RPM1 CRI_mlmt_RPM2 CRI_mlmt_RPM3 CRI_mlmt_RPM4 CRI_mlmt_RPM5 CRI_mlmt_RPM6 CRI_mlmt_RPM7 CRI_mlmt_RPM8 CRI_mlmt_RPM9 CRI_mlmt_ECT0 CRI_mlmt_ECT1 CRI_mlmt_ECT2 CRI_mlmt_ECT3 CRI_mlmt_ECT4 CRI_mlmt_ECT5 CRI_mlmt_ECT6 CRI_mlmt_ECT7 CRI_mlmt_ECT8 CRI_mlmt_ECT9 CRI_mlmt_IAT0 CRI_mlmt_IAT1 CRI_mlmt_IAT2 CRI_mlmt_IAT3 CRI_mlmt_IAT4 CRI_mlmt_IAT5 CRI_mlmt_IAT6 CRI_mlmt_IAT7 CRI_mlmt_IAT8 CRI_mlmt_IAT9 CRI_mlmt_DOCT0 CRI_mlmt_DOCT1 CRI_mlmt_DOCT2 CRI_mlmt_DOCT3 CRI_mlmt_DOCT4 CRI_mlmt_DOCT5 CRI_mlmt_DOCT6 CRI_mlmt_DOCT7 CRI_mlmt_DOCT8 CRI_mlmt_DOCT9 CRI_mlmt_DPFT0 CRI_mlmt_DPFT1 CRI_mlmt_DPFT2 CRI_mlmt_DPFT3 CRI_mlmt_DPFT4 CRI_mlmt_DPFT5 CRI_mlmt_DPFT6 CRI_mlmt_DPFT7 CRI_mlmt_DPFT8 CRI_mlmt_DPFT9 CRI_mlmt_soot0 CRI_mlmt_soot1 CRI_mlmt_soot2 CRI_mlmt_soot3 CRI_mlmt_soot4 CRI_mlmt_soot5 CRI_mlmt_soot6 CRI_mlmt_soot7 CRI_mlmt_soot8 CRI_mlmt_soot9 CRI_mlmt_RS_speed0 CRI_mlmt_RS_speed1 CRI_mlmt_RS_speed2 CRI_mlmt_RS_speed3 CRI_mlmt_RS_speed4 CRI_mlmt_RS_speed5 CRI_mlmt_RS_speed6 CRI_mlmt_RS_speed7 CRI_mlmt_RS_speed8 CRI_mlmt_RS_speed9 CRI_mchk_persist0 CRI_mchk_persist1 CRI_mchk_persist2 CRI_mchk_persist3 CRI_mchk_persist4 CRI_mchk_persist5 CRI_mchk_persist6 CRI_mchk_persist7 CRI_mchk_persist8 CRI_mchk_persist9 CRI_mtranA_chk0 CRI_mtranA_chk1 CRI_mtranA_chk2 CRI_mtranA_chk3 CRI_mtranA_chk4 CRI_mtranA_chk5 CRI_mtranA_chk6 CRI_mtranA_chk7 CRI_mtranA_chk8 CRI_mtranA_chk9 CRI_mtranB_chk0 CRI_mtranB_chk1 CRI_mtranB_chk2 CRI_mtranB_chk3 CRI_mtranB_chk4 CRI_mtranB_chk5 CRI_mtranB_chk6 CRI_mtranB_chk7 CRI_mtranB_chk8 CRI_mtranB_chk9 CRI_mtranC_chk0 CRI_mtranC_chk1 CRI_mtranC_chk2 CRI_mtranC_chk3 CRI_mtranC_chk4 CRI_mtranC_chk5 CRI_mtranC_chk6 CRI_mtranC_chk7 CRI_mtranC_chk8 CRI_mtranC_chk9 CRI_mtranA_persist0 CRI_mtranA_persist1 CRI_mtranA_persist2 CRI_mtranA_persist3 CRI_mtranA_persist4 CRI_mtranA_persist5 CRI_mtranA_persist6 CRI_mtranA_persist7 CRI_mtranA_persist8 CRI_mtranA_persist9 CRI_mtranB_persist0 CRI_mtranB_persist1 CRI_mtranB_persist2 CRI_mtranB_persist3 CRI_mtranB_persist4 CRI_mtranB_persist5 CRI_mtranB_persist6 CRI_mtranB_persist7 CRI_mtranB_persist8 CRI_mtranB_persist9 CRI_mtranC_persist0 CRI_mtranC_persist1 CRI_mtranC_persist2 CRI_mtranC_persist3 CRI_mtranC_persist4 CRI_mtranC_persist5 CRI_mtranC_persist6 CRI_mtranC_persist7 CRI_mtranC_persist8 CRI_mtranC_persist9 STR_CRI_mode_0 STR_CRI_mode_1 STR_CRI_mode_2 STR_CRI_mode_3 STR_CRI_mode_4 STR_CRI_mode_5 STR_CRI_mode_6 STR_CRI_mode_7 STR_CRI_mode_8 STR_CRI_mode_9 /end REF_CHARACTERISTIC
 /begin REF_MEASUREMENT mdot_ports_cmd CRI_active_mode /end REF_MEASUREMENT
/end GROUP
/begin GROUP EC_DPF "ECONTROLS" ROOT /begin REF_CHARACTERISTIC DOCT_ena DPFT_ena SCRT_ena DPFdP_ena DPF_V_init /end REF_CHARACTERISTIC
 /begin REF_MEASUREMENT Vdot_exhaust EMP_slow DPFdP TOT DOCT DPFT SCRT DPF_regen_active DPF_soot_grams DPF_soot_g_per_L DPF_soot_mg_sec Vdot_cat /end REF_MEASUREMENT
/end GROUP
/begin GROUP EC_FilterCal "ECONTROLS" ROOT /begin REF_MEASUREMENT EMP_slow /end REF_MEASUREMENT /end GROUP
/begin GROUP EC_VECal "ECONTROLS" ROOT /begin REF_MEASUREMENT Vdot_exhaust EMP_slow Vdot_cat /end REF_MEASUREMENT /end GROUP
/end MODULE
/end PROJECT
