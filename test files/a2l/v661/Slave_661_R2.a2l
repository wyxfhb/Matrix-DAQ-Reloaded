ASAP2_VERSION 1 61
/begin PROJECT Econtrols_4G "4G Test"
/begin HEADER "4G A2L Configuration" PROJECT_NO EControls4G /* config for version control */ VERSION "$Revision: 82130 $:" /* config for version control */ /end HEADER
/begin MODULE EControls_4G_SH2A "EControls 4G"
/begin MOD_COMMON "" DEPOSIT ABSOLUTE BYTE_ORDER MSB_FIRST /end MOD_COMMON
/* Define the Record Layouts */
/begin RECORD_LAYOUT ECIPP_ALIGNMENT_UBYTE FNC_VALUES 1 UBYTE COLUMN_DIR DIRECT /end RECORD_LAYOUT
/begin RECORD_LAYOUT ECIPP_ALIGNMENT_UWORD FNC_VALUES 1 UWORD COLUMN_DIR DIRECT /end RECORD_LAYOUT
/begin RECORD_LAYOUT ECIPP_ALIGNMENT_SWORD FNC_VALUES 1 SWORD COLUMN_DIR DIRECT /end RECORD_LAYOUT
/begin RECORD_LAYOUT ECIPP_Lookup_SWORD AXIS_PTS_X 1 SWORD INDEX_INCR DIRECT /end RECORD_LAYOUT
/begin RECORD_LAYOUT ECIPP_ALIGNMENT_ULONG FNC_VALUES 1 ULONG COLUMN_DIR DIRECT /end RECORD_LAYOUT
/begin RECORD_LAYOUT ECIPP_ALIGNMENT_FLOAT32_IEEE FNC_VALUES 1 FLOAT32_IEEE COLUMN_DIR DIRECT /end RECORD_LAYOUT
/* Define generic COMPU_METHODS used in the A2L */ /* NOTE: most of the parameters from ECIPP use unique/specific COMPU_METHODS */
/begin COMPU_METHOD Compu_ECIPP_STRINGS "ECIPP Strings " /* Identifier */ RAT_FUNC "%.0" /* Format */ "ASCII" /* Units */ COEFFS 0 1 0 0 0 1 /end COMPU_METHOD
/begin MEASUREMENT KNK_retard "KNK retard" UWORD Compu_KNK_retard 0 0 0 127.998046875 ECU_ADDRESS 0x01000388 /end MEASUREMENT
/begin COMPU_METHOD Compu_KNK_retard " " RAT_FUNC "%.1" "CAD" COEFFS 0 512 0 0 0 1 /end COMPU_METHOD
/begin MEASUREMENT WGP_gage "WGP gage pressure" UWORD Compu_WGP_gage 0 0 0 255.99609375 ECU_ADDRESS 0x01000458 /end MEASUREMENT
/begin COMPU_METHOD Compu_WGP_gage " " RAT_FUNC "%.2" "psig" COEFFS 0 256 0 0 0 1 /end COMPU_METHOD
/begin MEASUREMENT RS_speed "Road speed" UWORD Compu_RS_speed 0 0 0 255.99609375 ECU_ADDRESS 0x01000488 /end MEASUREMENT
/begin COMPU_METHOD Compu_RS_speed " " RAT_FUNC "%.1" "km/hr" COEFFS 0 256 0 0 0 1 /end COMPU_METHOD
/begin CHARACTERISTIC RS_pulses_per_km "Roadspeed pulse calibration" VALUE 0x001c3b34 /* @ECU_Address@RS_pulses_per_km@0x01003130@ */ ECIPP_ALIGNMENT_FLOAT32_IEEE 10000000000 Compu_RS_pulses_per_km -10000000000 10000000000 /end CHARACTERISTIC
/begin COMPU_METHOD Compu_RS_pulses_per_km " " RAT_FUNC "%.1" "pulses/km" COEFFS 0 1 0 0 0 1 /end COMPU_METHOD
/begin CHARACTERISTIC fault_store_EE "Fault retention desired{fault_store_EE&0xff=0:Battery}{fault_store_EE&0xff=1:Permanent}" VALUE 0x001c9018 /* @ECU_Address@fault_store_EE@0x01003290@ */ ECIPP_ALIGNMENT_UBYTE 255 fault_store_EE_COMPU_VTAB 0 255 BIT_MASK 0xff /end CHARACTERISTIC
/begin COMPU_METHOD fault_store_EE_COMPU_VTAB "Verbal Table" TAB_VERB "%.0" "list" COMPU_TAB_REF fault_store_EE_COMPU_VTAB_REF /end COMPU_METHOD
/begin COMPU_VTAB fault_store_EE_COMPU_VTAB_REF "Verbal Table" TAB_VERB 2 0 "Battery" 1 "Permanent" DEFAULT_VALUE "UNKNOWN" /end COMPU_VTAB
/begin MEASUREMENT RS_speed_d "Roadspeed limit final target" UWORD Compu_RS_speed_d 0 0 0 255.99609375 ECU_ADDRESS 0x01003F38 /end MEASUREMENT
/begin COMPU_METHOD Compu_RS_speed_d " " RAT_FUNC "%.1" "km/hr" COEFFS 0 256 0 0 0 1 /end COMPU_METHOD
/begin MEASUREMENT RS_setsrc_stat "Roadspeed setpoint source status{RS_setsrc_stat&0xff=0:Unknown}{RS_setsrc_stat&0xff=1:Fixed Setpoint}{RS_setsrc_stat&0xff=2:User Max Setpoint Generated}{RS_setsrc_stat&0xff=3:Proportional Voltage Input Generated}{RS_setsrc_stat&0xff=4:Invalid Proportional" UBYTE RS_setsrc_stat_COMPU_VTAB 0 0 0 255 ECU_ADDRESS 0x01004158 BIT_MASK 0xff /end MEASUREMENT
/begin COMPU_METHOD RS_setsrc_stat_COMPU_VTAB "Verbal Table" TAB_VERB "%.0" "list" COMPU_TAB_REF RS_setsrc_stat_COMPU_VTAB_REF /end COMPU_METHOD
/begin COMPU_VTAB RS_setsrc_stat_COMPU_VTAB_REF "Verbal Table" TAB_VERB 11 0 "Unknown" 1 "Fixed Setpoint" 2 "User Max Setpoint Generated" 3 "Proportional Voltage Input Generated" 4 "Invalid Proportional Voltage - Fixed Setpoint" 5 "Invalid PWM Input Validation - Fixed Setpoint" 6 "Cruise control setpoint" 7 "Network Setpoint" 8 "Gov Switch State Selects Setpoint" 9 "Gov1 as Auxiliary Input" 10 "Gov2 as Auxiliary Input" DEFAULT_VALUE "UNKNOWN" /end COMPU_VTAB
/begin CHARACTERISTIC MIL_start_cnt_min "MIL min persist desired" VALUE 0x001c7da0 /* @ECU_Address@MIL_start_cnt_min@0x01004D18@ */ ECIPP_ALIGNMENT_UWORD 65535 Compu_MIL_start_cnt_min 0 65535 /end CHARACTERISTIC
/begin COMPU_METHOD Compu_MIL_start_cnt_min " " RAT_FUNC "%.0" "cycles" COEFFS 0 1 0 0 0 1 /end COMPU_METHOD
/begin CHARACTERISTIC FPPSC_nomload_ena "Nominal load adder{FPPSC_nomload_ena&0xff=0:Disabled}{FPPSC_nomload_ena&0xff=1:Enabled}" VALUE 0x001c871d /* @ECU_Address@FPPSC_nomload_ena@0x01004D38@ */ ECIPP_ALIGNMENT_UBYTE 255 FPPSC_nomload_ena_COMPU_VTAB 0 255 BIT_MASK 0xff /end CHARACTERISTIC
/begin COMPU_METHOD FPPSC_nomload_ena_COMPU_VTAB "Verbal Table" TAB_VERB "%.0" "list" COMPU_TAB_REF FPPSC_nomload_ena_COMPU_VTAB_REF /end COMPU_METHOD
/begin COMPU_VTAB FPPSC_nomload_ena_COMPU_VTAB_REF "Verbal Table" TAB_VERB 2 0 "Disabled" 1 "Enabled" DEFAULT_VALUE "UNKNOWN" /end COMPU_VTAB
/begin CHARACTERISTIC FPPSC_int_min_ena "Inegrator min limit{FPPSC_int_min_ena&0xff=0:Disabled}{FPPSC_int_min_ena&0xff=1:Enabled}" VALUE 0x001c871b /* @ECU_Address@FPPSC_int_min_ena@0x01004D40@ */ ECIPP_ALIGNMENT_UBYTE 255 FPPSC_int_min_ena_COMPU_VTAB 0 255 BIT_MASK 0xff /end CHARACTERISTIC
/begin COMPU_METHOD FPPSC_int_min_ena_COMPU_VTAB "Verbal Table" TAB_VERB "%.0" "list" COMPU_TAB_REF FPPSC_int_min_ena_COMPU_VTAB_REF /end COMPU_METHOD
/begin COMPU_VTAB FPPSC_int_min_ena_COMPU_VTAB_REF "Verbal Table" TAB_VERB 2 0 "Disabled" 1 "Enabled" DEFAULT_VALUE "UNKNOWN" /end COMPU_VTAB
/begin CHARACTERISTIC FPPSC_int_max_ena "Inegrator max limit{FPPSC_int_max_ena&0xff=0:Disabled}{FPPSC_int_max_ena&0xff=1:Enabled}" VALUE 0x001c871a /* @ECU_Address@FPPSC_int_max_ena@0x01004D48@ */ ECIPP_ALIGNMENT_UBYTE 255 FPPSC_int_max_ena_COMPU_VTAB 0 255 BIT_MASK 0xff /end CHARACTERISTIC
/begin COMPU_METHOD FPPSC_int_max_ena_COMPU_VTAB "Verbal Table" TAB_VERB "%.0" "list" COMPU_TAB_REF FPPSC_int_max_ena_COMPU_VTAB_REF /end COMPU_METHOD
/begin COMPU_VTAB FPPSC_int_max_ena_COMPU_VTAB_REF "Verbal Table" TAB_VERB 2 0 "Disabled" 1 "Enabled" DEFAULT_VALUE "UNKNOWN" /end COMPU_VTAB
/begin MEASUREMENT KNK_HW_scale2 "Knock hardware high-gain scaling" UWORD Compu_KNK_HW_scale2 0 0 0 63.9990234375 ECU_ADDRESS 0x01004F98 /end MEASUREMENT
/begin COMPU_METHOD Compu_KNK_HW_scale2 " " RAT_FUNC "%.3" "volts/full-scale" COEFFS 0 1024 0 0 0 1 /end COMPU_METHOD
/begin CHARACTERISTIC PTO_sw "PTO proportional enable input{PTO_sw&0xff=0:Disabled}{PTO_sw&0xff=1:Aux PU1=Gnd}{PTO_sw&0xff=2:Aux PU2=Gnd}{PTO_sw&0xff=3:Aux PU3=Gnd}{PTO_sw&0xff=4:Aux PUD1=+5V}{PTO_sw&0xff=5:Aux PUD2=+5V}{PTO_sw&0xff=6:Aux PUD3=+5V}{PTO_sw&0xff=7:Aux DIG1}{PTO_sw&0xff=" VALUE 0x001c889e /* @ECU_Address@PTO_sw@0x01005B18@ */ ECIPP_ALIGNMENT_UBYTE 255 PTO_sw_COMPU_VTAB 0 255 BIT_MASK 0xff /end CHARACTERISTIC
/begin COMPU_METHOD PTO_sw_COMPU_VTAB "Verbal Table" TAB_VERB "%.0" "list" COMPU_TAB_REF PTO_sw_COMPU_VTAB_REF /end COMPU_METHOD
/begin COMPU_VTAB PTO_sw_COMPU_VTAB_REF "Verbal Table" TAB_VERB 17 0 "Disabled" 1 "Aux PU1=Gnd" 2 "Aux PU2=Gnd" 3 "Aux PU3=Gnd" 4 "Aux PUD1=+5V" 5 "Aux PUD2=+5V" 6 "Aux PUD3=+5V" 7 "Aux DIG1" 8 "Aux DIG2" 9 "Aux DIG3" 10 "Aux DIG4" 11 "Aux DIG5" 12 "Aux DIG6" 13 "Aux DIG7" 14 "Aux DIG8" 15 "Aux DIG9" 16 "Aux DIG10" DEFAULT_VALUE "UNKNOWN" /end COMPU_VTAB
/begin MEASUREMENT PTO_ena "PTO proportional status{PTO_ena&0xff=0:Inactive}{PTO_ena&0xff=1:Active}" UBYTE PTO_ena_COMPU_VTAB 0 0 0 255 ECU_ADDRESS 0x01005B20 BIT_MASK 0xff /end MEASUREMENT
/begin COMPU_METHOD PTO_ena_COMPU_VTAB "Verbal Table" TAB_VERB "%.0" "list" COMPU_TAB_REF PTO_ena_COMPU_VTAB_REF /end COMPU_METHOD
/begin COMPU_VTAB PTO_ena_COMPU_VTAB_REF "Verbal Table" TAB_VERB 2 0 "Inactive" 1 "Active" DEFAULT_VALUE "UNKNOWN" /end COMPU_VTAB
/begin CHARACTERISTIC PTO_spdinput "PTO proportional speed input{PTO_spdinput&0xff=0:Aux PD1}{PTO_spdinput&0xff=1:Aux PD2}{PTO_spdinput&0xff=2:Aux PD3}{PTO_spdinput&0xff=3:Aux PUD1}{PTO_spdinput&0xff=4:Aux PUD2}{PTO_spdinput&0xff=5:Aux PUD3}" VALUE 0x001c889d /* @ECU_Address@PTO_spdinput@0x01005B28@ */ ECIPP_ALIGNMENT_UBYTE 255 PTO_spdinput_COMPU_VTAB 0 255 BIT_MASK 0xff /end CHARACTERISTIC
/begin COMPU_METHOD PTO_spdinput_COMPU_VTAB "Verbal Table" TAB_VERB "%.0" "list" COMPU_TAB_REF PTO_spdinput_COMPU_VTAB_REF /end COMPU_METHOD
/begin COMPU_VTAB PTO_spdinput_COMPU_VTAB_REF "Verbal Table" TAB_VERB 6 0 "Aux PD1" 1 "Aux PD2" 2 "Aux PD3" 3 "Aux PUD1" 4 "Aux PUD2" 5 "Aux PUD3" DEFAULT_VALUE "UNKNOWN" /end COMPU_VTAB
/begin CHARACTERISTIC PTO_gov_type "PTO governor settings{PTO_gov_type&0xff=0:Use Gov1 settings}{PTO_gov_type&0xff=1:Use Gov2 settings}{PTO_gov_type&0xff=2:Use Gov3 settings}{PTO_gov_type&0xff=3:Use Gov3 + FPP}" VALUE 0x001c889c /* @ECU_Address@PTO_gov_type@0x01005B30@ */ ECIPP_ALIGNMENT_UBYTE 255 PTO_gov_type_COMPU_VTAB 0 255 BIT_MASK 0xff /end CHARACTERISTIC
/begin COMPU_METHOD PTO_gov_type_COMPU_VTAB "Verbal Table" TAB_VERB "%.0" "list" COMPU_TAB_REF PTO_gov_type_COMPU_VTAB_REF /end COMPU_METHOD
/begin COMPU_VTAB PTO_gov_type_COMPU_VTAB_REF "Verbal Table" TAB_VERB 4 0 "Use Gov1 settings" 1 "Use Gov2 settings" 2 "Use Gov3 settings" 3 "Use Gov3 + FPP" DEFAULT_VALUE "UNKNOWN" /end COMPU_VTAB
/begin CHARACTERISTIC PTO_Vslow "PTO proportional slow voltage" VALUE 0x001c7e5c /* @ECU_Address@PTO_Vslow@0x01005B38@ */ ECIPP_ALIGNMENT_UWORD 5 Compu_PTO_Vslow 0 5.00114468864469 /end CHARACTERISTIC
/begin COMPU_METHOD Compu_PTO_Vslow " " RAT_FUNC "%.2" "volts" COEFFS 0 13104 0 0 0 1 /end COMPU_METHOD
/begin CHARACTERISTIC PTO_Vfast "PTO proportional fast voltage" VALUE 0x001c7e5a /* @ECU_Address@PTO_Vfast@0x01005B40@ */ ECIPP_ALIGNMENT_UWORD 5 Compu_PTO_Vfast 0 5.00114468864469 /end CHARACTERISTIC
/begin COMPU_METHOD Compu_PTO_Vfast " " RAT_FUNC "%.2" "volts" COEFFS 0 13104 0 0 0 1 /end COMPU_METHOD
/begin CHARACTERISTIC PTO_rpmslow "PTO slow/min engine speed" VALUE 0x001c7e64 /* @ECU_Address@PTO_rpmslow@0x01005B48@ */ ECIPP_ALIGNMENT_UWORD 65535 Compu_PTO_rpmslow 0 65535 /end CHARACTERISTIC
/begin COMPU_METHOD Compu_PTO_rpmslow " " RAT_FUNC "%.0" "rpm" COEFFS 0 1 0 0 0 1 /end COMPU_METHOD
/begin CHARACTERISTIC PTO_rpmfast "PTO fast/max engine speed" VALUE 0x001c7e62 /* @ECU_Address@PTO_rpmfast@0x01005B50@ */ ECIPP_ALIGNMENT_UWORD 65535 Compu_PTO_rpmfast 0 65535 /end CHARACTERISTIC
/begin COMPU_METHOD Compu_PTO_rpmfast " " RAT_FUNC "%.0" "rpm" COEFFS 0 1 0 0 0 1 /end COMPU_METHOD
/begin MEASUREMENT PTO_rpmd "PTO engine speed target" UWORD Compu_PTO_rpmd 0 0 0 65535 ECU_ADDRESS 0x01005B58 /end MEASUREMENT
/begin COMPU_METHOD Compu_PTO_rpmd " " RAT_FUNC "%.0" "rpm" COEFFS 0 1 0 0 0 1 /end COMPU_METHOD
/begin CHARACTERISTIC FltStartMax "Cycles before clear desired" VALUE 0x001c874d /* @ECU_Address@FltStartMax@0x01006090@ */ ECIPP_ALIGNMENT_UBYTE 255 Compu_FltStartMax 0 255 /end CHARACTERISTIC
/begin COMPU_METHOD Compu_FltStartMax " " RAT_FUNC "%.0" "cycles" COEFFS 0 1 0 0 0 1 /end COMPU_METHOD
/begin MEASUREMENT PCB1_assembly_raw "PCB1_assembly_raw" UWORD Compu_PCB1_assembly_raw 0 0 0 5.00114468864469 ECU_ADDRESS 0x01006C58 /end MEASUREMENT
/begin COMPU_METHOD Compu_PCB1_assembly_raw " " RAT_FUNC "%.3" "volts" COEFFS 0 13104 0 0 0 1 /end COMPU_METHOD
/begin CHARACTERISTIC PTOd_sw "PTOd enable input{PTOd_sw&0xff=0:Disabled/config default}{PTOd_sw&0xff=1:Aux PU1=Gnd}{PTOd_sw&0xff=2:Aux PU2=Gnd}{PTOd_sw&0xff=3:Aux PU3=Gnd}{PTOd_sw&0xff=4:Aux PUD1=+5V}{PTOd_sw&0xff=5:Aux PUD2=+5V}{PTOd_sw&0xff=6:Aux PUD3=+5V}{PTOd_sw&0xff=7:Aux DIG1}{P" VALUE 0x001c88ab /* @ECU_Address@PTOd_sw@0x010072E8@ */ ECIPP_ALIGNMENT_UBYTE 255 PTOd_sw_COMPU_VTAB 0 255 BIT_MASK 0xff /end CHARACTERISTIC
/begin COMPU_METHOD PTOd_sw_COMPU_VTAB "Verbal Table" TAB_VERB "%.0" "list" COMPU_TAB_REF PTOd_sw_COMPU_VTAB_REF /end COMPU_METHOD
/begin COMPU_VTAB PTOd_sw_COMPU_VTAB_REF "Verbal Table" TAB_VERB 23 0 "Disabled/config default" 1 "Aux PU1=Gnd" 2 "Aux PU2=Gnd" 3 "Aux PU3=Gnd" 4 "Aux PUD1=+5V" 5 "Aux PUD2=+5V" 6 "Aux PUD3=+5V" 7 "Aux DIG1" 8 "Aux DIG2" 9 "Aux DIG3" 10 "Aux DIG4" 11 "Aux DIG5" 12 "Aux DIG6" 13 "Aux DIG7" 14 "Aux DIG8" 15 "Aux DIG9" 16 "Aux DIG10" 17 "J1939 CCVS1 - SPN 599" 18 "J1939 CCVS1 - SPN 600" 19 "J1939 CCVS1 - SPN 601" 20 "J1939 CCVS1 - SPN 602" 21 "J1939 PTO - SPN 980=01" 22 "J1939 PTO - SPN 980=00" DEFAULT_VALUE "UNKNOWN" /end COMPU_VTAB
/begin CHARACTERISTIC PTOd_setinc_chan "PTO set/+ input{PTOd_setinc_chan&0xff=0:Disabled/config default}{PTOd_setinc_chan&0xff=1:Aux PU1 = Gnd}{PTOd_setinc_chan&0xff=2:Aux PU2 = Gnd}{PTOd_setinc_chan&0xff=3:Aux PU3 = Gnd}{PTOd_setinc_chan&0xff=4:Aux PUD1 = Gnd}{PTOd_setinc_chan&0xff=5:Aux PUD2 " VALUE 0x001c88a9 /* @ECU_Address@PTOd_setinc_chan@0x010072F0@ */ ECIPP_ALIGNMENT_UBYTE 255 PTOd_setinc_chan_COMPU_VTAB 0 255 BIT_MASK 0xff /end CHARACTERISTIC
/begin COMPU_METHOD PTOd_setinc_chan_COMPU_VTAB "Verbal Table" TAB_VERB "%.0" "list" COMPU_TAB_REF PTOd_setinc_chan_COMPU_VTAB_REF /end COMPU_METHOD
/begin COMPU_VTAB PTOd_setinc_chan_COMPU_VTAB_REF "Verbal Table" TAB_VERB 34 0 "Disabled/config default" 1 "Aux PU1 = Gnd" 2 "Aux PU2 = Gnd" 3 "Aux PU3 = Gnd" 4 "Aux PUD1 = Gnd" 5 "Aux PUD2 = Gnd" 6 "Aux PUD3 = Gnd" 7 "Aux PUD4 = +V" 8 "Aux PUD5 = Gnd" 9 "Aux DIG1" 10 "Aux DIG2" 11 "Aux DIG3" 12 "Aux DIG4" 13 "Aux DIG5" 14 "Aux DIG6" 15 "Aux DIG7" 16 "Aux DIG8" 17 "Aux DIG9" 18 "Aux DIG10" 19 "Aux DIG11" 20 "Aux DIG12" 21 "Aux DIG13" 22 "Aux DIG14" 23 "Aux DIG15" 24 "Aux DIG16" 25 "Aux DIG17" 26 "Aux DIG18" 27 "Aux DIG19" 28 "Gov1" 29 "Gov2" 30 "J1939 CCVS1 - SPN 599" 31 "J1939 CCVS1 - SPN 600" 32 "J1939 CCVS1 - SPN 601" 33 "J1939 CCVS1 - SPN 602" DEFAULT_VALUE "UNKNOWN" /end COMPU_VTAB
/begin CHARACTERISTIC PTOd_resdec_chan "PTO res/- input{PTOd_resdec_chan&0xff=0:Disabled/config default}{PTOd_resdec_chan&0xff=1:Aux PU1 = Gnd}{PTOd_resdec_chan&0xff=2:Aux PU2 = Gnd}{PTOd_resdec_chan&0xff=3:Aux PU3 = Gnd}{PTOd_resdec_chan&0xff=4:Aux PUD1 = Gnd}{PTOd_resdec_chan&0xff=5:Aux PUD2 " VALUE 0x001c88a7 /* @ECU_Address@PTOd_resdec_chan@0x010072F8@ */ ECIPP_ALIGNMENT_UBYTE 255 PTOd_resdec_chan_COMPU_VTAB 0 255 BIT_MASK 0xff /end CHARACTERISTIC
/begin COMPU_METHOD PTOd_resdec_chan_COMPU_VTAB "Verbal Table" TAB_VERB "%.0" "list" COMPU_TAB_REF PTOd_resdec_chan_COMPU_VTAB_REF /end COMPU_METHOD
/begin COMPU_VTAB PTOd_resdec_chan_COMPU_VTAB_REF "Verbal Table" TAB_VERB 34 0 "Disabled/config default" 1 "Aux PU1 = Gnd" 2 "Aux PU2 = Gnd" 3 "Aux PU3 = Gnd" 4 "Aux PUD1 = Gnd" 5 "Aux PUD2 = Gnd" 6 "Aux PUD3 = Gnd" 7 "Aux PUD4 = +V" 8 "Aux PUD5 = Gnd" 9 "Aux DIG1" 10 "Aux DIG2" 11 "Aux DIG3" 12 "Aux DIG4" 13 "Aux DIG5" 14 "Aux DIG6" 15 "Aux DIG7" 16 "Aux DIG8" 17 "Aux DIG9" 18 "Aux DIG10" 19 "Aux DIG11" 20 "Aux DIG12" 21 "Aux DIG13" 22 "Aux DIG14" 23 "Aux DIG15" 24 "Aux DIG16" 25 "Aux DIG17" 26 "Aux DIG18" 27 "Aux DIG19" 28 "Gov1" 29 "Gov2" 30 "J1939 CCVS1 - SPN 599" 31 "J1939 CCVS1 - SPN 600" 32 "J1939 CCVS1 - SPN 601" 33 "J1939 CCVS1 - SPN 602" DEFAULT_VALUE "UNKNOWN" /end COMPU_VTAB
/begin CHARACTERISTIC PTO_clutch_override "PTO when clutch depressed{PTO_clutch_override&0xff=0:Leave PTO engaged}{PTO_clutch_override&0xff=1:Disengage PTO}" VALUE 0x001c889a /* @ECU_Address@PTO_clutch_override@0x01007300@ */ ECIPP_ALIGNMENT_UBYTE 255 PTO_clutch_override_COMPU_VTAB 0 255 BIT_MASK 0xff /end CHARACTERISTIC
/begin COMPU_METHOD PTO_clutch_override_COMPU_VTAB "Verbal Table" TAB_VERB "%.0" "list" COMPU_TAB_REF PTO_clutch_override_COMPU_VTAB_REF /end COMPU_METHOD
/begin COMPU_VTAB PTO_clutch_override_COMPU_VTAB_REF "Verbal Table" TAB_VERB 2 0 "Leave PTO engaged" 1 "Disengage PTO" DEFAULT_VALUE "UNKNOWN" /end COMPU_VTAB
/begin CHARACTERISTIC PTO_ebrake_override "PTO when drivebrake engages{PTO_ebrake_override&0xff=0:Leave PTO engaged}{PTO_ebrake_override&0xff=1:Disengage PTO}" VALUE 0x001c889b /* @ECU_Address@PTO_ebrake_override@0x01007308@ */ ECIPP_ALIGNMENT_UBYTE 255 PTO_ebrake_override_COMPU_VTAB 0 255 BIT_MASK 0xff /end CHARACTERISTIC
/begin COMPU_METHOD PTO_ebrake_override_COMPU_VTAB "Verbal Table" TAB_VERB "%.0" "list" COMPU_TAB_REF PTO_ebrake_override_COMPU_VTAB_REF /end COMPU_METHOD
/begin COMPU_VTAB PTO_ebrake_override_COMPU_VTAB_REF "Verbal Table" TAB_VERB 2 0 "Leave PTO engaged" 1 "Disengage PTO" DEFAULT_VALUE "UNKNOWN" /end COMPU_VTAB
/begin CHARACTERISTIC PTO_max_load_pct "PTO max load percent" VALUE 0x001c7e5e /* @ECU_Address@PTO_max_load_pct@0x01007310@ */ ECIPP_ALIGNMENT_UWORD 100 Compu_PTO_max_load_pct 0 99.9984741210938 /end CHARACTERISTIC
/begin COMPU_METHOD Compu_PTO_max_load_pct " " RAT_FUNC "%.1" "%" COEFFS 0 655.36 0 0 0 1 /end COMPU_METHOD
/begin CHARACTERISTIC PTOd_setres_rpm "PTO set/res engine speed" VALUE 0x001c7e7e /* @ECU_Address@PTOd_setres_rpm@0x01007318@ */ ECIPP_ALIGNMENT_UWORD 65535 Compu_PTOd_setres_rpm 0 65535 /end CHARACTERISTIC
/begin COMPU_METHOD Compu_PTOd_setres_rpm " " RAT_FUNC "%.0" "rpm" COEFFS 0 1 0 0 0 1 /end COMPU_METHOD
/begin CHARACTERISTIC PTOd_setinc_rpm "PTO set/+ engine speed" VALUE 0x001c7e78 /* @ECU_Address@PTOd_setinc_rpm@0x01007320@ */ ECIPP_ALIGNMENT_UWORD 65535 Compu_PTOd_setinc_rpm 0 65535 /end CHARACTERISTIC
/begin COMPU_METHOD Compu_PTOd_setinc_rpm " " RAT_FUNC "%.0" "rpm" COEFFS 0 1 0 0 0 1 /end COMPU_METHOD
/begin CHARACTERISTIC PTOd_resdec_rpm "PTO res/- engine speed" VALUE 0x001c7e6e /* @ECU_Address@PTOd_resdec_rpm@0x01007328@ */ ECIPP_ALIGNMENT_UWORD 65535 Compu_PTOd_resdec_rpm 0 65535 /end CHARACTERISTIC
/begin COMPU_METHOD Compu_PTOd_resdec_rpm " " RAT_FUNC "%.0" "rpm" COEFFS 0 1 0 0 0 1 /end COMPU_METHOD
/begin CHARACTERISTIC PTOd_setres_wait "PTO set/res debounce" VALUE 0x001c7e80 /* @ECU_Address@PTOd_setres_wait@0x01007330@ */ ECIPP_ALIGNMENT_UWORD 65535 Compu_PTOd_setres_wait 0 65535 /end CHARACTERISTIC
/begin COMPU_METHOD Compu_PTOd_setres_wait " " RAT_FUNC "%.0" "ms" COEFFS 0 1 0 0 0 1 /end COMPU_METHOD
/begin CHARACTERISTIC PTOd_setinc_wait "PTO set/+ ramp wait" VALUE 0x001c7e7c /* @ECU_Address@PTOd_setinc_wait@0x01007338@ */ ECIPP_ALIGNMENT_UWORD 65535 Compu_PTOd_setinc_wait 0 65535 /end CHARACTERISTIC
/begin COMPU_METHOD Compu_PTOd_setinc_wait " " RAT_FUNC "%.0" "ms" COEFFS 0 1 0 0 0 1 /end COMPU_METHOD
/begin CHARACTERISTIC PTOd_resdec_wait "PTO res/- ramp wait" VALUE 0x001c7e72 /* @ECU_Address@PTOd_resdec_wait@0x01007340@ */ ECIPP_ALIGNMENT_UWORD 65535 Compu_PTOd_resdec_wait 0 65535 /end CHARACTERISTIC
/begin COMPU_METHOD Compu_PTOd_resdec_wait " " RAT_FUNC "%.0" "ms" COEFFS 0 1 0 0 0 1 /end COMPU_METHOD
/begin CHARACTERISTIC PTOd_setinc_ramp "PTO set/+ ramp rate" VALUE 0x001c7e76 /* @ECU_Address@PTOd_setinc_ramp@0x01007348@ */ ECIPP_ALIGNMENT_UWORD 65535 Compu_PTOd_setinc_ramp 0 65535 /end CHARACTERISTIC
/begin COMPU_METHOD Compu_PTOd_setinc_ramp " " RAT_FUNC "%.0" "rpm/sec" COEFFS 0 1 0 0 0 1 /end COMPU_METHOD
/begin CHARACTERISTIC PTOd_resdec_ramp "PTO res/- ramp rate" VALUE 0x001c7e6c /* @ECU_Address@PTOd_resdec_ramp@0x01007350@ */ ECIPP_ALIGNMENT_UWORD 65535 Compu_PTOd_resdec_ramp 0 65535 /end CHARACTERISTIC
/begin COMPU_METHOD Compu_PTOd_resdec_ramp " " RAT_FUNC "%.0" "rpm/sec" COEFFS 0 1 0 0 0 1 /end COMPU_METHOD
/begin MEASUREMENT PTOd_ena "PTOd status{PTOd_ena&0xff=0:Inactive}{PTOd_ena&0xff=1:Active}" UBYTE PTOd_ena_COMPU_VTAB 0 0 0 255 ECU_ADDRESS 0x01007358 BIT_MASK 0xff /end MEASUREMENT
/begin COMPU_METHOD PTOd_ena_COMPU_VTAB "Verbal Table" TAB_VERB "%.0" "list" COMPU_TAB_REF PTOd_ena_COMPU_VTAB_REF /end COMPU_METHOD
/begin COMPU_VTAB PTOd_ena_COMPU_VTAB_REF "Verbal Table" TAB_VERB 2 0 "Inactive" 1 "Active" DEFAULT_VALUE "UNKNOWN" /end COMPU_VTAB
/begin MEASUREMENT PTOp_rpm_inst "PTO proportional target" UWORD Compu_PTOp_rpm_inst 0 0 0 65535 ECU_ADDRESS 0x01007360 /end MEASUREMENT
/begin COMPU_METHOD Compu_PTOp_rpm_inst " " RAT_FUNC "%.0" "rpm" COEFFS 0 1 0 0 0 1 /end COMPU_METHOD
/begin MEASUREMENT PTOd_rpm_accum "PTOd target" ULONG Compu_PTOd_rpm_accum 0 0 0 65535.9999847412 ECU_ADDRESS 0x01007368 /end MEASUREMENT
/begin COMPU_METHOD Compu_PTOd_rpm_accum " " RAT_FUNC "%.0" "rpm" COEFFS 0 65536 0 0 0 1 /end COMPU_METHOD
/begin MEASUREMENT PTOd_inc_sw "PTO increment{PTOd_inc_sw&0x40=0x00:OFF}{PTOd_inc_sw&0x40=0x40:ON}" UBYTE PTOd_inc_sw_COMPU_VTAB 0 0 0 255 ECU_ADDRESS 0x01007620 BIT_MASK 0x40 /end MEASUREMENT
/begin COMPU_METHOD PTOd_inc_sw_COMPU_VTAB "Verbal Table" TAB_VERB "%.0" "list" COMPU_TAB_REF PTOd_inc_sw_COMPU_VTAB_REF /end COMPU_METHOD
/begin COMPU_VTAB PTOd_inc_sw_COMPU_VTAB_REF "Verbal Table" TAB_VERB 2 0x00 "OFF" 0x40 "ON" DEFAULT_VALUE "UNKNOWN" /end COMPU_VTAB
/begin MEASUREMENT PTOd_res_sw "PTO resume{PTOd_res_sw&0x10=0x00:OFF}{PTOd_res_sw&0x10=0x10:ON}" UBYTE PTOd_res_sw_COMPU_VTAB 0 0 0 255 ECU_ADDRESS 0x01007628 BIT_MASK 0xFF /end MEASUREMENT
/begin COMPU_METHOD PTOd_res_sw_COMPU_VTAB "Verbal Table" TAB_VERB "%.0" "list" COMPU_TAB_REF PTOd_res_sw_COMPU_VTAB_REF /end COMPU_METHOD
/begin COMPU_VTAB PTOd_res_sw_COMPU_VTAB_REF "Verbal Table" TAB_VERB 2 0x00 "OFF" 0x10 "ON" DEFAULT_VALUE "Unsupported Bit_Shift" /end COMPU_VTAB
/begin MEASUREMENT PTOd_dec_sw "PTO decrement{PTOd_dec_sw&0x04=0x00:OFF}{PTOd_dec_sw&0x04=0x04:ON}" UBYTE PTOd_dec_sw_COMPU_VTAB 0 0 0 255 ECU_ADDRESS 0x01007630 BIT_MASK 0x04 /end MEASUREMENT
/begin COMPU_METHOD PTOd_dec_sw_COMPU_VTAB "Verbal Table" TAB_VERB "%.0" "list" COMPU_TAB_REF PTOd_dec_sw_COMPU_VTAB_REF /end COMPU_METHOD
/begin COMPU_VTAB PTOd_dec_sw_COMPU_VTAB_REF "Verbal Table" TAB_VERB 2 0x00 "OFF" 0x04 "ON" DEFAULT_VALUE "UNKNOWN" /end COMPU_VTAB
/begin MEASUREMENT PTOd_set_sw "PTO set{PTOd_set_sw&0x01=0x00:OFF}{PTOd_set_sw&0x01=0x01:ON}" UBYTE PTOd_set_sw_COMPU_VTAB 0 0 0 255 ECU_ADDRESS 0x01007638 BIT_MASK 0x01 /end MEASUREMENT
/begin COMPU_METHOD PTOd_set_sw_COMPU_VTAB "Verbal Table" TAB_VERB "%.0" "list" COMPU_TAB_REF PTOd_set_sw_COMPU_VTAB_REF /end COMPU_METHOD
/begin COMPU_VTAB PTOd_set_sw_COMPU_VTAB_REF "Verbal Table" TAB_VERB 2 0x00 "OFF" 0x01 "ON" DEFAULT_VALUE "UNKNOWN" /end COMPU_VTAB
/begin CHARACTERISTIC PTO_brake_override "PTO when brake depressed{PTO_brake_override&0xff=0:Leave PTO engaged}{PTO_brake_override&0xff=1:Disengage PTO}" VALUE 0x001c8899 /* @ECU_Address@PTO_brake_override@0x010078D8@ */ ECIPP_ALIGNMENT_UBYTE 255 PTO_brake_override_COMPU_VTAB 0 255 BIT_MASK 0xff /end CHARACTERISTIC
/begin COMPU_METHOD PTO_brake_override_COMPU_VTAB "Verbal Table" TAB_VERB "%.0" "list" COMPU_TAB_REF PTO_brake_override_COMPU_VTAB_REF /end COMPU_METHOD
/begin COMPU_VTAB PTO_brake_override_COMPU_VTAB_REF "Verbal Table" TAB_VERB 2 0 "Leave PTO engaged" 1 "Disengage PTO" DEFAULT_VALUE "UNKNOWN" /end COMPU_VTAB
/begin CHARACTERISTIC PTO_vehspd_limit "PTO vehicle speed limit" VALUE 0x001c7e66 /* @ECU_Address@PTO_vehspd_limit@0x010078E0@ */ ECIPP_ALIGNMENT_UWORD 256 Compu_PTO_vehspd_limit 0 255.99609375 /end CHARACTERISTIC
/begin COMPU_METHOD Compu_PTO_vehspd_limit " " RAT_FUNC "%.1" "kph" COEFFS 0 256 0 0 0 1 /end COMPU_METHOD
/begin CHARACTERISTIC PTO_sw_validation "PTO switch off validation{PTO_sw_validation&0xff=0:Not required}{PTO_sw_validation&0xff=1:Required}" VALUE 0x001c88a0 /* @ECU_Address@PTO_sw_validation@0x01007950@ */ ECIPP_ALIGNMENT_UBYTE 255 PTO_sw_validation_COMPU_VTAB 0 255 BIT_MASK 0xff /end CHARACTERISTIC
/begin COMPU_METHOD PTO_sw_validation_COMPU_VTAB "Verbal Table" TAB_VERB "%.0" "list" COMPU_TAB_REF PTO_sw_validation_COMPU_VTAB_REF /end COMPU_METHOD
/begin COMPU_VTAB PTO_sw_validation_COMPU_VTAB_REF "Verbal Table" TAB_VERB 2 0 "Not required" 1 "Required" DEFAULT_VALUE "UNKNOWN" /end COMPU_VTAB
/begin MEASUREMENT PCB2_assembly_raw "PCB2_assembly_raw" UWORD Compu_PCB2_assembly_raw 0 0 0 5.00114468864469 ECU_ADDRESS 0x010082B8 /end MEASUREMENT
/begin COMPU_METHOD Compu_PCB2_assembly_raw " " RAT_FUNC "%.3" "volts" COEFFS 0 13104 0 0 0 1 /end COMPU_METHOD
/begin MEASUREMENT Aux_PWM3_manual "Aux PWM3 manual{Aux_PWM3_manual&0xff=0x00:Disabled}{Aux_PWM3_manual&0xff=0x01:Enabled}" UBYTE Aux_PWM3_manual_COMPU_VTAB 0 0 0 255 ECU_ADDRESS 0x01008940 BIT_MASK 0xff /end MEASUREMENT
/begin COMPU_METHOD Aux_PWM3_manual_COMPU_VTAB "Verbal Table" TAB_VERB "%.0" "list" COMPU_TAB_REF Aux_PWM3_manual_COMPU_VTAB_REF /end COMPU_METHOD
/begin COMPU_VTAB Aux_PWM3_manual_COMPU_VTAB_REF "Verbal Table" TAB_VERB 2 0x00 "Disabled" 0x01 "Enabled" DEFAULT_VALUE "UNKNOWN" /end COMPU_VTAB
/begin MEASUREMENT LOCKOFF_PWM_manual "LOCKOFF PWM manual{LOCKOFF_PWM_manual&0xff=0x00:Disabled}{LOCKOFF_PWM_manual&0xff=0x01:Enabled}" UBYTE LOCKOFF_PWM_manual_COMPU_VTAB 0 0 0 255 ECU_ADDRESS 0x010089A0 BIT_MASK 0xff /end MEASUREMENT
/begin COMPU_METHOD LOCKOFF_PWM_manual_COMPU_VTAB "Verbal Table" TAB_VERB "%.0" "list" COMPU_TAB_REF LOCKOFF_PWM_manual_COMPU_VTAB_REF /end COMPU_METHOD
/begin COMPU_VTAB LOCKOFF_PWM_manual_COMPU_VTAB_REF "Verbal Table" TAB_VERB 2 0x00 "Disabled" 0x01 "Enabled" DEFAULT_VALUE "UNKNOWN" /end COMPU_VTAB
/begin CHARACTERISTIC DBW_output_Hz "DBW output freq" VALUE 0x001C9C24 /* @ECU_Address@DBW_output_Hz@0x01009EC0@ */ ECIPP_ALIGNMENT_ULONG 10000000000 Compu_DBW_output_Hz 0 10000000000 /end CHARACTERISTIC
/begin COMPU_METHOD Compu_DBW_output_Hz " " RAT_FUNC "%.0" "Hz" COEFFS 0 0 1 0 0.00000005 0 /end COMPU_METHOD
/begin CHARACTERISTIC HBA_output_Hz "HBA output freq" VALUE 0x001C9DF8 /* @ECU_Address@HBA_output_Hz@0x01009EC8@ */ ECIPP_ALIGNMENT_ULONG 10000000000 Compu_HBA_output_Hz 0 10000000000 /end CHARACTERISTIC
/begin COMPU_METHOD Compu_HBA_output_Hz " " RAT_FUNC "%.0" "Hz" COEFFS 0 0 1 0 0.00000005 0 /end COMPU_METHOD
/begin CHARACTERISTIC HBB_output_Hz "HBB output freq" VALUE 0x001C9E98 /* @ECU_Address@HBB_output_Hz@0x01009ED0@ */ ECIPP_ALIGNMENT_ULONG 10000000000 Compu_HBB_output_Hz 0 10000000000 /end CHARACTERISTIC
/begin COMPU_METHOD Compu_HBB_output_Hz " " RAT_FUNC "%.0" "Hz" COEFFS 0 0 1 0 0.00000005 0 /end COMPU_METHOD
/begin CHARACTERISTIC DBW_output_type "DBW output type{DBW_output_type&0xff=0:Disabled}{DBW_output_type&0xff=1:Full-bridge}{DBW_output_type&0xff=2:Half (smart) on +}{DBW_output_type&0xff=3:Half (dumb) on +}{DBW_output_type&0xff=4:3-Phase Master: A,B}{DBW_output_type&0xff=5:3-Phase Slave: C}{DB" VALUE 0x001C9C20 /* @ECU_Address@DBW_output_type@0x01009ED8@ */ ECIPP_ALIGNMENT_UBYTE 255 DBW_output_type_COMPU_VTAB 0 255 BIT_MASK 0xff /end CHARACTERISTIC
/begin COMPU_METHOD DBW_output_type_COMPU_VTAB "Verbal Table" TAB_VERB "%.0" "list" COMPU_TAB_REF DBW_output_type_COMPU_VTAB_REF /end COMPU_METHOD
/begin COMPU_VTAB DBW_output_type_COMPU_VTAB_REF "Verbal Table" TAB_VERB 7 0 "Disabled" 1 "Full-bridge" 2 "Half (smart) on +" 3 "Half (dumb) on +" 4 "3-Phase Master: A,B" 5 "3-Phase Slave: C" 6 "Aux PWMs 2xHalf" DEFAULT_VALUE "UNKNOWN" /end COMPU_VTAB
/begin CHARACTERISTIC HBA_output_type "HBA output type{HBA_output_type&0xff=0:Disabled}{HBA_output_type&0xff=1:Full-bridge}{HBA_output_type&0xff=2:Half (smart) on +}{HBA_output_type&0xff=3:Half (dumb) on +}{HBA_output_type&0xff=4:3-Phase Master: A,B}{HBA_output_type&0xff=5:3-Phase Slave: C}{HB" VALUE 0x001C9DF4 /* @ECU_Address@HBA_output_type@0x01009EE0@ */ ECIPP_ALIGNMENT_UBYTE 255 HBA_output_type_COMPU_VTAB 0 255 BIT_MASK 0xff /end CHARACTERISTIC
/begin COMPU_METHOD HBA_output_type_COMPU_VTAB "Verbal Table" TAB_VERB "%.0" "list" COMPU_TAB_REF HBA_output_type_COMPU_VTAB_REF /end COMPU_METHOD
/begin COMPU_VTAB HBA_output_type_COMPU_VTAB_REF "Verbal Table" TAB_VERB 7 0 "Disabled" 1 "Full-bridge" 2 "Half (smart) on +" 3 "Half (dumb) on +" 4 "3-Phase Master: A,B" 5 "3-Phase Slave: C" 6 "Aux PWMs 2xHalf" DEFAULT_VALUE "UNKNOWN" /end COMPU_VTAB
/begin CHARACTERISTIC HBB_output_type "HBB output type{HBB_output_type&0xff=0:Disabled}{HBB_output_type&0xff=1:Full-bridge}{HBB_output_type&0xff=2:Half (smart) on +}{HBB_output_type&0xff=3:Half (dumb) on +}{HBB_output_type&0xff=4:3-Phase Master: A,B}{HBB_output_type&0xff=5:3-Phase Slave: C}{HB" VALUE 0x001C9E94 /* @ECU_Address@HBB_output_type@0x01009EE8@ */ ECIPP_ALIGNMENT_UBYTE 255 HBB_output_type_COMPU_VTAB 0 255 BIT_MASK 0xff /end CHARACTERISTIC
/begin COMPU_METHOD HBB_output_type_COMPU_VTAB "Verbal Table" TAB_VERB "%.0" "list" COMPU_TAB_REF HBB_output_type_COMPU_VTAB_REF /end COMPU_METHOD
/begin COMPU_VTAB HBB_output_type_COMPU_VTAB_REF "Verbal Table" TAB_VERB 7 0 "Disabled" 1 "Full-bridge" 2 "Half (smart) on +" 3 "Half (dumb) on +" 4 "3-Phase Master: A,B" 5 "3-Phase Slave: C" 6 "Aux PWMs 2xHalf" DEFAULT_VALUE "UNKNOWN" /end COMPU_VTAB
/begin CHARACTERISTIC DBW_output_invert "DBW output inversion{DBW_output_invert&0xff=0:Disabled}{DBW_output_invert&0xff=1:Enabled}" VALUE 0x001C9C21 /* @ECU_Address@DBW_output_invert@0x0100A1E8@ */ ECIPP_ALIGNMENT_UBYTE 255 DBW_output_invert_COMPU_VTAB 0 255 BIT_MASK 0xff /end CHARACTERISTIC
/begin COMPU_METHOD DBW_output_invert_COMPU_VTAB "Verbal Table" TAB_VERB "%.0" "list" COMPU_TAB_REF DBW_output_invert_COMPU_VTAB_REF /end COMPU_METHOD
/begin COMPU_VTAB DBW_output_invert_COMPU_VTAB_REF "Verbal Table" TAB_VERB 2 0 "Disabled" 1 "Enabled" DEFAULT_VALUE "UNKNOWN" /end COMPU_VTAB
/begin CHARACTERISTIC HBA_output_invert "HBA output inversion{HBA_output_invert&0xff=0:Disabled}{HBA_output_invert&0xff=1:Enabled}" VALUE 0x001C9DF5 /* @ECU_Address@HBA_output_invert@0x0100A1F0@ */ ECIPP_ALIGNMENT_UBYTE 255 HBA_output_invert_COMPU_VTAB 0 255 BIT_MASK 0xff /end CHARACTERISTIC
/begin COMPU_METHOD HBA_output_invert_COMPU_VTAB "Verbal Table" TAB_VERB "%.0" "list" COMPU_TAB_REF HBA_output_invert_COMPU_VTAB_REF /end COMPU_METHOD
/begin COMPU_VTAB HBA_output_invert_COMPU_VTAB_REF "Verbal Table" TAB_VERB 2 0 "Disabled" 1 "Enabled" DEFAULT_VALUE "UNKNOWN" /end COMPU_VTAB
/begin CHARACTERISTIC HBB_output_invert "HBB output inversion{HBB_output_invert&0xff=0:Disabled}{HBB_output_invert&0xff=1:Enabled}" VALUE 0x001C9E95 /* @ECU_Address@HBB_output_invert@0x0100A1F8@ */ ECIPP_ALIGNMENT_UBYTE 255 HBB_output_invert_COMPU_VTAB 0 255 BIT_MASK 0xff /end CHARACTERISTIC
/begin COMPU_METHOD HBB_output_invert_COMPU_VTAB "Verbal Table" TAB_VERB "%.0" "list" COMPU_TAB_REF HBB_output_invert_COMPU_VTAB_REF /end COMPU_METHOD
/begin COMPU_VTAB HBB_output_invert_COMPU_VTAB_REF "Verbal Table" TAB_VERB 2 0 "Disabled" 1 "Enabled" DEFAULT_VALUE "UNKNOWN" /end COMPU_VTAB
/begin MEASUREMENT CFV_man_mode "CFV manual mode{CFV_man_mode&0xff=0:Auto}{CFV_man_mode&0xff=1:Manual Pressure}{CFV_man_mode&0xff=2:Manual Flow}{CFV_man_mode&0xff=3:Manual Press+Flow}{CFV_man_mode&0xff=4:Manual Press+Position}{CFV_man_mode&0xff=5:Manual Duty-Cycle}{CFV_man_mode&0xff=6:Ma" UBYTE CFV_man_mode_COMPU_VTAB 0 0 0 255 ECU_ADDRESS 0x0100B2E0 BIT_MASK 0xff /end MEASUREMENT
/begin COMPU_METHOD CFV_man_mode_COMPU_VTAB "Verbal Table" TAB_VERB "%.0" "list" COMPU_TAB_REF CFV_man_mode_COMPU_VTAB_REF /end COMPU_METHOD
/begin COMPU_VTAB CFV_man_mode_COMPU_VTAB_REF "Verbal Table" TAB_VERB 7 0 "Auto" 1 "Manual Pressure" 2 "Manual Flow" 3 "Manual Press+Flow" 4 "Manual Press+Position" 5 "Manual Duty-Cycle" 6 "Manual Offline" DEFAULT_VALUE "UNKNOWN" /end COMPU_VTAB
/begin MEASUREMENT CFV_status "CFV status{CFV_status&0xff=0:Comm Lost}{CFV_status&0xff=1:OK}{CFV_status&0xff=2:Fault}" UBYTE CFV_status_COMPU_VTAB 0 0 0 255 ECU_ADDRESS 0x0100B2F8 BIT_MASK 0xff /end MEASUREMENT
/begin COMPU_METHOD CFV_status_COMPU_VTAB "Verbal Table" TAB_VERB "%.0" "list" COMPU_TAB_REF CFV_status_COMPU_VTAB_REF /end COMPU_METHOD
/begin COMPU_VTAB CFV_status_COMPU_VTAB_REF "Verbal Table" TAB_VERB 3 0 "Comm Lost" 1 "OK" 2 "Fault" DEFAULT_VALUE "UNKNOWN" /end COMPU_VTAB
/begin MEASUREMENT CFVI_cur_cal_mod "Internal current CFV cal model" ULONG Compu_CFVI_cur_cal_mod 0 0 0 4294967295 ECU_ADDRESS 0x0100B310 /end MEASUREMENT
/begin COMPU_METHOD Compu_CFVI_cur_cal_mod " " RAT_FUNC "%.0" "-" COEFFS 0 1 0 0 0 1 /end COMPU_METHOD
/begin CHARACTERISTIC PN_CFV_eng_cal_mod "Engine calibration CFV cal model" VALUE 0x001c42d0 /* @ECU_Address@PN_CFV_eng_cal_mod@0x0100B318@ */ ECIPP_ALIGNMENT_ULONG 4294967295 Compu_PN_CFV_eng_cal_mod 0 4294967295 /end CHARACTERISTIC
/begin COMPU_METHOD Compu_PN_CFV_eng_cal_mod " " RAT_FUNC "%.0" "-" COEFFS 0 1 0 0 0 1 /end COMPU_METHOD
/begin MEASUREMENT CFVI_cur_SW_mod "Internal current CFV SW model" ULONG Compu_CFVI_cur_SW_mod 0 0 0 4294967295 ECU_ADDRESS 0x0100B340 /end MEASUREMENT
/begin COMPU_METHOD Compu_CFVI_cur_SW_mod " " RAT_FUNC "%.0" "-" COEFFS 0 1 0 0 0 1 /end COMPU_METHOD
/begin MEASUREMENT CFVI_cur_HW_mod "Internal current CFV HW model" ULONG Compu_CFVI_cur_HW_mod 0 0 0 4294967295 ECU_ADDRESS 0x0100B348 /end MEASUREMENT
/begin COMPU_METHOD Compu_CFVI_cur_HW_mod " " RAT_FUNC "%.0" "-" COEFFS 0 1 0 0 0 1 /end COMPU_METHOD
/begin MEASUREMENT CFV_P_act_DC "CFV actual pressure actuator duty-cycle" SWORD Compu_CFV_P_act_DC 0 0 -100 99.9969482421875 ECU_ADDRESS 0x0100B370 /end MEASUREMENT
/begin COMPU_METHOD Compu_CFV_P_act_DC " " RAT_FUNC "%.1" "%" COEFFS 0 327.68 0 0 0 1 /end COMPU_METHOD
/begin MEASUREMENT CFV_x_act_DC "CFV actual valve actuator duty-cycle" SWORD Compu_CFV_x_act_DC 0 0 -100 99.9969482421875 ECU_ADDRESS 0x0100B378 /end MEASUREMENT
/begin COMPU_METHOD Compu_CFV_x_act_DC " " RAT_FUNC "%.1" "%" COEFFS 0 327.68 0 0 0 1 /end COMPU_METHOD
/begin MEASUREMENT CFV_P_act_I "CFV actual pressure actuator current" SWORD Compu_CFV_P_act_I 0 0 -32 31.9990234375 ECU_ADDRESS 0x0100B380 /end MEASUREMENT
/begin COMPU_METHOD Compu_CFV_P_act_I " " RAT_FUNC "%.2" "amps" COEFFS 0 1024 0 0 0 1 /end COMPU_METHOD
/begin MEASUREMENT CFV_x_act_I "CFV actual valve actuator current" SWORD Compu_CFV_x_act_I 0 0 -32 31.9990234375 ECU_ADDRESS 0x0100B388 /end MEASUREMENT
/begin COMPU_METHOD Compu_CFV_x_act_I " " RAT_FUNC "%.2" "amps" COEFFS 0 1024 0 0 0 1 /end COMPU_METHOD
/begin MEASUREMENT CFV_P_act_kPa "CFV actual interstage pressure" UWORD Compu_CFV_P_act_kPa 0 0 0 297.0332915625 ECU_ADDRESS 0x0100B390 /end MEASUREMENT
/begin COMPU_METHOD Compu_CFV_P_act_kPa " " RAT_FUNC "%.2" "psia" COEFFS 0 220.631834415808 0 0 0 1 /end COMPU_METHOD
/begin MEASUREMENT CFV_x_act "CFV actual valve position" SWORD Compu_CFV_x_act 0 0 -32 31.9990234375 ECU_ADDRESS 0x0100B398 /end MEASUREMENT
/begin COMPU_METHOD Compu_CFV_x_act " " RAT_FUNC "%.2" "mm" COEFFS 0 1024 0 0 0 1 /end COMPU_METHOD
/begin MEASUREMENT CFV_Tfuel_degK "CFV interstage fuel temperature" UWORD Compu_CFV_Tfuel_degK 0 0 -460 1383.171875 ECU_ADDRESS 0x0100B3A0 /end MEASUREMENT
/begin COMPU_METHOD Compu_CFV_Tfuel_degK " " RAT_FUNC "%.1" "deg F" COEFFS 0 35.5555555555556 16355.5555555556 0 0 1 /end COMPU_METHOD
/begin MEASUREMENT CFV_mdot_act_pct "CFV actual fuel flow %" UWORD Compu_CFV_mdot_act_pct 0 0 0 99.9984741210938 ECU_ADDRESS 0x0100B3A8 /end MEASUREMENT
/begin COMPU_METHOD Compu_CFV_mdot_act_pct " " RAT_FUNC "%.1" "% of FS" COEFFS 0 655.36 0 0 0 1 /end COMPU_METHOD
/begin MEASUREMENT CFV_mdot_act "CFV actual fuel flow" UWORD Compu_CFV_mdot_act 0 0 0 127.998046875 ECU_ADDRESS 0x0100B3B0 /end MEASUREMENT
/begin COMPU_METHOD Compu_CFV_mdot_act " " RAT_FUNC "%.2" "g/sec" COEFFS 0 512 0 0 0 1 /end COMPU_METHOD
/begin MEASUREMENT CFV_mdot_cmd_pct "CFV commanded fuel flow %" UWORD Compu_CFV_mdot_cmd_pct 0 0 0 99.9984741210938 ECU_ADDRESS 0x0100B3B8 /end MEASUREMENT
/begin COMPU_METHOD Compu_CFV_mdot_cmd_pct " " RAT_FUNC "%.1" "% of FS" COEFFS 0 655.36 0 0 0 1 /end COMPU_METHOD
/begin MEASUREMENT CFV_mdot_cmd "CFV commanded fuel flow" UWORD Compu_CFV_mdot_cmd 0 0 0 127.998046875 ECU_ADDRESS 0x0100B3C0 /end MEASUREMENT
/begin COMPU_METHOD Compu_CFV_mdot_cmd " " RAT_FUNC "%.2" "g/sec" COEFFS 0 512 0 0 0 1 /end COMPU_METHOD
/begin MEASUREMENT CFV_P_man_kPa "CFV manual interstage pressure" UWORD Compu_CFV_P_man_kPa 0 0 0 297.0332915625 ECU_ADDRESS 0x0100B3C8 /end MEASUREMENT
/begin COMPU_METHOD Compu_CFV_P_man_kPa " " RAT_FUNC "%.2" "psia" COEFFS 0 220.631834415808 0 0 0 1 /end COMPU_METHOD
/begin MEASUREMENT CFV_x_man "CFV manual valve position" SWORD Compu_CFV_x_man 0 0 -32 31.9990234375 ECU_ADDRESS 0x0100B3D0 /end MEASUREMENT
/begin COMPU_METHOD Compu_CFV_x_man " " RAT_FUNC "%.2" "mm" COEFFS 0 1024 0 0 0 1 /end COMPU_METHOD
/begin MEASUREMENT CFV_x_err "CFV internal position control error" SWORD Compu_CFV_x_err 0 0 -32 31.9990234375 ECU_ADDRESS 0x0100B3E8 /end MEASUREMENT
/begin COMPU_METHOD Compu_CFV_x_err " " RAT_FUNC "%.2" "mm" COEFFS 0 1024 0 0 0 1 /end COMPU_METHOD
/begin MEASUREMENT CFV_P_err_kPa "CFV internal pressure control error" SWORD Compu_CFV_P_err_kPa 0 0 -148.518912 148.5143795625 ECU_ADDRESS 0x0100B3F0 /end MEASUREMENT
/begin COMPU_METHOD Compu_CFV_P_err_kPa " " RAT_FUNC "%.2" "psi" COEFFS 0 220.631834415808 0 0 0 1 /end COMPU_METHOD
/begin MEASUREMENT CFV_x_cmd "CFV internal command position" SWORD Compu_CFV_x_cmd 0 0 -32 31.9990234375 ECU_ADDRESS 0x0100B3F8 /end MEASUREMENT
/begin COMPU_METHOD Compu_CFV_x_cmd " " RAT_FUNC "%.2" "mm" COEFFS 0 1024 0 0 0 1 /end COMPU_METHOD
/begin MEASUREMENT CFV_P_cmd_kPa "CFV internal command pressure" SWORD Compu_CFV_P_cmd_kPa 0 0 -148.518912 148.5143795625 ECU_ADDRESS 0x0100B400 /end MEASUREMENT
/begin COMPU_METHOD Compu_CFV_P_cmd_kPa " " RAT_FUNC "%.2" "psia" COEFFS 0 220.631834415808 0 0 0 1 /end COMPU_METHOD
/begin MEASUREMENT CFV_FSO_cmd "CFV fuel shutoff command{CFV_FSO_cmd&0xff=0:Normal Fueling}{CFV_FSO_cmd&0xff=1:FSO Commanded}" UBYTE CFV_FSO_cmd_COMPU_VTAB 0 0 0 255 ECU_ADDRESS 0x0100B408 BIT_MASK 0xff /end MEASUREMENT
/begin COMPU_METHOD CFV_FSO_cmd_COMPU_VTAB "Verbal Table" TAB_VERB "%.0" "list" COMPU_TAB_REF CFV_FSO_cmd_COMPU_VTAB_REF /end COMPU_METHOD
/begin COMPU_VTAB CFV_FSO_cmd_COMPU_VTAB_REF "Verbal Table" TAB_VERB 2 0 "Normal Fueling" 1 "FSO Commanded" DEFAULT_VALUE "UNKNOWN" /end COMPU_VTAB
/begin MEASUREMENT CFV_mdot_pct_err "CFV actual fuel flow vs. commanded" SWORD Compu_CFV_mdot_pct_err 0 0 -6400 6399.8046875 ECU_ADDRESS 0x0100C2B8 /end MEASUREMENT
/begin COMPU_METHOD Compu_CFV_mdot_pct_err " " RAT_FUNC "%.1" "% error" COEFFS 0 5.12 0 0 0 1 /end COMPU_METHOD
/begin CHARACTERISTIC PTOd_sw_cfg "PTOd enable Aux DIG config{PTOd_sw_cfg&0xff=0:Default}{PTOd_sw_cfg&0xff=1:GND}{PTOd_sw_cfg&0xff=2:GND/+V}{PTOd_sw_cfg&0xff=3:+V}{PTOd_sw_cfg&0xff=4:Open}" VALUE 0x001c88ac /* @ECU_Address@PTOd_sw_cfg@0x0100C7E0@ */ ECIPP_ALIGNMENT_UBYTE 255 PTOd_sw_cfg_COMPU_VTAB 0 255 BIT_MASK 0xff /end CHARACTERISTIC
/begin COMPU_METHOD PTOd_sw_cfg_COMPU_VTAB "Verbal Table" TAB_VERB "%.0" "list" COMPU_TAB_REF PTOd_sw_cfg_COMPU_VTAB_REF /end COMPU_METHOD
/begin COMPU_VTAB PTOd_sw_cfg_COMPU_VTAB_REF "Verbal Table" TAB_VERB 5 0 "Default" 1 "GND" 2 "GND/+V" 3 "+V" 4 "Open" DEFAULT_VALUE "UNKNOWN" /end COMPU_VTAB
/begin CHARACTERISTIC PTO_sw_cfg "PTO proportional Aux DIG config{PTO_sw_cfg&0xff=0:Default}{PTO_sw_cfg&0xff=1:GND}{PTO_sw_cfg&0xff=2:GND/+V}{PTO_sw_cfg&0xff=3:+V}{PTO_sw_cfg&0xff=4:Open}" VALUE 0x001c889f /* @ECU_Address@PTO_sw_cfg@0x0100C7E8@ */ ECIPP_ALIGNMENT_UBYTE 255 PTO_sw_cfg_COMPU_VTAB 0 255 BIT_MASK 0xff /end CHARACTERISTIC
/begin COMPU_METHOD PTO_sw_cfg_COMPU_VTAB "Verbal Table" TAB_VERB "%.0" "list" COMPU_TAB_REF PTO_sw_cfg_COMPU_VTAB_REF /end COMPU_METHOD
/begin COMPU_VTAB PTO_sw_cfg_COMPU_VTAB_REF "Verbal Table" TAB_VERB 5 0 "Default" 1 "GND" 2 "GND/+V" 3 "+V" 4 "Open" DEFAULT_VALUE "UNKNOWN" /end COMPU_VTAB
/begin MEASUREMENT UEGO_reset_action "UEGO reset action{UEGO_reset_action&0xff=0:Inactive}{UEGO_reset_action&0xff=1:Reset UEGO 1}{UEGO_reset_action&0xff=2:Reset UEGO 2}{UEGO_reset_action&0xff=3:Reset UEGO 3}{UEGO_reset_action&0xff=4:Reset UEGO 4}" UBYTE UEGO_reset_action_COMPU_VTAB 0 0 0 255 ECU_ADDRESS 0x0100CFB0 BIT_MASK 0xff /end MEASUREMENT
/begin COMPU_METHOD UEGO_reset_action_COMPU_VTAB "Verbal Table" TAB_VERB "%.0" "list" COMPU_TAB_REF UEGO_reset_action_COMPU_VTAB_REF /end COMPU_METHOD
/begin COMPU_VTAB UEGO_reset_action_COMPU_VTAB_REF "Verbal Table" TAB_VERB 5 0 "Inactive" 1 "Reset UEGO 1" 2 "Reset UEGO 2" 3 "Reset UEGO 3" 4 "Reset UEGO 4" DEFAULT_VALUE "UNKNOWN" /end COMPU_VTAB
/begin CHARACTERISTIC PTOd_setinc_cfg "PTO set/+ input Aux DIG config{PTOd_setinc_cfg&0xff=0:Default}{PTOd_setinc_cfg&0xff=1:GND}{PTOd_setinc_cfg&0xff=2:GND/+V}{PTOd_setinc_cfg&0xff=3:+V}{PTOd_setinc_cfg&0xff=4:Open}" VALUE 0x001c88a8 /* @ECU_Address@PTOd_setinc_cfg@0x0100D778@ */ ECIPP_ALIGNMENT_UBYTE 255 PTOd_setinc_cfg_COMPU_VTAB 0 255 BIT_MASK 0xff /end CHARACTERISTIC
/begin COMPU_METHOD PTOd_setinc_cfg_COMPU_VTAB "Verbal Table" TAB_VERB "%.0" "list" COMPU_TAB_REF PTOd_setinc_cfg_COMPU_VTAB_REF /end COMPU_METHOD
/begin COMPU_VTAB PTOd_setinc_cfg_COMPU_VTAB_REF "Verbal Table" TAB_VERB 5 0 "Default" 1 "GND" 2 "GND/+V" 3 "+V" 4 "Open" DEFAULT_VALUE "UNKNOWN" /end COMPU_VTAB
/begin CHARACTERISTIC PTOd_resdec_cfg "PTO res/- input Aux DIG config{PTOd_resdec_cfg&0xff=0:Default}{PTOd_resdec_cfg&0xff=1:GND}{PTOd_resdec_cfg&0xff=2:GND/+V}{PTOd_resdec_cfg&0xff=3:+V}{PTOd_resdec_cfg&0xff=4:Open}" VALUE 0x001c88a6 /* @ECU_Address@PTOd_resdec_cfg@0x0100D780@ */ ECIPP_ALIGNMENT_UBYTE 255 PTOd_resdec_cfg_COMPU_VTAB 0 255 BIT_MASK 0xff /end CHARACTERISTIC
/begin COMPU_METHOD PTOd_resdec_cfg_COMPU_VTAB "Verbal Table" TAB_VERB "%.0" "list" COMPU_TAB_REF PTOd_resdec_cfg_COMPU_VTAB_REF /end COMPU_METHOD
/begin COMPU_VTAB PTOd_resdec_cfg_COMPU_VTAB_REF "Verbal Table" TAB_VERB 5 0 "Default" 1 "GND" 2 "GND/+V" 3 "+V" 4 "Open" DEFAULT_VALUE "UNKNOWN" /end COMPU_VTAB
/begin CHARACTERISTIC PTOd_enable_moment "PTOd enable switch type{PTOd_enable_moment&0xff=0:Toggle sw./config default}{PTOd_enable_moment&0xff=1:Momentary switch}" VALUE 0x001c88a5 /* @ECU_Address@PTOd_enable_moment@0x0100D7D0@ */ ECIPP_ALIGNMENT_UBYTE 255 PTOd_enable_moment_COMPU_VTAB 0 255 BIT_MASK 0xff /end CHARACTERISTIC
/begin COMPU_METHOD PTOd_enable_moment_COMPU_VTAB "Verbal Table" TAB_VERB "%.0" "list" COMPU_TAB_REF PTOd_enable_moment_COMPU_VTAB_REF /end COMPU_METHOD
/begin COMPU_VTAB PTOd_enable_moment_COMPU_VTAB_REF "Verbal Table" TAB_VERB 2 0 "Toggle sw./config default" 1 "Momentary switch" DEFAULT_VALUE "UNKNOWN" /end COMPU_VTAB
/begin CHARACTERISTIC PTOd_disable "PTOd disable input{PTOd_disable&0xff=0:Disabled/config default}{PTOd_disable&0xff=1:Aux PU1=Gnd}{PTOd_disable&0xff=2:Aux PU2=Gnd}{PTOd_disable&0xff=3:Aux PU3=Gnd}{PTOd_disable&0xff=4:Aux PUD1=+5V}{PTOd_disable&0xff=5:Aux PUD2=+5V}{PTOd_disable&0xff=6:Aux " VALUE 0x001c88a1 /* @ECU_Address@PTOd_disable@0x0100D7D8@ */ ECIPP_ALIGNMENT_UBYTE 255 PTOd_disable_COMPU_VTAB 0 255 BIT_MASK 0xff /end CHARACTERISTIC
/begin COMPU_METHOD PTOd_disable_COMPU_VTAB "Verbal Table" TAB_VERB "%.0" "list" COMPU_TAB_REF PTOd_disable_COMPU_VTAB_REF /end COMPU_METHOD
/begin COMPU_VTAB PTOd_disable_COMPU_VTAB_REF "Verbal Table" TAB_VERB 23 0 "Disabled/config default" 1 "Aux PU1=Gnd" 2 "Aux PU2=Gnd" 3 "Aux PU3=Gnd" 4 "Aux PUD1=+5V" 5 "Aux PUD2=+5V" 6 "Aux PUD3=+5V" 7 "Aux DIG1" 8 "Aux DIG2" 9 "Aux DIG3" 10 "Aux DIG4" 11 "Aux DIG5" 12 "Aux DIG6" 13 "Aux DIG7" 14 "Aux DIG8" 15 "Aux DIG9" 16 "Aux DIG10" 17 "J1939 CCVS1 - SPN 599" 18 "J1939 CCVS1 - SPN 600" 19 "J1939 CCVS1 - SPN 601" 20 "J1939 CCVS1 - SPN 602" 21 "J1939 PTO - SPN 980=01" 22 "J1939 PTO - SPN 980=00" DEFAULT_VALUE "UNKNOWN" /end COMPU_VTAB
/begin CHARACTERISTIC PTOd_disable_cfg "PTOd disable Aux DIG config{PTOd_disable_cfg&0xff=0:Default}{PTOd_disable_cfg&0xff=1:GND}{PTOd_disable_cfg&0xff=2:GND/+V}{PTOd_disable_cfg&0xff=3:+V}{PTOd_disable_cfg&0xff=4:Open}" VALUE 0x001c88a3 /* @ECU_Address@PTOd_disable_cfg@0x0100D7E0@ */ ECIPP_ALIGNMENT_UBYTE 255 PTOd_disable_cfg_COMPU_VTAB 0 255 BIT_MASK 0xff /end CHARACTERISTIC
/begin COMPU_METHOD PTOd_disable_cfg_COMPU_VTAB "Verbal Table" TAB_VERB "%.0" "list" COMPU_TAB_REF PTOd_disable_cfg_COMPU_VTAB_REF /end COMPU_METHOD
/begin COMPU_VTAB PTOd_disable_cfg_COMPU_VTAB_REF "Verbal Table" TAB_VERB 5 0 "Default" 1 "GND" 2 "GND/+V" 3 "+V" 4 "Open" DEFAULT_VALUE "UNKNOWN" /end COMPU_VTAB
/begin CHARACTERISTIC IdleTrim_ena "Idle Trim activation input{IdleTrim_ena&0xff=0:Disabled}{IdleTrim_ena&0xff=1:Aux PU1 = Gnd}{IdleTrim_ena&0xff=2:Aux PU2 = Gnd}{IdleTrim_ena&0xff=3:Aux PU3 = Gnd}{IdleTrim_ena&0xff=4:Aux PUD1 = Gnd}{IdleTrim_ena&0xff=5:Aux PUD2 = Gnd}{IdleTrim_ena&0xff=6:A" VALUE 0x001c87a1 /* @ECU_Address@IdleTrim_ena@0x0100D7E8@ */ ECIPP_ALIGNMENT_UBYTE 255 IdleTrim_ena_COMPU_VTAB 0 255 BIT_MASK 0xff /end CHARACTERISTIC
/begin COMPU_METHOD IdleTrim_ena_COMPU_VTAB "Verbal Table" TAB_VERB "%.0" "list" COMPU_TAB_REF IdleTrim_ena_COMPU_VTAB_REF /end COMPU_METHOD
/begin COMPU_VTAB IdleTrim_ena_COMPU_VTAB_REF "Verbal Table" TAB_VERB 30 0 "Disabled" 1 "Aux PU1 = Gnd" 2 "Aux PU2 = Gnd" 3 "Aux PU3 = Gnd" 4 "Aux PUD1 = Gnd" 5 "Aux PUD2 = Gnd" 6 "Aux PUD3 = Gnd" 7 "Aux PUD4 = +V" 8 "Aux PUD5 = Gnd" 9 "Aux DIG1" 10 "Aux DIG2" 11 "Aux DIG3" 12 "Aux DIG4" 13 "Aux DIG5" 14 "Aux DIG6" 15 "Aux DIG7" 16 "Aux DIG8" 17 "Aux DIG9" 18 "Aux DIG10" 19 "Aux DIG11" 20 "Aux DIG12" 21 "Aux DIG13" 22 "Aux DIG14" 23 "Aux DIG15" 24 "Aux DIG16" 25 "Aux DIG17" 26 "Aux DIG18" 27 "Aux DIG19" 28 "Gov1" 29 "Gov2" DEFAULT_VALUE "UNKNOWN" /end COMPU_VTAB
/begin CHARACTERISTIC IdleTrim_ena_cfg "Idle Trim Aux DIG config{IdleTrim_ena_cfg&0xff=0:Default}{IdleTrim_ena_cfg&0xff=1:GND}{IdleTrim_ena_cfg&0xff=2:GND/+V}{IdleTrim_ena_cfg&0xff=3:+V}{IdleTrim_ena_cfg&0xff=4:Open}" VALUE 0x001c87a2 /* @ECU_Address@IdleTrim_ena_cfg@0x0100D7F0@ */ ECIPP_ALIGNMENT_UBYTE 255 IdleTrim_ena_cfg_COMPU_VTAB 0 255 BIT_MASK 0xff /end CHARACTERISTIC
/begin COMPU_METHOD IdleTrim_ena_cfg_COMPU_VTAB "Verbal Table" TAB_VERB "%.0" "list" COMPU_TAB_REF IdleTrim_ena_cfg_COMPU_VTAB_REF /end COMPU_METHOD
/begin COMPU_VTAB IdleTrim_ena_cfg_COMPU_VTAB_REF "Verbal Table" TAB_VERB 5 0 "Default" 1 "GND" 2 "GND/+V" 3 "+V" 4 "Open" DEFAULT_VALUE "UNKNOWN" /end COMPU_VTAB
/begin CHARACTERISTIC IdleTrim_inc "Idle + input{IdleTrim_inc&0xff=0:Disabled}{IdleTrim_inc&0xff=1:Aux PU1 = Gnd}{IdleTrim_inc&0xff=2:Aux PU2 = Gnd}{IdleTrim_inc&0xff=3:Aux PU3 = Gnd}{IdleTrim_inc&0xff=4:Aux PUD1 = Gnd}{IdleTrim_inc&0xff=5:Aux PUD2 = Gnd}{IdleTrim_inc&0xff=6:Aux PUD3 = Gnd}" VALUE 0x001c87a3 /* @ECU_Address@IdleTrim_inc@0x0100D7F8@ */ ECIPP_ALIGNMENT_UBYTE 255 IdleTrim_inc_COMPU_VTAB 0 255 BIT_MASK 0xff /end CHARACTERISTIC
/begin COMPU_METHOD IdleTrim_inc_COMPU_VTAB "Verbal Table" TAB_VERB "%.0" "list" COMPU_TAB_REF IdleTrim_inc_COMPU_VTAB_REF /end COMPU_METHOD
/begin COMPU_VTAB IdleTrim_inc_COMPU_VTAB_REF "Verbal Table" TAB_VERB 30 0 "Disabled" 1 "Aux PU1 = Gnd" 2 "Aux PU2 = Gnd" 3 "Aux PU3 = Gnd" 4 "Aux PUD1 = Gnd" 5 "Aux PUD2 = Gnd" 6 "Aux PUD3 = Gnd" 7 "Aux PUD4 = +V" 8 "Aux PUD5 = Gnd" 9 "Aux DIG1" 10 "Aux DIG2" 11 "Aux DIG3" 12 "Aux DIG4" 13 "Aux DIG5" 14 "Aux DIG6" 15 "Aux DIG7" 16 "Aux DIG8" 17 "Aux DIG9" 18 "Aux DIG10" 19 "Aux DIG11" 20 "Aux DIG12" 21 "Aux DIG13" 22 "Aux DIG14" 23 "Aux DIG15" 24 "Aux DIG16" 25 "Aux DIG17" 26 "Aux DIG18" 27 "Aux DIG19" 28 "Gov1" 29 "Gov2" DEFAULT_VALUE "UNKNOWN" /end COMPU_VTAB
/begin CHARACTERISTIC IdleTrim_inc_cfg "Idle + input Aux DIG config{IdleTrim_inc_cfg&0xff=0:Default}{IdleTrim_inc_cfg&0xff=1:GND}{IdleTrim_inc_cfg&0xff=2:GND/+V}{IdleTrim_inc_cfg&0xff=3:+V}{IdleTrim_inc_cfg&0xff=4:Open}" VALUE 0x001c87a4 /* @ECU_Address@IdleTrim_inc_cfg@0x0100D800@ */ ECIPP_ALIGNMENT_UBYTE 255 IdleTrim_inc_cfg_COMPU_VTAB 0 255 BIT_MASK 0xff /end CHARACTERISTIC
/begin COMPU_METHOD IdleTrim_inc_cfg_COMPU_VTAB "Verbal Table" TAB_VERB "%.0" "list" COMPU_TAB_REF IdleTrim_inc_cfg_COMPU_VTAB_REF /end COMPU_METHOD
/begin COMPU_VTAB IdleTrim_inc_cfg_COMPU_VTAB_REF "Verbal Table" TAB_VERB 5 0 "Default" 1 "GND" 2 "GND/+V" 3 "+V" 4 "Open" DEFAULT_VALUE "UNKNOWN" /end COMPU_VTAB
/begin CHARACTERISTIC IdleTrim_dec "Idle - input{IdleTrim_dec&0xff=0:Disabled}{IdleTrim_dec&0xff=1:Aux PU1 = Gnd}{IdleTrim_dec&0xff=2:Aux PU2 = Gnd}{IdleTrim_dec&0xff=3:Aux PU3 = Gnd}{IdleTrim_dec&0xff=4:Aux PUD1 = Gnd}{IdleTrim_dec&0xff=5:Aux PUD2 = Gnd}{IdleTrim_dec&0xff=6:Aux PUD3 = Gnd}" VALUE 0x001c879f /* @ECU_Address@IdleTrim_dec@0x0100D808@ */ ECIPP_ALIGNMENT_UBYTE 255 IdleTrim_dec_COMPU_VTAB 0 255 BIT_MASK 0xff /end CHARACTERISTIC
/begin COMPU_METHOD IdleTrim_dec_COMPU_VTAB "Verbal Table" TAB_VERB "%.0" "list" COMPU_TAB_REF IdleTrim_dec_COMPU_VTAB_REF /end COMPU_METHOD
/begin COMPU_VTAB IdleTrim_dec_COMPU_VTAB_REF "Verbal Table" TAB_VERB 30 0 "Disabled" 1 "Aux PU1 = Gnd" 2 "Aux PU2 = Gnd" 3 "Aux PU3 = Gnd" 4 "Aux PUD1 = Gnd" 5 "Aux PUD2 = Gnd" 6 "Aux PUD3 = Gnd" 7 "Aux PUD4 = +V" 8 "Aux PUD5 = Gnd" 9 "Aux DIG1" 10 "Aux DIG2" 11 "Aux DIG3" 12 "Aux DIG4" 13 "Aux DIG5" 14 "Aux DIG6" 15 "Aux DIG7" 16 "Aux DIG8" 17 "Aux DIG9" 18 "Aux DIG10" 19 "Aux DIG11" 20 "Aux DIG12" 21 "Aux DIG13" 22 "Aux DIG14" 23 "Aux DIG15" 24 "Aux DIG16" 25 "Aux DIG17" 26 "Aux DIG18" 27 "Aux DIG19" 28 "Gov1" 29 "Gov2" DEFAULT_VALUE "UNKNOWN" /end COMPU_VTAB
/begin CHARACTERISTIC IdleTrim_dec_cfg "Idle - input Aux DIG config{IdleTrim_dec_cfg&0xff=0:Default}{IdleTrim_dec_cfg&0xff=1:GND}{IdleTrim_dec_cfg&0xff=2:GND/+V}{IdleTrim_dec_cfg&0xff=3:+V}{IdleTrim_dec_cfg&0xff=4:Open}" VALUE 0x001c87a0 /* @ECU_Address@IdleTrim_dec_cfg@0x0100D810@ */ ECIPP_ALIGNMENT_UBYTE 255 IdleTrim_dec_cfg_COMPU_VTAB 0 255 BIT_MASK 0xff /end CHARACTERISTIC
/begin COMPU_METHOD IdleTrim_dec_cfg_COMPU_VTAB "Verbal Table" TAB_VERB "%.0" "list" COMPU_TAB_REF IdleTrim_dec_cfg_COMPU_VTAB_REF /end COMPU_METHOD
/begin COMPU_VTAB IdleTrim_dec_cfg_COMPU_VTAB_REF "Verbal Table" TAB_VERB 5 0 "Default" 1 "GND" 2 "GND/+V" 3 "+V" 4 "Open" DEFAULT_VALUE "UNKNOWN" /end COMPU_VTAB
/begin CHARACTERISTIC IdleTrim_step "Idle +/- step size" VALUE 0x001c7c78 /* @ECU_Address@IdleTrim_step@0x0100D818@ */ ECIPP_ALIGNMENT_UWORD 65535 Compu_IdleTrim_step 0 65535 /end CHARACTERISTIC
/begin COMPU_METHOD Compu_IdleTrim_step " " RAT_FUNC "%.0" "rpm" COEFFS 0 1 0 0 0 1 /end COMPU_METHOD
/begin CHARACTERISTIC IdleTrim_ECT "Idle min ECT" VALUE 0x001c7c70 /* @ECU_Address@IdleTrim_ECT@0x0100D820@ */ ECIPP_ALIGNMENT_UWORD 564 Compu_IdleTrim_ECT -460 563.984375 /end CHARACTERISTIC
/begin COMPU_METHOD Compu_IdleTrim_ECT " " RAT_FUNC "%.1" "deg F" COEFFS 0 64 29440 0 0 1 /end COMPU_METHOD
/begin CHARACTERISTIC IdleTrim_run_wait "Idle min engine run time" VALUE 0x001c7c76 /* @ECU_Address@IdleTrim_run_wait@0x0100D828@ */ ECIPP_ALIGNMENT_UWORD 66 Compu_IdleTrim_run_wait 0 65.535 /end CHARACTERISTIC
/begin COMPU_METHOD Compu_IdleTrim_run_wait " " RAT_FUNC "%.1" "sec" COEFFS 0 1000 0 0 0 1 /end COMPU_METHOD
/begin CHARACTERISTIC IdleTrim_min_rpm "Idle min engine speed" VALUE 0x001c7c74 /* @ECU_Address@IdleTrim_min_rpm@0x0100D830@ */ ECIPP_ALIGNMENT_UWORD 65535 Compu_IdleTrim_min_rpm 0 65535 /end CHARACTERISTIC
/begin COMPU_METHOD Compu_IdleTrim_min_rpm " " RAT_FUNC "%.0" "rpm" COEFFS 0 1 0 0 0 1 /end COMPU_METHOD
/begin CHARACTERISTIC IdleTrim_max_rpm "Idle max engine speed" VALUE 0x001c7c72 /* @ECU_Address@IdleTrim_max_rpm@0x0100D838@ */ ECIPP_ALIGNMENT_UWORD 65535 Compu_IdleTrim_max_rpm 0 65535 /end CHARACTERISTIC
/begin COMPU_METHOD Compu_IdleTrim_max_rpm " " RAT_FUNC "%.0" "rpm" COEFFS 0 1 0 0 0 1 /end COMPU_METHOD
/begin MEASUREMENT IdleTrim_rpm "Idle setpoint" UWORD Compu_IdleTrim_rpm 0 0 0 65535 ECU_ADDRESS 0x0100D840 /end MEASUREMENT
/begin COMPU_METHOD Compu_IdleTrim_rpm " " RAT_FUNC "%.0" "rpm" COEFFS 0 1 0 0 0 1 /end COMPU_METHOD
/begin MEASUREMENT IdleTrim_ctls "Idle +/-/save inputs{IdleTrim_ctls&0xff=0:Inactive}{IdleTrim_ctls&0xff=1:Active}" UBYTE IdleTrim_ctls_COMPU_VTAB 0 0 0 255 ECU_ADDRESS 0x0100D848 BIT_MASK 0xff /end MEASUREMENT
/begin COMPU_METHOD IdleTrim_ctls_COMPU_VTAB "Verbal Table" TAB_VERB "%.0" "list" COMPU_TAB_REF IdleTrim_ctls_COMPU_VTAB_REF /end COMPU_METHOD
/begin COMPU_VTAB IdleTrim_ctls_COMPU_VTAB_REF "Verbal Table" TAB_VERB 2 0 "Inactive" 1 "Active" DEFAULT_VALUE "UNKNOWN" /end COMPU_VTAB
/begin MEASUREMENT IdleTrim_active "Idle Trim setpoint active{IdleTrim_active&0x01=0x00:OFF}{IdleTrim_active&0x01=0x01:ON}" UBYTE IdleTrim_active_COMPU_VTAB 0 0 0 255 ECU_ADDRESS 0x0100D850 BIT_MASK 0x01 /end MEASUREMENT
/begin COMPU_METHOD IdleTrim_active_COMPU_VTAB "Verbal Table" TAB_VERB "%.0" "list" COMPU_TAB_REF IdleTrim_active_COMPU_VTAB_REF /end COMPU_METHOD
/begin COMPU_VTAB IdleTrim_active_COMPU_VTAB_REF "Verbal Table" TAB_VERB 2 0x00 "OFF" 0x01 "ON" DEFAULT_VALUE "UNKNOWN" /end COMPU_VTAB
/begin CHARACTERISTIC fm_wus_ect_min "Warm-up min ECT" VALUE 0x001c8438 /* @ECU_Address@fm_wus_ect_min@0x0100DA18@ */ ECIPP_ALIGNMENT_UWORD 564 Compu_fm_wus_ect_min -460 563.984375 /end CHARACTERISTIC
/begin COMPU_METHOD Compu_fm_wus_ect_min " " RAT_FUNC "%.0" "deg F" COEFFS 0 64 29440 0 0 1 /end COMPU_METHOD
/begin MEASUREMENT fm_wus_ect_target "Warm-up target ECT" UWORD Compu_fm_wus_ect_target 0 0 -460 563.984375 ECU_ADDRESS 0x0100DA20 /end MEASUREMENT
/begin COMPU_METHOD Compu_fm_wus_ect_target " " RAT_FUNC "%.1" "deg F" COEFFS 0 64 29440 0 0 1 /end COMPU_METHOD
/begin MEASUREMENT fm_wus_ect_start "ECT at engine start" UWORD Compu_fm_wus_ect_start 0 0 -460 563.984375 ECU_ADDRESS 0x0100DA30 /end MEASUREMENT
/begin COMPU_METHOD Compu_fm_wus_ect_start " " RAT_FUNC "%.1" "deg F" COEFFS 0 64 29440 0 0 1 /end COMPU_METHOD
/begin CHARACTERISTIC fm_wus_ect_delta "Warm-up ECT increase" VALUE 0x001c8436 /* @ECU_Address@fm_wus_ect_delta@0x0100DA80@ */ ECIPP_ALIGNMENT_UWORD 1024 Compu_fm_wus_ect_delta 0 1023.984375 /end CHARACTERISTIC
/begin COMPU_METHOD Compu_fm_wus_ect_delta " " RAT_FUNC "%.0" "deg F" COEFFS 0 64 0 0 0 1 /end COMPU_METHOD
/begin MEASUREMENT FSF2_NOX_FAULT_MIL "NOx fault requesting MIL{FSF2_NOX_FAULT_MIL&0x08=0x00:No NOx Fault requesting MIL}{FSF2_NOX_FAULT_MIL&0x08=0x08:NOx fault requesting MIL}" UBYTE FSF2_NOX_FAULT_MIL_COMPU_VTAB 0 0 0 255 ECU_ADDRESS 0x0100DAD0 BIT_MASK 0x08 /end MEASUREMENT
/begin COMPU_METHOD FSF2_NOX_FAULT_MIL_COMPU_VTAB "Verbal Table" TAB_VERB "%.0" "list" COMPU_TAB_REF FSF2_NOX_FAULT_MIL_COMPU_VTAB_REF /end COMPU_METHOD
/begin COMPU_VTAB FSF2_NOX_FAULT_MIL_COMPU_VTAB_REF "Verbal Table" TAB_VERB 2 0x00 "No NOx Fault requesting MIL" 0x08 "NOx fault requesting MIL" DEFAULT_VALUE "UNKNOWN" /end COMPU_VTAB
/begin MEASUREMENT fm_rt_while_nox_MIL "NOx MIL engine run time" ULONG Compu_fm_rt_while_nox_MIL 0 0 0 71582788.25 ECU_ADDRESS 0x0100DAD8 /end MEASUREMENT
/begin COMPU_METHOD Compu_fm_rt_while_nox_MIL " " RAT_FUNC "%.0" "minutes" COEFFS 0 60 0 0 0 1 /end COMPU_METHOD
/begin CHARACTERISTIC fm_nox_retention "NOx fault retention" VALUE 0x001c43f8 /* @ECU_Address@fm_nox_retention@0x0100DAE0@ */ ECIPP_ALIGNMENT_ULONG 1193046 Compu_fm_nox_retention 0 1193046.47083333 /end CHARACTERISTIC
/begin COMPU_METHOD Compu_fm_nox_retention " " RAT_FUNC "%.2" "hours" COEFFS 0 3600 0 0 0 1 /end COMPU_METHOD
/begin CHARACTERISTIC fm_derate_clear "Clear active derate{fm_derate_clear&0xff=0:Not allowed}{fm_derate_clear&0xff=1:Allowed}" VALUE 0x001c901e /* @ECU_Address@fm_derate_clear@0x0100DAE8@ */ ECIPP_ALIGNMENT_UBYTE 255 fm_derate_clear_COMPU_VTAB 0 255 BIT_MASK 0xff /end CHARACTERISTIC
/begin COMPU_METHOD fm_derate_clear_COMPU_VTAB "Verbal Table" TAB_VERB "%.0" "list" COMPU_TAB_REF fm_derate_clear_COMPU_VTAB_REF /end COMPU_METHOD
/begin COMPU_VTAB fm_derate_clear_COMPU_VTAB_REF "Verbal Table" TAB_VERB 2 0 "Not allowed" 1 "Allowed" DEFAULT_VALUE "UNKNOWN" /end COMPU_VTAB
/begin CHARACTERISTIC PTOd_setinc_tap "PTO set/+ tap step" VALUE 0x001c7e7a /* @ECU_Address@PTOd_setinc_tap@0x0100E5F0@ */ ECIPP_ALIGNMENT_UWORD 65535 Compu_PTOd_setinc_tap 0 65535 /end CHARACTERISTIC
/begin COMPU_METHOD Compu_PTOd_setinc_tap " " RAT_FUNC "%.0" "rpm" COEFFS 0 1 0 0 0 1 /end COMPU_METHOD
/begin CHARACTERISTIC PTOd_resdec_tap "PTO res/- tap step" VALUE 0x001c7e70 /* @ECU_Address@PTOd_resdec_tap@0x0100E5F8@ */ ECIPP_ALIGNMENT_UWORD 65535 Compu_PTOd_resdec_tap 0 65535 /end CHARACTERISTIC
/begin COMPU_METHOD Compu_PTOd_resdec_tap " " RAT_FUNC "%.0" "rpm" COEFFS 0 1 0 0 0 1 /end COMPU_METHOD
/begin CHARACTERISTIC PTOd_setinc_store_EE "PTO set/+ engine speed retention{PTOd_setinc_store_EE&0xff=0:Reset when disengaged}{PTOd_setinc_store_EE&0xff=1:Permanently retained}" VALUE 0x001c88aa /* @ECU_Address@PTOd_setinc_store_EE@0x0100E7B8@ */ ECIPP_ALIGNMENT_UBYTE 255 PTOd_setinc_store_EE_COMPU_VTAB 0 255 BIT_MASK 0xff /end CHARACTERISTIC
/begin COMPU_METHOD PTOd_setinc_store_EE_COMPU_VTAB "Verbal Table" TAB_VERB "%.0" "list" COMPU_TAB_REF PTOd_setinc_store_EE_COMPU_VTAB_REF /end COMPU_METHOD
/begin COMPU_VTAB PTOd_setinc_store_EE_COMPU_VTAB_REF "Verbal Table" TAB_VERB 2 0 "Reset when disengaged" 1 "Permanently retained" DEFAULT_VALUE "UNKNOWN" /end COMPU_VTAB
/begin CHARACTERISTIC fm_mode "Fault system mode{fm_mode&0xff=0:Custom}{fm_mode&0xff=1:State Standard V (SSV)}{fm_mode&0xff=2:Euro VI}{fm_mode&0xff=3:CARB 1971.1}" VALUE 0x001c902a /* @ECU_Address@fm_mode@0x0100E900@ */ ECIPP_ALIGNMENT_UBYTE 255 fm_mode_COMPU_VTAB 0 255 BIT_MASK 0xff /end CHARACTERISTIC
/begin COMPU_METHOD fm_mode_COMPU_VTAB "Verbal Table" TAB_VERB "%.0" "list" COMPU_TAB_REF fm_mode_COMPU_VTAB_REF /end COMPU_METHOD
/begin COMPU_VTAB fm_mode_COMPU_VTAB_REF "Verbal Table" TAB_VERB 4 0 "Custom" 1 "State Standard V (SSV)" 2 "Euro VI" 3 "CARB 1971.1" DEFAULT_VALUE "UNKNOWN" /end COMPU_VTAB
/begin CHARACTERISTIC fm_ac_cyc_type "Cycle type desired{fm_ac_cyc_type&0xff=0:Engine cycle}{fm_ac_cyc_type&0xff=1:Warm-up cycle}" VALUE 0x001c901d /* @ECU_Address@fm_ac_cyc_type@0x0100E9A0@ */ ECIPP_ALIGNMENT_UBYTE 255 fm_ac_cyc_type_COMPU_VTAB 0 255 BIT_MASK 0xff /end CHARACTERISTIC
/begin COMPU_METHOD fm_ac_cyc_type_COMPU_VTAB "Verbal Table" TAB_VERB "%.0" "list" COMPU_TAB_REF fm_ac_cyc_type_COMPU_VTAB_REF /end COMPU_METHOD
/begin COMPU_VTAB fm_ac_cyc_type_COMPU_VTAB_REF "Verbal Table" TAB_VERB 2 0 "Engine cycle" 1 "Warm-up cycle" DEFAULT_VALUE "UNKNOWN" /end COMPU_VTAB
/begin MEASUREMENT fm_discmil "Effective MI State{fm_discmil&0xff=0:Off}{fm_discmil&0xff=1:On demand}{fm_discmil&0xff=2:Short}{fm_discmil&0xff=3:Continuous}" UBYTE fm_discmil_COMPU_VTAB 0 0 0 255 ECU_ADDRESS 0x0100E9A8 BIT_MASK 0xff /end MEASUREMENT
/begin COMPU_METHOD fm_discmil_COMPU_VTAB "Verbal Table" TAB_VERB "%.0" "list" COMPU_TAB_REF fm_discmil_COMPU_VTAB_REF /end COMPU_METHOD
/begin COMPU_VTAB fm_discmil_COMPU_VTAB_REF "Verbal Table" TAB_VERB 4 0 "Off" 1 "On demand" 2 "Short" 3 "Continuous" DEFAULT_VALUE "UNKNOWN" /end COMPU_VTAB
/begin MEASUREMENT FSF_FAULT_MIL "Continuous-MI{FSF_FAULT_MIL&0x80=0x00:Off}{FSF_FAULT_MIL&0x80=0x80:On}" UBYTE FSF_FAULT_MIL_COMPU_VTAB 0 0 0 255 ECU_ADDRESS 0x0100E9B0 BIT_MASK 0xFF /end MEASUREMENT
/begin COMPU_METHOD FSF_FAULT_MIL_COMPU_VTAB "Verbal Table" TAB_VERB "%.0" "list" COMPU_TAB_REF FSF_FAULT_MIL_COMPU_VTAB_REF /end COMPU_METHOD
/begin COMPU_VTAB FSF_FAULT_MIL_COMPU_VTAB_REF "Verbal Table" TAB_VERB 2 0x00 "Off" 0x80 "On" DEFAULT_VALUE "Unsupported Bit_Shift" /end COMPU_VTAB
/begin MEASUREMENT FSF2_SHORT_MIL "Short-MI{FSF2_SHORT_MIL&0x04=0x00:Off}{FSF2_SHORT_MIL&0x04=0x04:On}" UBYTE FSF2_SHORT_MIL_COMPU_VTAB 0 0 0 255 ECU_ADDRESS 0x0100E9B8 BIT_MASK 0x04 /end MEASUREMENT
/begin COMPU_METHOD FSF2_SHORT_MIL_COMPU_VTAB "Verbal Table" TAB_VERB "%.0" "list" COMPU_TAB_REF FSF2_SHORT_MIL_COMPU_VTAB_REF /end COMPU_METHOD
/begin COMPU_VTAB FSF2_SHORT_MIL_COMPU_VTAB_REF "Verbal Table" TAB_VERB 2 0x00 "Off" 0x04 "On" DEFAULT_VALUE "UNKNOWN" /end COMPU_VTAB
/begin MEASUREMENT FSF2_ON_DEMAND_MIL "On-demand-MI{FSF2_ON_DEMAND_MIL&0x02=0x00:Off}{FSF2_ON_DEMAND_MIL&0x02=0x02:On}" UBYTE FSF2_ON_DEMAND_MIL_COMPU_VTAB 0 0 0 255 ECU_ADDRESS 0x0100E9C0 BIT_MASK 0x02 /end MEASUREMENT
/begin COMPU_METHOD FSF2_ON_DEMAND_MIL_COMPU_VTAB "Verbal Table" TAB_VERB "%.0" "list" COMPU_TAB_REF FSF2_ON_DEMAND_MIL_COMPU_VTAB_REF /end COMPU_METHOD
/begin COMPU_VTAB FSF2_ON_DEMAND_MIL_COMPU_VTAB_REF "Verbal Table" TAB_VERB 2 0x00 "Off" 0x02 "On" DEFAULT_VALUE "UNKNOWN" /end COMPU_VTAB
/begin MEASUREMENT FSF2_ALL_MON_READY "All supported monitors ready{FSF2_ALL_MON_READY&0x01=0x00:No}{FSF2_ALL_MON_READY&0x01=0x01:Yes}" UBYTE FSF2_ALL_MON_READY_COMPU_VTAB 0 0 0 255 ECU_ADDRESS 0x0100EA00 BIT_MASK 0x01 /end MEASUREMENT
/begin COMPU_METHOD FSF2_ALL_MON_READY_COMPU_VTAB "Verbal Table" TAB_VERB "%.0" "list" COMPU_TAB_REF FSF2_ALL_MON_READY_COMPU_VTAB_REF /end COMPU_METHOD
/begin COMPU_VTAB FSF2_ALL_MON_READY_COMPU_VTAB_REF "Verbal Table" TAB_VERB 2 0x00 "No" 0x01 "Yes" DEFAULT_VALUE "UNKNOWN" /end COMPU_VTAB
/begin MEASUREMENT FSFP_WARMED_UP "Warmed up{FSFP_WARMED_UP&0x80=0x00:Not warmed up}{FSFP_WARMED_UP&0x80=0x80:Warmed up}" UBYTE FSFP_WARMED_UP_COMPU_VTAB 0 0 0 255 ECU_ADDRESS 0x0100EA08 BIT_MASK 0xFF /end MEASUREMENT
/begin COMPU_METHOD FSFP_WARMED_UP_COMPU_VTAB "Verbal Table" TAB_VERB "%.0" "list" COMPU_TAB_REF FSFP_WARMED_UP_COMPU_VTAB_REF /end COMPU_METHOD
/begin COMPU_VTAB FSFP_WARMED_UP_COMPU_VTAB_REF "Verbal Table" TAB_VERB 2 0x00 "Not warmed up" 0x80 "Warmed up" DEFAULT_VALUE "Unsupported Bit_Shift" /end COMPU_VTAB
/begin MEASUREMENT FSFP_MIL_THIS_CYCLE "MIL this cycle{FSFP_MIL_THIS_CYCLE&0x40=0x00:No MIL this cycle}{FSFP_MIL_THIS_CYCLE&0x40=0x40:MIL this cycle}" UBYTE FSFP_MIL_THIS_CYCLE_COMPU_VTAB 0 0 0 255 ECU_ADDRESS 0x0100EA10 BIT_MASK 0x40 /end MEASUREMENT
/begin COMPU_METHOD FSFP_MIL_THIS_CYCLE_COMPU_VTAB "Verbal Table" TAB_VERB "%.0" "list" COMPU_TAB_REF FSFP_MIL_THIS_CYCLE_COMPU_VTAB_REF /end COMPU_METHOD
/begin COMPU_VTAB FSFP_MIL_THIS_CYCLE_COMPU_VTAB_REF "Verbal Table" TAB_VERB 2 0x00 "No MIL this cycle" 0x40 "MIL this cycle" DEFAULT_VALUE "UNKNOWN" /end COMPU_VTAB
/begin MEASUREMENT FSFP_CLR_THIS_CYCLE "Cleared/reset this cycle{FSFP_CLR_THIS_CYCLE&0x20=0x00:Not cleared this cycle}{FSFP_CLR_THIS_CYCLE&0x20=0x20:Cleared this cycle}" UBYTE FSFP_CLR_THIS_CYCLE_COMPU_VTAB 0 0 0 255 ECU_ADDRESS 0x0100EA18 BIT_MASK 0x20 /end MEASUREMENT
/begin COMPU_METHOD FSFP_CLR_THIS_CYCLE_COMPU_VTAB "Verbal Table" TAB_VERB "%.0" "list" COMPU_TAB_REF FSFP_CLR_THIS_CYCLE_COMPU_VTAB_REF /end COMPU_METHOD
/begin COMPU_VTAB FSFP_CLR_THIS_CYCLE_COMPU_VTAB_REF "Verbal Table" TAB_VERB 2 0x00 "Not cleared this cycle" 0x20 "Cleared this cycle" DEFAULT_VALUE "UNKNOWN" /end COMPU_VTAB
/begin MEASUREMENT FSF_MIL_STATE "MIL state{FSF_MIL_STATE&0x01=0x00:Off}{FSF_MIL_STATE&0x01=0x01:On}" UBYTE FSF_MIL_STATE_COMPU_VTAB 0 0 0 255 ECU_ADDRESS 0x0100EA28 BIT_MASK 0x01 /end MEASUREMENT
/begin COMPU_METHOD FSF_MIL_STATE_COMPU_VTAB "Verbal Table" TAB_VERB "%.0" "list" COMPU_TAB_REF FSF_MIL_STATE_COMPU_VTAB_REF /end COMPU_METHOD
/begin COMPU_VTAB FSF_MIL_STATE_COMPU_VTAB_REF "Verbal Table" TAB_VERB 2 0x00 "Off" 0x01 "On" DEFAULT_VALUE "UNKNOWN" /end COMPU_VTAB
/begin MEASUREMENT J1939_MIL_state "J1939 MIL state{J1939_MIL_state&0xff=0:Off}{J1939_MIL_state&0xff=1:On}" UBYTE J1939_MIL_state_COMPU_VTAB 0 0 0 255 ECU_ADDRESS 0x0100EA30 BIT_MASK 0xff /end MEASUREMENT
/begin COMPU_METHOD J1939_MIL_state_COMPU_VTAB "Verbal Table" TAB_VERB "%.0" "list" COMPU_TAB_REF J1939_MIL_state_COMPU_VTAB_REF /end COMPU_METHOD
/begin COMPU_VTAB J1939_MIL_state_COMPU_VTAB_REF "Verbal Table" TAB_VERB 2 0 "Off" 1 "On" DEFAULT_VALUE "UNKNOWN" /end COMPU_VTAB
/begin MEASUREMENT MIL_status "Configurable output MIL{MIL_status&0xff=0:Off}{MIL_status&0xff=1:On - Bulb}{MIL_status&0xff=2:On - Persist}{MIL_status&0xff=3:On - Fault}" UWORD MIL_status_COMPU_VTAB 0 0 0 65535 ECU_ADDRESS 0x0100EA38 BIT_MASK 0xff /end MEASUREMENT
/begin COMPU_METHOD MIL_status_COMPU_VTAB "Verbal Table" TAB_VERB "%.0" "list" COMPU_TAB_REF MIL_status_COMPU_VTAB_REF /end COMPU_METHOD
/begin COMPU_VTAB MIL_status_COMPU_VTAB_REF "Verbal Table" TAB_VERB 4 0 "Off" 1 "On - Bulb" 2 "On - Persist" 3 "On - Fault" DEFAULT_VALUE "UNKNOWN" /end COMPU_VTAB
/begin CHARACTERISTIC fm_dtc_svr_ena "UDS DTC Severity support{fm_dtc_svr_ena&0xff=0:Disabled}{fm_dtc_svr_ena&0xff=1:Enabled}" VALUE 0x001c901f /* @ECU_Address@fm_dtc_svr_ena@0x0100EA40@ */ ECIPP_ALIGNMENT_UBYTE 255 fm_dtc_svr_ena_COMPU_VTAB 0 255 BIT_MASK 0xff /end CHARACTERISTIC
/begin COMPU_METHOD fm_dtc_svr_ena_COMPU_VTAB "Verbal Table" TAB_VERB "%.0" "list" COMPU_TAB_REF fm_dtc_svr_ena_COMPU_VTAB_REF /end COMPU_METHOD
/begin COMPU_VTAB fm_dtc_svr_ena_COMPU_VTAB_REF "Verbal Table" TAB_VERB 2 0 "Disabled" 1 "Enabled" DEFAULT_VALUE "UNKNOWN" /end COMPU_VTAB
/begin MEASUREMENT fm_gd_cum_rt_env "Cumulative runtime - env" ULONG Compu_fm_gd_cum_rt_env 0 0 0 4294967.295 ECU_ADDRESS 0x0100EAA0 /end MEASUREMENT
/begin COMPU_METHOD Compu_fm_gd_cum_rt_env " " RAT_FUNC "%.0" "sec" COEFFS 0 1000 0 0 0 1 /end COMPU_METHOD
/begin MEASUREMENT fm_gd_cum_rt_oper "Cumulative runtime - oper" ULONG Compu_fm_gd_cum_rt_oper 0 0 0 4294967.295 ECU_ADDRESS 0x0100EAA8 /end MEASUREMENT
/begin COMPU_METHOD Compu_fm_gd_cum_rt_oper " " RAT_FUNC "%.0" "sec" COEFFS 0 1000 0 0 0 1 /end COMPU_METHOD
/begin MEASUREMENT fm_gd_cont_rt_idle "Continuous runtime - idle" UWORD Compu_fm_gd_cont_rt_idle 0 0 0 65.535 ECU_ADDRESS 0x0100EAB0 /end MEASUREMENT
/begin COMPU_METHOD Compu_fm_gd_cont_rt_idle " " RAT_FUNC "%.0" "sec" COEFFS 0 1000 0 0 0 1 /end COMPU_METHOD
/begin MEASUREMENT FSF2_GD_INC "Gen denom incremented{FSF2_GD_INC&0x20=0x00:GD incremented this cycle}{FSF2_GD_INC&0x20=0x20:GD not incremented this cycle}" UBYTE FSF2_GD_INC_COMPU_VTAB 0 0 0 255 ECU_ADDRESS 0x0100EAB8 BIT_MASK 0x20 /end MEASUREMENT
/begin COMPU_METHOD FSF2_GD_INC_COMPU_VTAB "Verbal Table" TAB_VERB "%.0" "list" COMPU_TAB_REF FSF2_GD_INC_COMPU_VTAB_REF /end COMPU_METHOD
/begin COMPU_VTAB FSF2_GD_INC_COMPU_VTAB_REF "Verbal Table" TAB_VERB 2 0x00 "GD incremented this cycle" 0x20 "GD not incremented this cycle" DEFAULT_VALUE "UNKNOWN" /end COMPU_VTAB
/begin MEASUREMENT rdy_rdy_nmhc_cat "OBD Readiness Status Ready 5" UBYTE Compu_rdy_rdy_nmhc_cat 0 0 0 255 ECU_ADDRESS 0x0100EAF0 /end MEASUREMENT
/begin COMPU_METHOD Compu_rdy_rdy_nmhc_cat " " RAT_FUNC "%.0" "-" COEFFS 0 1 0 0 0 1 /end COMPU_METHOD
/begin MEASUREMENT rdy_rdy_heated_cat "OBD Readiness Status Ready 6" UBYTE Compu_rdy_rdy_heated_cat 0 0 0 255 ECU_ADDRESS 0x0100EAF8 /end MEASUREMENT
/begin COMPU_METHOD Compu_rdy_rdy_heated_cat " " RAT_FUNC "%.0" "-" COEFFS 0 1 0 0 0 1 /end COMPU_METHOD
/begin MEASUREMENT rdy_rdy_nox "OBD Readiness Status Ready 7" UBYTE Compu_rdy_rdy_nox 0 0 0 255 ECU_ADDRESS 0x0100EB00 /end MEASUREMENT
/begin COMPU_METHOD Compu_rdy_rdy_nox " " RAT_FUNC "%.0" "-" COEFFS 0 1 0 0 0 1 /end COMPU_METHOD
/begin MEASUREMENT rdy_rdy_evap "OBD Readiness Status Ready 8" UBYTE Compu_rdy_rdy_evap 0 0 0 255 ECU_ADDRESS 0x0100EB08 /end MEASUREMENT
/begin COMPU_METHOD Compu_rdy_rdy_evap " " RAT_FUNC "%.0" "-" COEFFS 0 1 0 0 0 1 /end COMPU_METHOD
/begin MEASUREMENT rdy_rdy_sec_air "OBD Readiness Status Ready 9" UBYTE Compu_rdy_rdy_sec_air 0 0 0 255 ECU_ADDRESS 0x0100EB10 /end MEASUREMENT
/begin COMPU_METHOD Compu_rdy_rdy_sec_air " " RAT_FUNC "%.0" "-" COEFFS 0 1 0 0 0 1 /end COMPU_METHOD
/begin MEASUREMENT rdy_rdy_exhaust_gas "OBD Readiness Status Ready 12" UBYTE Compu_rdy_rdy_exhaust_gas 0 0 0 255 ECU_ADDRESS 0x0100EB28 /end MEASUREMENT
/begin COMPU_METHOD Compu_rdy_rdy_exhaust_gas " " RAT_FUNC "%.0" "-" COEFFS 0 1 0 0 0 1 /end COMPU_METHOD
/begin MEASUREMENT rdy_rdy_pm_filter "OBD Readiness Status Ready 14" UBYTE Compu_rdy_rdy_pm_filter 0 0 0 255 ECU_ADDRESS 0x0100EB38 /end MEASUREMENT
/begin COMPU_METHOD Compu_rdy_rdy_pm_filter " " RAT_FUNC "%.0" "-" COEFFS 0 1 0 0 0 1 /end COMPU_METHOD
/begin MEASUREMENT rdy_sup_nmhc_cat "OBD Readiness Status Supported 5" UBYTE Compu_rdy_sup_nmhc_cat 0 0 0 255 ECU_ADDRESS 0x0100EB70 /end MEASUREMENT
/begin COMPU_METHOD Compu_rdy_sup_nmhc_cat " " RAT_FUNC "%.0" "-" COEFFS 0 1 0 0 0 1 /end COMPU_METHOD
/begin MEASUREMENT rdy_sup_heated_cat "OBD Readiness Status Supported 6" UBYTE Compu_rdy_sup_heated_cat 0 0 0 255 ECU_ADDRESS 0x0100EB78 /end MEASUREMENT
/begin COMPU_METHOD Compu_rdy_sup_heated_cat " " RAT_FUNC "%.0" "-" COEFFS 0 1 0 0 0 1 /end COMPU_METHOD
/begin MEASUREMENT rdy_sup_nox "OBD Readiness Status Supported 7" UBYTE Compu_rdy_sup_nox 0 0 0 255 ECU_ADDRESS 0x0100EB80 /end MEASUREMENT
/begin COMPU_METHOD Compu_rdy_sup_nox " " RAT_FUNC "%.0" "-" COEFFS 0 1 0 0 0 1 /end COMPU_METHOD
/begin MEASUREMENT rdy_sup_evap "OBD Readiness Status Supported 8" UBYTE Compu_rdy_sup_evap 0 0 0 255 ECU_ADDRESS 0x0100EB88 /end MEASUREMENT
/begin COMPU_METHOD Compu_rdy_sup_evap " " RAT_FUNC "%.0" "-" COEFFS 0 1 0 0 0 1 /end COMPU_METHOD
/begin MEASUREMENT rdy_sup_sec_air "OBD Readiness Status Supported 9" UBYTE Compu_rdy_sup_sec_air 0 0 0 255 ECU_ADDRESS 0x0100EB90 /end MEASUREMENT
/begin COMPU_METHOD Compu_rdy_sup_sec_air " " RAT_FUNC "%.0" "-" COEFFS 0 1 0 0 0 1 /end COMPU_METHOD
/begin MEASUREMENT rdy_sup_exhaust_gas "OBD Readiness Status Supported 12" UBYTE Compu_rdy_sup_exhaust_gas 0 0 0 255 ECU_ADDRESS 0x0100EBA8 /end MEASUREMENT
/begin COMPU_METHOD Compu_rdy_sup_exhaust_gas " " RAT_FUNC "%.0" "-" COEFFS 0 1 0 0 0 1 /end COMPU_METHOD
/begin MEASUREMENT rdy_sup_pm_filter "OBD Readiness Status Supported 14" UBYTE Compu_rdy_sup_pm_filter 0 0 0 255 ECU_ADDRESS 0x0100EBB8 /end MEASUREMENT
/begin COMPU_METHOD Compu_rdy_sup_pm_filter " " RAT_FUNC "%.0" "-" COEFFS 0 1 0 0 0 1 /end COMPU_METHOD
/begin MEASUREMENT rdy_ena_misfire "OBD Readiness Status Enabled 1" UBYTE Compu_rdy_ena_misfire 0 0 0 255 ECU_ADDRESS 0x0100EBD0 /end MEASUREMENT
/begin COMPU_METHOD Compu_rdy_ena_misfire " " RAT_FUNC "%.0" "-" COEFFS 0 1 0 0 0 1 /end COMPU_METHOD
/begin MEASUREMENT rdy_ena_fuel "OBD Readiness Status Enabled 2" UBYTE Compu_rdy_ena_fuel 0 0 0 255 ECU_ADDRESS 0x0100EBD8 /end MEASUREMENT
/begin COMPU_METHOD Compu_rdy_ena_fuel " " RAT_FUNC "%.0" "-" COEFFS 0 1 0 0 0 1 /end COMPU_METHOD
/begin MEASUREMENT rdy_ena_compcomp "OBD Readiness Status Enabled 3" UBYTE Compu_rdy_ena_compcomp 0 0 0 255 ECU_ADDRESS 0x0100EBE0 /end MEASUREMENT
/begin COMPU_METHOD Compu_rdy_ena_compcomp " " RAT_FUNC "%.0" "-" COEFFS 0 1 0 0 0 1 /end COMPU_METHOD
/begin MEASUREMENT rdy_ena_cat "OBD Readiness Status Enabled 4" UBYTE Compu_rdy_ena_cat 0 0 0 255 ECU_ADDRESS 0x0100EBE8 /end MEASUREMENT
/begin COMPU_METHOD Compu_rdy_ena_cat " " RAT_FUNC "%.0" "-" COEFFS 0 1 0 0 0 1 /end COMPU_METHOD
/begin MEASUREMENT rdy_ena_nmhc_cat "OBD Readiness Status Enabled 5" UBYTE Compu_rdy_ena_nmhc_cat 0 0 0 255 ECU_ADDRESS 0x0100EBF0 /end MEASUREMENT
/begin COMPU_METHOD Compu_rdy_ena_nmhc_cat " " RAT_FUNC "%.0" "-" COEFFS 0 1 0 0 0 1 /end COMPU_METHOD
/begin MEASUREMENT rdy_ena_heated_cat "OBD Readiness Status Enabled 6" UBYTE Compu_rdy_ena_heated_cat 0 0 0 255 ECU_ADDRESS 0x0100EBF8 /end MEASUREMENT
/begin COMPU_METHOD Compu_rdy_ena_heated_cat " " RAT_FUNC "%.0" "-" COEFFS 0 1 0 0 0 1 /end COMPU_METHOD
/begin MEASUREMENT rdy_ena_nox "OBD Readiness Status Enabled 7" UBYTE Compu_rdy_ena_nox 0 0 0 255 ECU_ADDRESS 0x0100EC00 /end MEASUREMENT
/begin COMPU_METHOD Compu_rdy_ena_nox " " RAT_FUNC "%.0" "-" COEFFS 0 1 0 0 0 1 /end COMPU_METHOD
/begin MEASUREMENT rdy_ena_evap "OBD Readiness Status Enabled 8" UBYTE Compu_rdy_ena_evap 0 0 0 255 ECU_ADDRESS 0x0100EC08 /end MEASUREMENT
/begin COMPU_METHOD Compu_rdy_ena_evap " " RAT_FUNC "%.0" "-" COEFFS 0 1 0 0 0 1 /end COMPU_METHOD
/begin MEASUREMENT rdy_ena_sec_air "OBD Readiness Status Enabled 9" UBYTE Compu_rdy_ena_sec_air 0 0 0 255 ECU_ADDRESS 0x0100EC10 /end MEASUREMENT
/begin COMPU_METHOD Compu_rdy_ena_sec_air " " RAT_FUNC "%.0" "-" COEFFS 0 1 0 0 0 1 /end COMPU_METHOD
/begin MEASUREMENT rdy_ena_boost "OBD Readiness Status Enabled 10" UBYTE Compu_rdy_ena_boost 0 0 0 255 ECU_ADDRESS 0x0100EC18 /end MEASUREMENT
/begin COMPU_METHOD Compu_rdy_ena_boost " " RAT_FUNC "%.0" "-" COEFFS 0 1 0 0 0 1 /end COMPU_METHOD
/begin MEASUREMENT rdy_ena_o2 "OBD Readiness Status Enabled 11" UBYTE Compu_rdy_ena_o2 0 0 0 255 ECU_ADDRESS 0x0100EC20 /end MEASUREMENT
/begin COMPU_METHOD Compu_rdy_ena_o2 " " RAT_FUNC "%.0" "-" COEFFS 0 1 0 0 0 1 /end COMPU_METHOD
/begin MEASUREMENT rdy_ena_exhaust_gas "OBD Readiness Status Enabled 12" UBYTE Compu_rdy_ena_exhaust_gas 0 0 0 255 ECU_ADDRESS 0x0100EC28 /end MEASUREMENT
/begin COMPU_METHOD Compu_rdy_ena_exhaust_gas " " RAT_FUNC "%.0" "-" COEFFS 0 1 0 0 0 1 /end COMPU_METHOD
/begin MEASUREMENT rdy_ena_o2_heater "OBD Readiness Status Enabled 13" UBYTE Compu_rdy_ena_o2_heater 0 0 0 255 ECU_ADDRESS 0x0100EC30 /end MEASUREMENT
/begin COMPU_METHOD Compu_rdy_ena_o2_heater " " RAT_FUNC "%.0" "-" COEFFS 0 1 0 0 0 1 /end COMPU_METHOD
/begin MEASUREMENT rdy_ena_pm_filter "OBD Readiness Status Enabled 14" UBYTE Compu_rdy_ena_pm_filter 0 0 0 255 ECU_ADDRESS 0x0100EC38 /end MEASUREMENT
/begin COMPU_METHOD Compu_rdy_ena_pm_filter " " RAT_FUNC "%.0" "-" COEFFS 0 1 0 0 0 1 /end COMPU_METHOD
/begin MEASUREMENT rdy_ena_egr_vvt "OBD Readiness Status Enabled 15" UBYTE Compu_rdy_ena_egr_vvt 0 0 0 255 ECU_ADDRESS 0x0100EC40 /end MEASUREMENT
/begin COMPU_METHOD Compu_rdy_ena_egr_vvt " " RAT_FUNC "%.0" "-" COEFFS 0 1 0 0 0 1 /end COMPU_METHOD
/begin MEASUREMENT rdy_com_misfire "OBD Readiness Status Complete 1" UBYTE Compu_rdy_com_misfire 0 0 0 255 ECU_ADDRESS 0x0100EC50 /end MEASUREMENT
/begin COMPU_METHOD Compu_rdy_com_misfire " " RAT_FUNC "%.0" "-" COEFFS 0 1 0 0 0 1 /end COMPU_METHOD
/begin MEASUREMENT rdy_com_fuel "OBD Readiness Status Complete 2" UBYTE Compu_rdy_com_fuel 0 0 0 255 ECU_ADDRESS 0x0100EC58 /end MEASUREMENT
/begin COMPU_METHOD Compu_rdy_com_fuel " " RAT_FUNC "%.0" "-" COEFFS 0 1 0 0 0 1 /end COMPU_METHOD
/begin MEASUREMENT rdy_com_compcomp "OBD Readiness Status Complete 3" UBYTE Compu_rdy_com_compcomp 0 0 0 255 ECU_ADDRESS 0x0100EC60 /end MEASUREMENT
/begin COMPU_METHOD Compu_rdy_com_compcomp " " RAT_FUNC "%.0" "-" COEFFS 0 1 0 0 0 1 /end COMPU_METHOD
/begin MEASUREMENT rdy_com_cat "OBD Readiness Status Complete 4" UBYTE Compu_rdy_com_cat 0 0 0 255 ECU_ADDRESS 0x0100EC68 /end MEASUREMENT
/begin COMPU_METHOD Compu_rdy_com_cat " " RAT_FUNC "%.0" "-" COEFFS 0 1 0 0 0 1 /end COMPU_METHOD
/begin MEASUREMENT rdy_com_nmhc_cat "OBD Readiness Status Complete 5" UBYTE Compu_rdy_com_nmhc_cat 0 0 0 255 ECU_ADDRESS 0x0100EC70 /end MEASUREMENT
/begin COMPU_METHOD Compu_rdy_com_nmhc_cat " " RAT_FUNC "%.0" "-" COEFFS 0 1 0 0 0 1 /end COMPU_METHOD
/begin MEASUREMENT rdy_com_heated_cat "OBD Readiness Status Complete 6" UBYTE Compu_rdy_com_heated_cat 0 0 0 255 ECU_ADDRESS 0x0100EC78 /end MEASUREMENT
/begin COMPU_METHOD Compu_rdy_com_heated_cat " " RAT_FUNC "%.0" "-" COEFFS 0 1 0 0 0 1 /end COMPU_METHOD
/begin MEASUREMENT rdy_com_nox "OBD Readiness Status Complete 7" UBYTE Compu_rdy_com_nox 0 0 0 255 ECU_ADDRESS 0x0100EC80 /end MEASUREMENT
/begin COMPU_METHOD Compu_rdy_com_nox " " RAT_FUNC "%.0" "-" COEFFS 0 1 0 0 0 1 /end COMPU_METHOD
/begin MEASUREMENT rdy_com_evap "OBD Readiness Status Complete 8" UBYTE Compu_rdy_com_evap 0 0 0 255 ECU_ADDRESS 0x0100EC88 /end MEASUREMENT
/begin COMPU_METHOD Compu_rdy_com_evap " " RAT_FUNC "%.0" "-" COEFFS 0 1 0 0 0 1 /end COMPU_METHOD
/begin MEASUREMENT rdy_com_sec_air "OBD Readiness Status Complete 9" UBYTE Compu_rdy_com_sec_air 0 0 0 255 ECU_ADDRESS 0x0100EC90 /end MEASUREMENT
/begin COMPU_METHOD Compu_rdy_com_sec_air " " RAT_FUNC "%.0" "-" COEFFS 0 1 0 0 0 1 /end COMPU_METHOD
/begin MEASUREMENT rdy_com_boost "OBD Readiness Status Complete 10" UBYTE Compu_rdy_com_boost 0 0 0 255 ECU_ADDRESS 0x0100EC98 /end MEASUREMENT
/begin COMPU_METHOD Compu_rdy_com_boost " " RAT_FUNC "%.0" "-" COEFFS 0 1 0 0 0 1 /end COMPU_METHOD
/begin MEASUREMENT rdy_com_o2 "OBD Readiness Status Complete 11" UBYTE Compu_rdy_com_o2 0 0 0 255 ECU_ADDRESS 0x0100ECA0 /end MEASUREMENT
/begin COMPU_METHOD Compu_rdy_com_o2 " " RAT_FUNC "%.0" "-" COEFFS 0 1 0 0 0 1 /end COMPU_METHOD
/begin MEASUREMENT rdy_com_exhaust_gas "OBD Readiness Status Complete 12" UBYTE Compu_rdy_com_exhaust_gas 0 0 0 255 ECU_ADDRESS 0x0100ECA8 /end MEASUREMENT
/begin COMPU_METHOD Compu_rdy_com_exhaust_gas " " RAT_FUNC "%.0" "-" COEFFS 0 1 0 0 0 1 /end COMPU_METHOD
/begin MEASUREMENT rdy_com_o2_heater "OBD Readiness Status Complete 13" UBYTE Compu_rdy_com_o2_heater 0 0 0 255 ECU_ADDRESS 0x0100ECB0 /end MEASUREMENT
/begin COMPU_METHOD Compu_rdy_com_o2_heater " " RAT_FUNC "%.0" "-" COEFFS 0 1 0 0 0 1 /end COMPU_METHOD
/begin MEASUREMENT rdy_com_pm_filter "OBD Readiness Status Complete 14" UBYTE Compu_rdy_com_pm_filter 0 0 0 255 ECU_ADDRESS 0x0100ECB8 /end MEASUREMENT
/begin COMPU_METHOD Compu_rdy_com_pm_filter " " RAT_FUNC "%.0" "-" COEFFS 0 1 0 0 0 1 /end COMPU_METHOD
/begin MEASUREMENT rdy_com_egr_vvt "OBD Readiness Status Complete 15" UBYTE Compu_rdy_com_egr_vvt 0 0 0 255 ECU_ADDRESS 0x0100ECC0 /end MEASUREMENT
/begin COMPU_METHOD Compu_rdy_com_egr_vvt " " RAT_FUNC "%.0" "-" COEFFS 0 1 0 0 0 1 /end COMPU_METHOD
/begin MEASUREMENT iupr_sup_sec_air "IUPR Supported 6" UBYTE Compu_iupr_sup_sec_air 0 0 0 255 ECU_ADDRESS 0x0100ECF8 /end MEASUREMENT
/begin COMPU_METHOD Compu_iupr_sup_sec_air " " RAT_FUNC "%.0" "-" COEFFS 0 1 0 0 0 1 /end COMPU_METHOD
/begin MEASUREMENT iupr_sup_evap "IUPR Supported 7" UBYTE Compu_iupr_sup_evap 0 0 0 255 ECU_ADDRESS 0x0100ED00 /end MEASUREMENT
/begin COMPU_METHOD Compu_iupr_sup_evap " " RAT_FUNC "%.0" "-" COEFFS 0 1 0 0 0 1 /end COMPU_METHOD
/begin MEASUREMENT iupr_sup_nmhc_cat "IUPR Supported 10" UBYTE Compu_iupr_sup_nmhc_cat 0 0 0 255 ECU_ADDRESS 0x0100ED18 /end MEASUREMENT
/begin COMPU_METHOD Compu_iupr_sup_nmhc_cat " " RAT_FUNC "%.0" "-" COEFFS 0 1 0 0 0 1 /end COMPU_METHOD
/begin MEASUREMENT iupr_sup_nox_scr_cat "IUPR Supported 11" UBYTE Compu_iupr_sup_nox_scr_cat 0 0 0 255 ECU_ADDRESS 0x0100ED20 /end MEASUREMENT
/begin COMPU_METHOD Compu_iupr_sup_nox_scr_cat " " RAT_FUNC "%.0" "-" COEFFS 0 1 0 0 0 1 /end COMPU_METHOD
/begin MEASUREMENT iupr_sup_nox_adsorb "IUPR Supported 12" UBYTE Compu_iupr_sup_nox_adsorb 0 0 0 255 ECU_ADDRESS 0x0100ED28 /end MEASUREMENT
/begin COMPU_METHOD Compu_iupr_sup_nox_adsorb " " RAT_FUNC "%.0" "-" COEFFS 0 1 0 0 0 1 /end COMPU_METHOD
/begin MEASUREMENT iupr_sup_pm_filter "IUPR Supported 13" UBYTE Compu_iupr_sup_pm_filter 0 0 0 255 ECU_ADDRESS 0x0100ED30 /end MEASUREMENT
/begin COMPU_METHOD Compu_iupr_sup_pm_filter " " RAT_FUNC "%.0" "-" COEFFS 0 1 0 0 0 1 /end COMPU_METHOD
/begin MEASUREMENT iupr_sup_exhaust_gas "IUPR Supported 14" UBYTE Compu_iupr_sup_exhaust_gas 0 0 0 255 ECU_ADDRESS 0x0100ED38 /end MEASUREMENT
/begin COMPU_METHOD Compu_iupr_sup_exhaust_gas " " RAT_FUNC "%.0" "-" COEFFS 0 1 0 0 0 1 /end COMPU_METHOD
/begin MEASUREMENT iupr_sup_fuel "IUPR Supported 16" UBYTE Compu_iupr_sup_fuel 0 0 0 255 ECU_ADDRESS 0x0100ED48 /end MEASUREMENT
/begin COMPU_METHOD Compu_iupr_sup_fuel " " RAT_FUNC "%.0" "-" COEFFS 0 1 0 0 0 1 /end COMPU_METHOD
/begin MEASUREMENT iupr_num_sec_air "IUPR Numerator 6" UWORD Compu_iupr_num_sec_air 0 0 0 65535 ECU_ADDRESS 0x0100ED78 /end MEASUREMENT
/begin COMPU_METHOD Compu_iupr_num_sec_air " " RAT_FUNC "%.0" "-" COEFFS 0 1 0 0 0 1 /end COMPU_METHOD
/begin MEASUREMENT iupr_num_evap "IUPR Numerator 7" UWORD Compu_iupr_num_evap 0 0 0 65535 ECU_ADDRESS 0x0100ED80 /end MEASUREMENT
/begin COMPU_METHOD Compu_iupr_num_evap " " RAT_FUNC "%.0" "-" COEFFS 0 1 0 0 0 1 /end COMPU_METHOD
/begin MEASUREMENT iupr_num_nmhc_cat "IUPR Numerator 10" UWORD Compu_iupr_num_nmhc_cat 0 0 0 65535 ECU_ADDRESS 0x0100ED98 /end MEASUREMENT
/begin COMPU_METHOD Compu_iupr_num_nmhc_cat " " RAT_FUNC "%.0" "-" COEFFS 0 1 0 0 0 1 /end COMPU_METHOD
/begin MEASUREMENT iupr_num_nox_scr_cat "IUPR Numerator 11" UWORD Compu_iupr_num_nox_scr_cat 0 0 0 65535 ECU_ADDRESS 0x0100EDA0 /end MEASUREMENT
/begin COMPU_METHOD Compu_iupr_num_nox_scr_cat " " RAT_FUNC "%.0" "-" COEFFS 0 1 0 0 0 1 /end COMPU_METHOD
/begin MEASUREMENT iupr_num_nox_adsorb "IUPR Numerator 12" UWORD Compu_iupr_num_nox_adsorb 0 0 0 65535 ECU_ADDRESS 0x0100EDA8 /end MEASUREMENT
/begin COMPU_METHOD Compu_iupr_num_nox_adsorb " " RAT_FUNC "%.0" "-" COEFFS 0 1 0 0 0 1 /end COMPU_METHOD
/begin MEASUREMENT iupr_num_pm_filter "IUPR Numerator 13" UWORD Compu_iupr_num_pm_filter 0 0 0 65535 ECU_ADDRESS 0x0100EDB0 /end MEASUREMENT
/begin COMPU_METHOD Compu_iupr_num_pm_filter " " RAT_FUNC "%.0" "-" COEFFS 0 1 0 0 0 1 /end COMPU_METHOD
/begin MEASUREMENT iupr_num_exhaust_gas "IUPR Numerator 14" UWORD Compu_iupr_num_exhaust_gas 0 0 0 65535 ECU_ADDRESS 0x0100EDB8 /end MEASUREMENT
/begin COMPU_METHOD Compu_iupr_num_exhaust_gas " " RAT_FUNC "%.0" "-" COEFFS 0 1 0 0 0 1 /end COMPU_METHOD
/begin MEASUREMENT iupr_num_fuel "IUPR Numerator 16" UWORD Compu_iupr_num_fuel 0 0 0 65535 ECU_ADDRESS 0x0100EDC8 /end MEASUREMENT
/begin COMPU_METHOD Compu_iupr_num_fuel " " RAT_FUNC "%.0" "-" COEFFS 0 1 0 0 0 1 /end COMPU_METHOD
/begin MEASUREMENT iupr_den_sec_air "IUPR Denominator 6" UWORD Compu_iupr_den_sec_air 0 0 0 65535 ECU_ADDRESS 0x0100EDF8 /end MEASUREMENT
/begin COMPU_METHOD Compu_iupr_den_sec_air " " RAT_FUNC "%.0" "-" COEFFS 0 1 0 0 0 1 /end COMPU_METHOD
/begin MEASUREMENT iupr_den_evap "IUPR Denominator 7" UWORD Compu_iupr_den_evap 0 0 0 65535 ECU_ADDRESS 0x0100EE00 /end MEASUREMENT
/begin COMPU_METHOD Compu_iupr_den_evap " " RAT_FUNC "%.0" "-" COEFFS 0 1 0 0 0 1 /end COMPU_METHOD
/begin MEASUREMENT iupr_den_nmhc_cat "IUPR Denominator 10" UWORD Compu_iupr_den_nmhc_cat 0 0 0 65535 ECU_ADDRESS 0x0100EE18 /end MEASUREMENT
/begin COMPU_METHOD Compu_iupr_den_nmhc_cat " " RAT_FUNC "%.0" "-" COEFFS 0 1 0 0 0 1 /end COMPU_METHOD
/begin MEASUREMENT iupr_den_nox_scr_cat "IUPR Denominator 11" UWORD Compu_iupr_den_nox_scr_cat 0 0 0 65535 ECU_ADDRESS 0x0100EE20 /end MEASUREMENT
/begin COMPU_METHOD Compu_iupr_den_nox_scr_cat " " RAT_FUNC "%.0" "-" COEFFS 0 1 0 0 0 1 /end COMPU_METHOD
/begin MEASUREMENT iupr_den_nox_adsorb "IUPR Denominator 12" UWORD Compu_iupr_den_nox_adsorb 0 0 0 65535 ECU_ADDRESS 0x0100EE28 /end MEASUREMENT
/begin COMPU_METHOD Compu_iupr_den_nox_adsorb " " RAT_FUNC "%.0" "-" COEFFS 0 1 0 0 0 1 /end COMPU_METHOD
/begin MEASUREMENT iupr_den_pm_filter "IUPR Denominator 13" UWORD Compu_iupr_den_pm_filter 0 0 0 65535 ECU_ADDRESS 0x0100EE30 /end MEASUREMENT
/begin COMPU_METHOD Compu_iupr_den_pm_filter " " RAT_FUNC "%.0" "-" COEFFS 0 1 0 0 0 1 /end COMPU_METHOD
/begin MEASUREMENT iupr_den_exhaust_gas "IUPR Denominator 14" UWORD Compu_iupr_den_exhaust_gas 0 0 0 65535 ECU_ADDRESS 0x0100EE38 /end MEASUREMENT
/begin COMPU_METHOD Compu_iupr_den_exhaust_gas " " RAT_FUNC "%.0" "-" COEFFS 0 1 0 0 0 1 /end COMPU_METHOD
/begin MEASUREMENT iupr_den_fuel "IUPR Denominator 16" UWORD Compu_iupr_den_fuel 0 0 0 65535 ECU_ADDRESS 0x0100EE48 /end MEASUREMENT
/begin COMPU_METHOD Compu_iupr_den_fuel " " RAT_FUNC "%.0" "-" COEFFS 0 1 0 0 0 1 /end COMPU_METHOD
/begin MEASUREMENT FSF2_GD_FAULT "Gen denom invalid cond{FSF2_GD_FAULT&0x40=0x00:GD conditions valid}{FSF2_GD_FAULT&0x40=0x40:GD conditions invalid}" UBYTE FSF2_GD_FAULT_COMPU_VTAB 0 0 0 255 ECU_ADDRESS 0x0100EE60 BIT_MASK 0x40 /end MEASUREMENT
/begin COMPU_METHOD FSF2_GD_FAULT_COMPU_VTAB "Verbal Table" TAB_VERB "%.0" "list" COMPU_TAB_REF FSF2_GD_FAULT_COMPU_VTAB_REF /end COMPU_METHOD
/begin COMPU_VTAB FSF2_GD_FAULT_COMPU_VTAB_REF "Verbal Table" TAB_VERB 2 0x00 "GD conditions valid" 0x40 "GD conditions invalid" DEFAULT_VALUE "UNKNOWN" /end COMPU_VTAB
/begin MEASUREMENT FltStartMaxa "Cycles before clear actual" UBYTE Compu_FltStartMaxa 0 0 0 255 ECU_ADDRESS 0x0100EE68 /end MEASUREMENT
/begin COMPU_METHOD Compu_FltStartMaxa " " RAT_FUNC "%.0" "-" COEFFS 0 1 0 0 0 1 /end COMPU_METHOD
/begin MEASUREMENT fm_ac_cyc_typea "Cycle type actual{fm_ac_cyc_typea&0xff=0:Engine cycle}{fm_ac_cyc_typea&0xff=1:Warm-up cycle}" UBYTE fm_ac_cyc_typea_COMPU_VTAB 0 0 0 255 ECU_ADDRESS 0x0100EE70 BIT_MASK 0xff /end MEASUREMENT
/begin COMPU_METHOD fm_ac_cyc_typea_COMPU_VTAB "Verbal Table" TAB_VERB "%.0" "list" COMPU_TAB_REF fm_ac_cyc_typea_COMPU_VTAB_REF /end COMPU_METHOD
/begin COMPU_VTAB fm_ac_cyc_typea_COMPU_VTAB_REF "Verbal Table" TAB_VERB 2 0 "Engine cycle" 1 "Warm-up cycle" DEFAULT_VALUE "UNKNOWN" /end COMPU_VTAB
/begin MEASUREMENT MIL_start_cnt_mina "MIL min persist actual" UWORD Compu_MIL_start_cnt_mina 0 0 0 65535 ECU_ADDRESS 0x0100EE78 /end MEASUREMENT
/begin COMPU_METHOD Compu_MIL_start_cnt_mina " " RAT_FUNC "%.0" "cycles" COEFFS 0 1 0 0 0 1 /end COMPU_METHOD
/begin MEASUREMENT fault_store_EEa "Fault retention actual{fault_store_EEa&0xff=0:Battery}{fault_store_EEa&0xff=1:Permanent}" UBYTE fault_store_EEa_COMPU_VTAB 0 0 0 255 ECU_ADDRESS 0x0100EE80 BIT_MASK 0xff /end MEASUREMENT
/begin COMPU_METHOD fault_store_EEa_COMPU_VTAB "Verbal Table" TAB_VERB "%.0" "list" COMPU_TAB_REF fault_store_EEa_COMPU_VTAB_REF /end COMPU_METHOD
/begin COMPU_VTAB fault_store_EEa_COMPU_VTAB_REF "Verbal Table" TAB_VERB 2 0 "Battery" 1 "Permanent" DEFAULT_VALUE "UNKNOWN" /end COMPU_VTAB
/begin MEASUREMENT fm_oper_cyc_counter "Operation cycle counter" UWORD Compu_fm_oper_cyc_counter 0 0 0 65535 ECU_ADDRESS 0x0100FC68 /end MEASUREMENT
/begin COMPU_METHOD Compu_fm_oper_cyc_counter " " RAT_FUNC "%.0" "cycles" COEFFS 0 1 0 0 0 1 /end COMPU_METHOD
/begin MEASUREMENT fm_drive_cyc_tmr "Drive cycle timer" UWORD Compu_fm_drive_cyc_tmr 0 0 0 18.2041666666667 ECU_ADDRESS 0x0100FC70 /end MEASUREMENT
/begin COMPU_METHOD Compu_fm_drive_cyc_tmr " " RAT_FUNC "%.2" "hours" COEFFS 0 3600 0 0 0 1 /end COMPU_METHOD
/begin MEASUREMENT fm_pending_cycle_act "Pending cycle type actual{fm_pending_cycle_act&0xff=0:Key cycle}{fm_pending_cycle_act&0xff=1:Operation cycle}" UBYTE fm_pending_cycle_act_COMPU_VTAB 0 0 0 255 ECU_ADDRESS 0x0100FC80 BIT_MASK 0xff /end MEASUREMENT
/begin COMPU_METHOD fm_pending_cycle_act_COMPU_VTAB "Verbal Table" TAB_VERB "%.0" "list" COMPU_TAB_REF fm_pending_cycle_act_COMPU_VTAB_REF /end COMPU_METHOD
/begin COMPU_VTAB fm_pending_cycle_act_COMPU_VTAB_REF "Verbal Table" TAB_VERB 2 0 "Key cycle" 1 "Operation cycle" DEFAULT_VALUE "UNKNOWN" /end COMPU_VTAB
/begin CHARACTERISTIC fm_induce_ena "Inducement System{fm_induce_ena&0xff=0:Disabled}{fm_induce_ena&0xff=1:Enabled}" VALUE 0x001c9027 /* @ECU_Address@fm_induce_ena@0x01010E50@ */ ECIPP_ALIGNMENT_UBYTE 255 fm_induce_ena_COMPU_VTAB 0 255 BIT_MASK 0xff /end CHARACTERISTIC
/begin COMPU_METHOD fm_induce_ena_COMPU_VTAB "Verbal Table" TAB_VERB "%.0" "list" COMPU_TAB_REF fm_induce_ena_COMPU_VTAB_REF /end COMPU_METHOD
/begin COMPU_VTAB fm_induce_ena_COMPU_VTAB_REF "Verbal Table" TAB_VERB 2 0 "Disabled" 1 "Enabled" DEFAULT_VALUE "UNKNOWN" /end COMPU_VTAB
/begin MEASUREMENT fm_induce_derate "Derate{fm_induce_derate&0x0f=0:Inactive}{fm_induce_derate&0x0f=1:Level 1 Low-Level}{fm_induce_derate&0x0f=2:Level 2}{fm_induce_derate&0x0f=4:Level 3 Severe}{fm_induce_derate&0x0f=5:Level 1 & 3}" UBYTE fm_induce_derate_COMPU_VTAB 0 0 0 255 ECU_ADDRESS 0x01010E68 BIT_MASK 0x0f /end MEASUREMENT
/begin COMPU_METHOD fm_induce_derate_COMPU_VTAB "Verbal Table" TAB_VERB "%.0" "list" COMPU_TAB_REF fm_induce_derate_COMPU_VTAB_REF /end COMPU_METHOD
/begin COMPU_VTAB fm_induce_derate_COMPU_VTAB_REF "Verbal Table" TAB_VERB 5 0 "Inactive" 1 "Level 1 Low-Level" 2 "Level 2" 4 "Level 3 Severe" 5 "Level 1 & 3" DEFAULT_VALUE "UNKNOWN" /end COMPU_VTAB
/begin MEASUREMENT fm_induce_state "State{fm_induce_state&0xff=0:Disabled}{fm_induce_state&0xff=1:Key/Engine Off}{fm_induce_state&0xff=2:Faults inactive}{fm_induce_state&0xff=3:36-hr count down}{fm_induce_state&0xff=4:Faults active}{fm_induce_state&0xff=5:Level 1 requested}{fm_induce_state&" UBYTE fm_induce_state_COMPU_VTAB 0 0 0 255 ECU_ADDRESS 0x01010E70 BIT_MASK 0xff /end MEASUREMENT
/begin COMPU_METHOD fm_induce_state_COMPU_VTAB "Verbal Table" TAB_VERB "%.0" "list" COMPU_TAB_REF fm_induce_state_COMPU_VTAB_REF /end COMPU_METHOD
/begin COMPU_VTAB fm_induce_state_COMPU_VTAB_REF "Verbal Table" TAB_VERB 13 0 "Disabled" 1 "Key/Engine Off" 2 "Faults inactive" 3 "36-hr count down" 4 "Faults active" 5 "Level 1 requested" 6 "Level 1 wait" 7 "Level 1 active" 8 "Level 3 requested" 9 "Level 3 wait" 10 "Level 3 active" 11 "Level 3 active - RS fault" 12 "Level 3 enabled" DEFAULT_VALUE "UNKNOWN" /end COMPU_VTAB
/begin MEASUREMENT fm_induce_l3_tmr "Continuous Operation" ULONG Compu_fm_induce_l3_tmr 0 0 0 1193046.47083333 ECU_ADDRESS 0x01010E78 /end MEASUREMENT
/begin COMPU_METHOD Compu_fm_induce_l3_tmr " " RAT_FUNC "%.3" "hours" COEFFS 0 3600 0 0 0 1 /end COMPU_METHOD
/begin MEASUREMENT fm_induce_up_EGR "EGR Impeded fault timer" ULONG Compu_fm_induce_up_EGR 0 0 0 1193046.47083333 ECU_ADDRESS 0x01010E80 /end MEASUREMENT
/begin COMPU_METHOD Compu_fm_induce_up_EGR " " RAT_FUNC "%.3" "hours" COEFFS 0 3600 0 0 0 1 /end COMPU_METHOD
/begin MEASUREMENT fm_induce_up_Mon "Monitor System fault timer" ULONG Compu_fm_induce_up_Mon 0 0 0 1193046.47083333 ECU_ADDRESS 0x01010E88 /end MEASUREMENT
/begin COMPU_METHOD Compu_fm_induce_up_Mon " " RAT_FUNC "%.3" "hours" COEFFS 0 3600 0 0 0 1 /end COMPU_METHOD
/begin MEASUREMENT fm_induce_dn_EGR "EGR Impeded clear timer" ULONG Compu_fm_induce_dn_EGR 0 0 0 1193046.47083333 ECU_ADDRESS 0x01010E90 /end MEASUREMENT
/begin COMPU_METHOD Compu_fm_induce_dn_EGR " " RAT_FUNC "%.3" "hours" COEFFS 0 3600 0 0 0 1 /end COMPU_METHOD
/begin MEASUREMENT fm_induce_dn_Mon "Monitor System clear timer" ULONG Compu_fm_induce_dn_Mon 0 0 0 1193046.47083333 ECU_ADDRESS 0x01010E98 /end MEASUREMENT
/begin COMPU_METHOD Compu_fm_induce_dn_Mon " " RAT_FUNC "%.3" "hours" COEFFS 0 3600 0 0 0 1 /end COMPU_METHOD
/begin CHARACTERISTIC fm_induce_actv_chan "Warning output{fm_induce_actv_chan&0xff=0:Disabled}{fm_induce_actv_chan&0xff=1:Aux PWM1}{fm_induce_actv_chan&0xff=2:Aux PWM2}{fm_induce_actv_chan&0xff=3:Aux PWM3}{fm_induce_actv_chan&0xff=4:Aux PWM4}{fm_induce_actv_chan&0xff=5:Aux PWM5}{fm_induce_actv_cha" VALUE 0x001c9026 /* @ECU_Address@fm_induce_actv_chan@0x01010EB8@ */ ECIPP_ALIGNMENT_UBYTE 255 fm_induce_actv_chan_COMPU_VTAB 0 255 BIT_MASK 0xff /end CHARACTERISTIC
/begin COMPU_METHOD fm_induce_actv_chan_COMPU_VTAB "Verbal Table" TAB_VERB "%.0" "list" COMPU_TAB_REF fm_induce_actv_chan_COMPU_VTAB_REF /end COMPU_METHOD
/begin COMPU_VTAB fm_induce_actv_chan_COMPU_VTAB_REF "Verbal Table" TAB_VERB 16 0 "Disabled" 1 "Aux PWM1" 2 "Aux PWM2" 3 "Aux PWM3" 4 "Aux PWM4" 5 "Aux PWM5" 6 "Aux PWM6" 7 "Aux PWM7" 8 "Aux PWM8" 9 "Aux PWM9" 10 "Aux PWM10" 11 "Aux PWM11" 12 "Aux PWM12" 13 "Aux PWM13" 14 "Aux PWM14" 15 "Aux PWM15" DEFAULT_VALUE "UNKNOWN" /end COMPU_VTAB
/begin CHARACTERISTIC INDUCE_lamp "Network lamp{INDUCE_lamp&0xff=0:Disabled}{INDUCE_lamp&0xff=1:Amber Warning Lamp}{INDUCE_lamp&0xff=2:Red Stop Lamp}{INDUCE_lamp&0xff=3:Protect Lamp}" VALUE 0x001c8784 /* @ECU_Address@INDUCE_lamp@0x01011B78@ */ ECIPP_ALIGNMENT_UBYTE 255 INDUCE_lamp_COMPU_VTAB 0 255 BIT_MASK 0xff /end CHARACTERISTIC
/begin COMPU_METHOD INDUCE_lamp_COMPU_VTAB "Verbal Table" TAB_VERB "%.0" "list" COMPU_TAB_REF INDUCE_lamp_COMPU_VTAB_REF /end COMPU_METHOD
/begin COMPU_VTAB INDUCE_lamp_COMPU_VTAB_REF "Verbal Table" TAB_VERB 4 0 "Disabled" 1 "Amber Warning Lamp" 2 "Red Stop Lamp" 3 "Protect Lamp" DEFAULT_VALUE "UNKNOWN" /end COMPU_VTAB
/begin MEASUREMENT CFV_mdot_choke "CFV after-start fuel enrichment" UWORD Compu_CFV_mdot_choke 0 0 0 1023.984375 ECU_ADDRESS 0x01011FB8 /end MEASUREMENT
/begin COMPU_METHOD Compu_CFV_mdot_choke " " RAT_FUNC "%.2" "g/sec" COEFFS 0 64 0 0 0 1 /end COMPU_METHOD
/begin CHARACTERISTIC fm_operation_cycle "Operation cycle type{fm_operation_cycle&0xff=0:Engine cycle}{fm_operation_cycle&0xff=1:4-hour drive cycle}{fm_operation_cycle&0xff=2:Key cycle}" VALUE 0x001c902c /* @ECU_Address@fm_operation_cycle@0x01012280@ */ ECIPP_ALIGNMENT_UBYTE 255 fm_operation_cycle_COMPU_VTAB 0 255 BIT_MASK 0xff /end CHARACTERISTIC
/begin COMPU_METHOD fm_operation_cycle_COMPU_VTAB "Verbal Table" TAB_VERB "%.0" "list" COMPU_TAB_REF fm_operation_cycle_COMPU_VTAB_REF /end COMPU_METHOD
/begin COMPU_VTAB fm_operation_cycle_COMPU_VTAB_REF "Verbal Table" TAB_VERB 3 0 "Engine cycle" 1 "4-hour drive cycle" 2 "Key cycle" DEFAULT_VALUE "UNKNOWN" /end COMPU_VTAB
/begin CHARACTERISTIC fm_gd_oper_req_env "Cumulative oper reqs env cond{fm_gd_oper_req_env&0xff=0:No}{fm_gd_oper_req_env&0xff=1:Yes}" VALUE 0x001c9022 /* @ECU_Address@fm_gd_oper_req_env@0x01012288@ */ ECIPP_ALIGNMENT_UBYTE 255 fm_gd_oper_req_env_COMPU_VTAB 0 255 BIT_MASK 0xff /end CHARACTERISTIC
/begin COMPU_METHOD fm_gd_oper_req_env_COMPU_VTAB "Verbal Table" TAB_VERB "%.0" "list" COMPU_TAB_REF fm_gd_oper_req_env_COMPU_VTAB_REF /end COMPU_METHOD
/begin COMPU_VTAB fm_gd_oper_req_env_COMPU_VTAB_REF "Verbal Table" TAB_VERB 2 0 "No" 1 "Yes" DEFAULT_VALUE "UNKNOWN" /end COMPU_VTAB
/begin CHARACTERISTIC fm_gd_idle_req_env "Continuous idle reqs env cond{fm_gd_idle_req_env&0xff=0:No}{fm_gd_idle_req_env&0xff=1:Yes}" VALUE 0x001c9020 /* @ECU_Address@fm_gd_idle_req_env@0x01012290@ */ ECIPP_ALIGNMENT_UBYTE 255 fm_gd_idle_req_env_COMPU_VTAB 0 255 BIT_MASK 0xff /end CHARACTERISTIC
/begin COMPU_METHOD fm_gd_idle_req_env_COMPU_VTAB "Verbal Table" TAB_VERB "%.0" "list" COMPU_TAB_REF fm_gd_idle_req_env_COMPU_VTAB_REF /end COMPU_METHOD
/begin COMPU_VTAB fm_gd_idle_req_env_COMPU_VTAB_REF "Verbal Table" TAB_VERB 2 0 "No" 1 "Yes" DEFAULT_VALUE "UNKNOWN" /end COMPU_VTAB
/begin CHARACTERISTIC fm_gd_oper_rs_ena "Cumulative oper uses roadspeed{fm_gd_oper_rs_ena&0xff=0:No}{fm_gd_oper_rs_ena&0xff=1:Yes}" VALUE 0x001c9024 /* @ECU_Address@fm_gd_oper_rs_ena@0x01012298@ */ ECIPP_ALIGNMENT_UBYTE 255 fm_gd_oper_rs_ena_COMPU_VTAB 0 255 BIT_MASK 0xff /end CHARACTERISTIC
/begin COMPU_METHOD fm_gd_oper_rs_ena_COMPU_VTAB "Verbal Table" TAB_VERB "%.0" "list" COMPU_TAB_REF fm_gd_oper_rs_ena_COMPU_VTAB_REF /end COMPU_METHOD
/begin COMPU_VTAB fm_gd_oper_rs_ena_COMPU_VTAB_REF "Verbal Table" TAB_VERB 2 0 "No" 1 "Yes" DEFAULT_VALUE "UNKNOWN" /end COMPU_VTAB
/begin CHARACTERISTIC fm_gd_oper_rpm_ena "Cumulative oper uses RPM{fm_gd_oper_rpm_ena&0xff=0:No}{fm_gd_oper_rpm_ena&0xff=1:Yes}" VALUE 0x001c9023 /* @ECU_Address@fm_gd_oper_rpm_ena@0x010122A0@ */ ECIPP_ALIGNMENT_UBYTE 255 fm_gd_oper_rpm_ena_COMPU_VTAB 0 255 BIT_MASK 0xff /end CHARACTERISTIC
/begin COMPU_METHOD fm_gd_oper_rpm_ena_COMPU_VTAB "Verbal Table" TAB_VERB "%.0" "list" COMPU_TAB_REF fm_gd_oper_rpm_ena_COMPU_VTAB_REF /end COMPU_METHOD
/begin COMPU_VTAB fm_gd_oper_rpm_ena_COMPU_VTAB_REF "Verbal Table" TAB_VERB 2 0 "No" 1 "Yes" DEFAULT_VALUE "UNKNOWN" /end COMPU_VTAB
/begin CHARACTERISTIC fm_gd_oper_load_ena "Cumulative oper uses load{fm_gd_oper_load_ena&0xff=0:No}{fm_gd_oper_load_ena&0xff=1:Yes}" VALUE 0x001c9021 /* @ECU_Address@fm_gd_oper_load_ena@0x010122A8@ */ ECIPP_ALIGNMENT_UBYTE 255 fm_gd_oper_load_ena_COMPU_VTAB 0 255 BIT_MASK 0xff /end CHARACTERISTIC
/begin COMPU_METHOD fm_gd_oper_load_ena_COMPU_VTAB "Verbal Table" TAB_VERB "%.0" "list" COMPU_TAB_REF fm_gd_oper_load_ena_COMPU_VTAB_REF /end COMPU_METHOD
/begin COMPU_VTAB fm_gd_oper_load_ena_COMPU_VTAB_REF "Verbal Table" TAB_VERB 2 0 "No" 1 "Yes" DEFAULT_VALUE "UNKNOWN" /end COMPU_VTAB
/begin CHARACTERISTIC gen_den_idle_src "Idle determination source{gen_den_idle_src&0xff=0:Automatic}{gen_den_idle_src&0xff=1:EEC2 FPP1}" VALUE 0x001c903f /* @ECU_Address@gen_den_idle_src@0x01012528@ */ ECIPP_ALIGNMENT_UBYTE 255 gen_den_idle_src_COMPU_VTAB 0 255 BIT_MASK 0xff /end CHARACTERISTIC
/begin COMPU_METHOD gen_den_idle_src_COMPU_VTAB "Verbal Table" TAB_VERB "%.0" "list" COMPU_TAB_REF gen_den_idle_src_COMPU_VTAB_REF /end COMPU_METHOD
/begin COMPU_VTAB gen_den_idle_src_COMPU_VTAB_REF "Verbal Table" TAB_VERB 2 0 "Automatic" 1 "EEC2 FPP1" DEFAULT_VALUE "UNKNOWN" /end COMPU_VTAB
/begin CHARACTERISTIC fm_op_reset_key_on "Reset op. cycle at key on{fm_op_reset_key_on&0xff=0:No}{fm_op_reset_key_on&0xff=1:Every key-on}{fm_op_reset_key_on&0xff=2:After engine stop}" VALUE 0x001c902b /* @ECU_Address@fm_op_reset_key_on@0x01012558@ */ ECIPP_ALIGNMENT_UBYTE 255 fm_op_reset_key_on_COMPU_VTAB 0 255 BIT_MASK 0xff /end CHARACTERISTIC
/begin COMPU_METHOD fm_op_reset_key_on_COMPU_VTAB "Verbal Table" TAB_VERB "%.0" "list" COMPU_TAB_REF fm_op_reset_key_on_COMPU_VTAB_REF /end COMPU_METHOD
/begin COMPU_VTAB fm_op_reset_key_on_COMPU_VTAB_REF "Verbal Table" TAB_VERB 3 0 "No" 1 "Every key-on" 2 "After engine stop" DEFAULT_VALUE "UNKNOWN" /end COMPU_VTAB
/begin MEASUREMENT OCT_learning "Octane rating learning active{OCT_learning&0xff=0:NO}{OCT_learning&0xff=1:YES}" UBYTE OCT_learning_COMPU_VTAB 0 0 0 255 ECU_ADDRESS 0x01012610 BIT_MASK 0xff /end MEASUREMENT
/begin COMPU_METHOD OCT_learning_COMPU_VTAB "Verbal Table" TAB_VERB "%.0" "list" COMPU_TAB_REF OCT_learning_COMPU_VTAB_REF /end COMPU_METHOD
/begin COMPU_VTAB OCT_learning_COMPU_VTAB_REF "Verbal Table" TAB_VERB 2 0 "NO" 1 "YES" DEFAULT_VALUE "UNKNOWN" /end COMPU_VTAB
/begin CHARACTERISTIC fm_hybrid_mode "Hybrid fault mode{fm_hybrid_mode&0xff=0:Disabled}{fm_hybrid_mode&0xff=1:Enabled}" VALUE 0x001c9025 /* @ECU_Address@fm_hybrid_mode@0x01012B28@ */ ECIPP_ALIGNMENT_UBYTE 255 fm_hybrid_mode_COMPU_VTAB 0 255 BIT_MASK 0xff /end CHARACTERISTIC
/begin COMPU_METHOD fm_hybrid_mode_COMPU_VTAB "Verbal Table" TAB_VERB "%.0" "list" COMPU_TAB_REF fm_hybrid_mode_COMPU_VTAB_REF /end COMPU_METHOD
/begin COMPU_VTAB fm_hybrid_mode_COMPU_VTAB_REF "Verbal Table" TAB_VERB 2 0 "Disabled" 1 "Enabled" DEFAULT_VALUE "UNKNOWN" /end COMPU_VTAB
/begin MEASUREMENT fm_clr_mode "Fault clearing mode{fm_clr_mode&0xff=0:Normal}{fm_clr_mode&0xff=1:Paused during remote stop}" UBYTE fm_clr_mode_COMPU_VTAB 0 0 0 255 ECU_ADDRESS 0x01012B30 BIT_MASK 0xff /end MEASUREMENT
/begin COMPU_METHOD fm_clr_mode_COMPU_VTAB "Verbal Table" TAB_VERB "%.0" "list" COMPU_TAB_REF fm_clr_mode_COMPU_VTAB_REF /end COMPU_METHOD
/begin COMPU_VTAB fm_clr_mode_COMPU_VTAB_REF "Verbal Table" TAB_VERB 2 0 "Normal" 1 "Paused during remote stop" DEFAULT_VALUE "UNKNOWN" /end COMPU_VTAB
/begin CHARACTERISTIC FltStartMaxPnd "Cycles before clear desired" VALUE 0x001e6dd8 /* @ECU_Address@FltStartMaxPnd@0x01012B40@ */ ECIPP_ALIGNMENT_UBYTE 255 Compu_FltStartMaxPnd 0 255 /end CHARACTERISTIC
/begin COMPU_METHOD Compu_FltStartMaxPnd " " RAT_FUNC "%.0" "cycles" COEFFS 0 1 0 0 0 1 /end COMPU_METHOD
/begin MEASUREMENT FltStartMaxPnda "Cycles before clear actual" UBYTE Compu_FltStartMaxPnda 0 0 0 255 ECU_ADDRESS 0x01012B48 /end MEASUREMENT
/begin COMPU_METHOD Compu_FltStartMaxPnda " " RAT_FUNC "%.0" "-" COEFFS 0 1 0 0 0 1 /end COMPU_METHOD
/begin CHARACTERISTIC PTO_vehspd_min "PTO vehicle speed minimum" VALUE 0x001c7e68 /* @ECU_Address@PTO_vehspd_min@0x01012C30@ */ ECIPP_ALIGNMENT_UWORD 256 Compu_PTO_vehspd_min 0 255.99609375 /end CHARACTERISTIC
/begin COMPU_METHOD Compu_PTO_vehspd_min " " RAT_FUNC "%.1" "kph" COEFFS 0 256 0 0 0 1 /end COMPU_METHOD
/begin CHARACTERISTIC PTOd_enable_mode "PTOd control configuration{PTOd_enable_mode&0xff=0:Enable input}{PTOd_enable_mode&0xff=1:Always enabled}{PTOd_enable_mode&0xff=2:J1939 PTO}" VALUE 0x001c88a4 /* @ECU_Address@PTOd_enable_mode@0x01012C38@ */ ECIPP_ALIGNMENT_UBYTE 255 PTOd_enable_mode_COMPU_VTAB 0 255 BIT_MASK 0xff /end CHARACTERISTIC
/begin COMPU_METHOD PTOd_enable_mode_COMPU_VTAB "Verbal Table" TAB_VERB "%.0" "list" COMPU_TAB_REF PTOd_enable_mode_COMPU_VTAB_REF /end COMPU_METHOD
/begin COMPU_VTAB PTOd_enable_mode_COMPU_VTAB_REF "Verbal Table" TAB_VERB 3 0 "Enable input" 1 "Always enabled" 2 "J1939 PTO" DEFAULT_VALUE "UNKNOWN" /end COMPU_VTAB
/begin CHARACTERISTIC PTOd_btn_rls_tout "PTOd button release timeout" VALUE 0x001c7e6a /* @ECU_Address@PTOd_btn_rls_tout@0x01012C40@ */ ECIPP_ALIGNMENT_UWORD 65535 Compu_PTOd_btn_rls_tout 0 65535 /end CHARACTERISTIC
/begin COMPU_METHOD Compu_PTOd_btn_rls_tout " " RAT_FUNC "%.0" "ms" COEFFS 0 1 0 0 0 1 /end COMPU_METHOD
/begin CHARACTERISTIC PTOd_disable_2inputs "PTOd disabled by multiple inputs{PTOd_disable_2inputs&0xff=0:Disabled}{PTOd_disable_2inputs&0xff=1:Enabled}" VALUE 0x001c88a2 /* @ECU_Address@PTOd_disable_2inputs@0x01012C48@ */ ECIPP_ALIGNMENT_UBYTE 255 PTOd_disable_2inputs_COMPU_VTAB 0 255 BIT_MASK 0xff /end CHARACTERISTIC
/begin COMPU_METHOD PTOd_disable_2inputs_COMPU_VTAB "Verbal Table" TAB_VERB "%.0" "list" COMPU_TAB_REF PTOd_disable_2inputs_COMPU_VTAB_REF /end COMPU_METHOD
/begin COMPU_VTAB PTOd_disable_2inputs_COMPU_VTAB_REF "Verbal Table" TAB_VERB 2 0 "Disabled" 1 "Enabled" DEFAULT_VALUE "UNKNOWN" /end COMPU_VTAB
/begin CHARACTERISTIC PTOd_rpm_init "PTOd initial engine speed" VALUE 0x001c7e74 /* @ECU_Address@PTOd_rpm_init@0x01012CC8@ */ ECIPP_ALIGNMENT_UWORD 65535 Compu_PTOd_rpm_init 0 65535 /end CHARACTERISTIC
/begin COMPU_METHOD Compu_PTOd_rpm_init " " RAT_FUNC "%.0" "rpm" COEFFS 0 1 0 0 0 1 /end COMPU_METHOD
/begin CHARACTERISTIC PTO_rpm_dz "PTO engine speed deadzone" VALUE 0x001c7e60 /* @ECU_Address@PTO_rpm_dz@0x01012CD0@ */ ECIPP_ALIGNMENT_UWORD 65535 Compu_PTO_rpm_dz 0 65535 /end CHARACTERISTIC
/begin COMPU_METHOD Compu_PTO_rpm_dz " " RAT_FUNC "%.0" "rpm" COEFFS 0 1 0 0 0 1 /end COMPU_METHOD
/begin MEASUREMENT INDUCEout_mirror "Inducement warning output pin{INDUCEout_mirror&0x01=0x00:Off}{INDUCEout_mirror&0x01=0x01:On}" UBYTE INDUCEout_mirror_COMPU_VTAB 0 0 0 255 ECU_ADDRESS 0x01012EC8 BIT_MASK 0x01 /end MEASUREMENT
/begin COMPU_METHOD INDUCEout_mirror_COMPU_VTAB "Verbal Table" TAB_VERB "%.0" "list" COMPU_TAB_REF INDUCEout_mirror_COMPU_VTAB_REF /end COMPU_METHOD
/begin COMPU_VTAB INDUCEout_mirror_COMPU_VTAB_REF "Verbal Table" TAB_VERB 2 0x00 "Off" 0x01 "On" DEFAULT_VALUE "UNKNOWN" /end COMPU_VTAB
/begin MEASUREMENT EGR_stuckvlv_tot_cnt "Stuck EGR valve diagnostic occurrence count" UWORD Compu_EGR_stuckvlv_tot_cnt 0 0 0 65535 ECU_ADDRESS 0x01012F30 /end MEASUREMENT
/begin COMPU_METHOD Compu_EGR_stuckvlv_tot_cnt " " RAT_FUNC "%.0" "-" COEFFS 0 1 0 0 0 1 /end COMPU_METHOD
/begin CHARACTERISTIC tech_SNPN_write_ena "Technician write access{tech_SNPN_write_ena&0xff=0:Not allowed}{tech_SNPN_write_ena&0xff=1:Allowed}" VALUE 0x001eccad /* @ECU_Address@tech_SNPN_write_ena@0x01012F50@ */ ECIPP_ALIGNMENT_UBYTE 255 tech_SNPN_write_ena_COMPU_VTAB 0 255 BIT_MASK 0xff /end CHARACTERISTIC
/begin COMPU_METHOD tech_SNPN_write_ena_COMPU_VTAB "Verbal Table" TAB_VERB "%.0" "list" COMPU_TAB_REF tech_SNPN_write_ena_COMPU_VTAB_REF /end COMPU_METHOD
/begin COMPU_VTAB tech_SNPN_write_ena_COMPU_VTAB_REF "Verbal Table" TAB_VERB 2 0 "Not allowed" 1 "Allowed" DEFAULT_VALUE "UNKNOWN" /end COMPU_VTAB
/begin MEASUREMENT tech_SNPN_write_key "Write trigger" UWORD Compu_tech_SNPN_write_key 0 0 0 65535 ECU_ADDRESS 0x01012F58 /end MEASUREMENT
/begin COMPU_METHOD Compu_tech_SNPN_write_key " " RAT_FUNC "%.0" "-" COEFFS 0 1 0 0 0 1 /end COMPU_METHOD
/begin MEASUREMENT TWCmod_OSC_reset "Reset OSC correction{TWCmod_OSC_reset&0xff=0:Inactive}{TWCmod_OSC_reset&0xff=1:Resetting...}" UBYTE TWCmod_OSC_reset_COMPU_VTAB 0 0 0 255 ECU_ADDRESS 0x010138B8 BIT_MASK 0xff /end MEASUREMENT
/begin COMPU_METHOD TWCmod_OSC_reset_COMPU_VTAB "Verbal Table" TAB_VERB "%.0" "list" COMPU_TAB_REF TWCmod_OSC_reset_COMPU_VTAB_REF /end COMPU_METHOD
/begin COMPU_VTAB TWCmod_OSC_reset_COMPU_VTAB_REF "Verbal Table" TAB_VERB 2 0 "Inactive" 1 "Resetting..." DEFAULT_VALUE "UNKNOWN" /end COMPU_VTAB
/begin CHARACTERISTIC fm_pending_cycle "Pending cycle type desired{fm_pending_cycle&0xff=0:Key cycle}{fm_pending_cycle&0xff=1:Operation cycle}" VALUE 0x001c902d /* @ECU_Address@fm_pending_cycle@0x01014350@ */ ECIPP_ALIGNMENT_UBYTE 255 fm_pending_cycle_COMPU_VTAB 0 255 BIT_MASK 0xff /end CHARACTERISTIC
/begin COMPU_METHOD fm_pending_cycle_COMPU_VTAB "Verbal Table" TAB_VERB "%.0" "list" COMPU_TAB_REF fm_pending_cycle_COMPU_VTAB_REF /end COMPU_METHOD
/begin COMPU_VTAB fm_pending_cycle_COMPU_VTAB_REF "Verbal Table" TAB_VERB 2 0 "Key cycle" 1 "Operation cycle" DEFAULT_VALUE "UNKNOWN" /end COMPU_VTAB
/begin CHARACTERISTIC TSSC_ena "Transmission shift shock control mode{TSSC_ena&0xff=0:Disabled}{TSSC_ena&0xff=1:Enabled - SPN 64898}{TSSC_ena&0xff=2:Enabled - SPN 64762}" VALUE 0x001c8f59 /* @ECU_Address@TSSC_ena@0x01014368@ */ ECIPP_ALIGNMENT_UBYTE 255 TSSC_ena_COMPU_VTAB 0 255 BIT_MASK 0xff /end CHARACTERISTIC
/begin COMPU_METHOD TSSC_ena_COMPU_VTAB "Verbal Table" TAB_VERB "%.0" "list" COMPU_TAB_REF TSSC_ena_COMPU_VTAB_REF /end COMPU_METHOD
/begin COMPU_VTAB TSSC_ena_COMPU_VTAB_REF "Verbal Table" TAB_VERB 3 0 "Disabled" 1 "Enabled - SPN 64898" 2 "Enabled - SPN 64762" DEFAULT_VALUE "UNKNOWN" /end COMPU_VTAB
/begin CHARACTERISTIC TSSC_up_dur "Upshift duration" VALUE 0x001c81e6 /* @ECU_Address@TSSC_up_dur@0x01014370@ */ ECIPP_ALIGNMENT_UWORD 65535 Compu_TSSC_up_dur 0 65535 /end CHARACTERISTIC
/begin COMPU_METHOD Compu_TSSC_up_dur " " RAT_FUNC "%.0" "ms" COEFFS 0 1 0 0 0 1 /end COMPU_METHOD
/begin CHARACTERISTIC TSSC_up_delta_rpm "Upshift speed reduction" VALUE 0x001c81e2 /* @ECU_Address@TSSC_up_delta_rpm@0x01014378@ */ ECIPP_ALIGNMENT_UWORD 65535 Compu_TSSC_up_delta_rpm 0 65535 /end CHARACTERISTIC
/begin COMPU_METHOD Compu_TSSC_up_delta_rpm " " RAT_FUNC "%.0" "rpm" COEFFS 0 1 0 0 0 1 /end COMPU_METHOD
/begin CHARACTERISTIC TSSC_up_min_rpm "Upshift speed minimum" VALUE 0x001c81e8 /* @ECU_Address@TSSC_up_min_rpm@0x01014380@ */ ECIPP_ALIGNMENT_UWORD 65535 Compu_TSSC_up_min_rpm 0 65535 /end CHARACTERISTIC
/begin COMPU_METHOD Compu_TSSC_up_min_rpm " " RAT_FUNC "%.0" "rpm" COEFFS 0 1 0 0 0 1 /end COMPU_METHOD
/begin CHARACTERISTIC TSSC_up_down_rpmdt "Upshift speed slew down rate" VALUE 0x001c81e4 /* @ECU_Address@TSSC_up_down_rpmdt@0x01014388@ */ ECIPP_ALIGNMENT_UWORD 127998 Compu_TSSC_up_down_rpmdt 0 127998.046875 /end CHARACTERISTIC
/begin COMPU_METHOD Compu_TSSC_up_down_rpmdt " " RAT_FUNC "%.0" "rpm/sec" COEFFS 0 0.512 0 0 0 1 /end COMPU_METHOD
/begin CHARACTERISTIC TSSC_up_up_rpmdt "Upshift speed slew up rate" VALUE 0x001c81ea /* @ECU_Address@TSSC_up_up_rpmdt@0x01014390@ */ ECIPP_ALIGNMENT_UWORD 127998 Compu_TSSC_up_up_rpmdt 0 127998.046875 /end CHARACTERISTIC
/begin COMPU_METHOD Compu_TSSC_up_up_rpmdt " " RAT_FUNC "%.0" "rpm/sec" COEFFS 0 0.512 0 0 0 1 /end COMPU_METHOD
/begin CHARACTERISTIC TSSC_up_RS_Iacc_rst "Upshift roadspeed integrator reset" VALUE 0x001c5998 /* @ECU_Address@TSSC_up_RS_Iacc_rst@0x01014398@ */ ECIPP_ALIGNMENT_SWORD 800 Compu_TSSC_up_RS_Iacc_rst -800 799.9755859375 /end CHARACTERISTIC
/begin COMPU_METHOD Compu_TSSC_up_RS_Iacc_rst " " RAT_FUNC "%.1" "%" COEFFS 0 40.96 0 0 0 1 /end COMPU_METHOD
/begin CHARACTERISTIC TSSC_sw_RS_lmt "Switchback roadspeed limit" VALUE 0x001c81d6 /* @ECU_Address@TSSC_sw_RS_lmt@0x010143A0@ */ ECIPP_ALIGNMENT_UWORD 256 Compu_TSSC_sw_RS_lmt 0 255.99609375 /end CHARACTERISTIC
/begin COMPU_METHOD Compu_TSSC_sw_RS_lmt " " RAT_FUNC "%.1" "km/hr" COEFFS 0 256 0 0 0 1 /end COMPU_METHOD
/begin CHARACTERISTIC TSSC_sw_RS_delay "Switchback exit delay" VALUE 0x001c81d4 /* @ECU_Address@TSSC_sw_RS_delay@0x010143A8@ */ ECIPP_ALIGNMENT_UWORD 65535 Compu_TSSC_sw_RS_delay 0 65535 /end CHARACTERISTIC
/begin COMPU_METHOD Compu_TSSC_sw_RS_delay " " RAT_FUNC "%.0" "ms" COEFFS 0 1 0 0 0 1 /end COMPU_METHOD
/begin CHARACTERISTIC TSSC_sw_delta_rpm "Switchback speed reduction" VALUE 0x001c81d8 /* @ECU_Address@TSSC_sw_delta_rpm@0x010143B0@ */ ECIPP_ALIGNMENT_UWORD 65535 Compu_TSSC_sw_delta_rpm 0 65535 /end CHARACTERISTIC
/begin COMPU_METHOD Compu_TSSC_sw_delta_rpm " " RAT_FUNC "%.0" "rpm" COEFFS 0 1 0 0 0 1 /end COMPU_METHOD
/begin CHARACTERISTIC TSSC_sw_min_rpm "Switchback speed minimum" VALUE 0x001c81dc /* @ECU_Address@TSSC_sw_min_rpm@0x010143B8@ */ ECIPP_ALIGNMENT_UWORD 65535 Compu_TSSC_sw_min_rpm 0 65535 /end CHARACTERISTIC
/begin COMPU_METHOD Compu_TSSC_sw_min_rpm " " RAT_FUNC "%.0" "rpm" COEFFS 0 1 0 0 0 1 /end COMPU_METHOD
/begin CHARACTERISTIC TSSC_sw_down_rpmdt "Switchback speed slew down rate" VALUE 0x001c81da /* @ECU_Address@TSSC_sw_down_rpmdt@0x010143C0@ */ ECIPP_ALIGNMENT_UWORD 127998 Compu_TSSC_sw_down_rpmdt 0 127998.046875 /end CHARACTERISTIC
/begin COMPU_METHOD Compu_TSSC_sw_down_rpmdt " " RAT_FUNC "%.0" "rpm/sec" COEFFS 0 0.512 0 0 0 1 /end COMPU_METHOD
/begin CHARACTERISTIC TSSC_sw_up_rpmdt "Switchback speed slew up rate" VALUE 0x001c81e0 /* @ECU_Address@TSSC_sw_up_rpmdt@0x010143C8@ */ ECIPP_ALIGNMENT_UWORD 127998 Compu_TSSC_sw_up_rpmdt 0 127998.046875 /end CHARACTERISTIC
/begin COMPU_METHOD Compu_TSSC_sw_up_rpmdt " " RAT_FUNC "%.0" "rpm/sec" COEFFS 0 0.512 0 0 0 1 /end COMPU_METHOD
/begin MEASUREMENT TSSC_gear_d "Transmission shift shock desired gear{TSSC_gear_d&0xff=128:Not Available}{TSSC_gear_d&0xff=129:Error}{TSSC_gear_d&0xff=254:Reverse 2}{TSSC_gear_d&0xff=255:Reverse 1}{TSSC_gear_d&0xff=0:Neutral}{TSSC_gear_d&0xff=1:Forward 1}{TSSC_gear_d&0xff=2:Forward 2}" UBYTE TSSC_gear_d_COMPU_VTAB 0 0 0 255 ECU_ADDRESS 0x010143D0 BIT_MASK 0xff /end MEASUREMENT
/begin COMPU_METHOD TSSC_gear_d_COMPU_VTAB "Verbal Table" TAB_VERB "%.0" "list" COMPU_TAB_REF TSSC_gear_d_COMPU_VTAB_REF /end COMPU_METHOD
/begin COMPU_VTAB TSSC_gear_d_COMPU_VTAB_REF "Verbal Table" TAB_VERB 7 128 "Not Available" 129 "Error" 254 "Reverse 2" 255 "Reverse 1" 0 "Neutral" 1 "Forward 1" 2 "Forward 2" DEFAULT_VALUE "UNKNOWN" /end COMPU_VTAB
/begin MEASUREMENT TSSC_rpm_max "Transmission shift shock max speed" UWORD Compu_TSSC_rpm_max 0 0 0 65535 ECU_ADDRESS 0x010143D8 /end MEASUREMENT
/begin COMPU_METHOD Compu_TSSC_rpm_max " " RAT_FUNC "%.0" "rpm" COEFFS 0 1 0 0 0 1 /end COMPU_METHOD
/begin MEASUREMENT TSSC_rpm_min "Transmission shift shock min speed" UWORD Compu_TSSC_rpm_min 0 0 0 65535 ECU_ADDRESS 0x010143E0 /end MEASUREMENT
/begin COMPU_METHOD Compu_TSSC_rpm_min " " RAT_FUNC "%.0" "rpm" COEFFS 0 1 0 0 0 1 /end COMPU_METHOD
/begin MEASUREMENT MIL_persist_tmr "MIL persist" UWORD Compu_MIL_persist_tmr 0 0 0 65.535 ECU_ADDRESS 0x01014718 /end MEASUREMENT
/begin COMPU_METHOD Compu_MIL_persist_tmr " " RAT_FUNC "%.2" "seconds" COEFFS 0 1000 0 0 0 1 /end COMPU_METHOD
/begin MEASUREMENT MIL_start_cnt "MIL persist count" UWORD Compu_MIL_start_cnt 0 0 0 65535 ECU_ADDRESS 0x01014720 /end MEASUREMENT
/begin COMPU_METHOD Compu_MIL_start_cnt " " RAT_FUNC "%.0" "cycles" COEFFS 0 1 0 0 0 1 /end COMPU_METHOD
/begin MEASUREMENT IdleTrim_ena_sw_stat "Idle Trim activation switch input status{IdleTrim_ena_sw_stat&0xff=0:Not Active}{IdleTrim_ena_sw_stat&0xff=1:Active}{IdleTrim_ena_sw_stat&0xff=2:Error/Fault}{IdleTrim_ena_sw_stat&0xff=3:Not Configured}" UBYTE IdleTrim_ena_sw_stat_COMPU_VTAB 0 0 0 255 ECU_ADDRESS 0x01014950 BIT_MASK 0xff /end MEASUREMENT
/begin COMPU_METHOD IdleTrim_ena_sw_stat_COMPU_VTAB "Verbal Table" TAB_VERB "%.0" "list" COMPU_TAB_REF IdleTrim_ena_sw_stat_COMPU_VTAB_REF /end COMPU_METHOD
/begin COMPU_VTAB IdleTrim_ena_sw_stat_COMPU_VTAB_REF "Verbal Table" TAB_VERB 4 0 "Not Active" 1 "Active" 2 "Error/Fault" 3 "Not Configured" DEFAULT_VALUE "UNKNOWN" /end COMPU_VTAB
/begin MEASUREMENT IdleTrim_inc_sw_stat "Idle Trim increment switch input status{IdleTrim_inc_sw_stat&0xff=0:Not Active}{IdleTrim_inc_sw_stat&0xff=1:Active}{IdleTrim_inc_sw_stat&0xff=2:Error/Fault}{IdleTrim_inc_sw_stat&0xff=3:Not Configured}" UBYTE IdleTrim_inc_sw_stat_COMPU_VTAB 0 0 0 255 ECU_ADDRESS 0x01014958 BIT_MASK 0xff /end MEASUREMENT
/begin COMPU_METHOD IdleTrim_inc_sw_stat_COMPU_VTAB "Verbal Table" TAB_VERB "%.0" "list" COMPU_TAB_REF IdleTrim_inc_sw_stat_COMPU_VTAB_REF /end COMPU_METHOD
/begin COMPU_VTAB IdleTrim_inc_sw_stat_COMPU_VTAB_REF "Verbal Table" TAB_VERB 4 0 "Not Active" 1 "Active" 2 "Error/Fault" 3 "Not Configured" DEFAULT_VALUE "UNKNOWN" /end COMPU_VTAB
/begin MEASUREMENT IdleTrim_dec_sw_stat "Idle Trim decrement switch input status{IdleTrim_dec_sw_stat&0xff=0:Not Active}{IdleTrim_dec_sw_stat&0xff=1:Active}{IdleTrim_dec_sw_stat&0xff=2:Error/Fault}{IdleTrim_dec_sw_stat&0xff=3:Not Configured}" UBYTE IdleTrim_dec_sw_stat_COMPU_VTAB 0 0 0 255 ECU_ADDRESS 0x01014960 BIT_MASK 0xff /end MEASUREMENT
/begin COMPU_METHOD IdleTrim_dec_sw_stat_COMPU_VTAB "Verbal Table" TAB_VERB "%.0" "list" COMPU_TAB_REF IdleTrim_dec_sw_stat_COMPU_VTAB_REF /end COMPU_METHOD
/begin COMPU_VTAB IdleTrim_dec_sw_stat_COMPU_VTAB_REF "Verbal Table" TAB_VERB 4 0 "Not Active" 1 "Active" 2 "Error/Fault" 3 "Not Configured" DEFAULT_VALUE "UNKNOWN" /end COMPU_VTAB
/begin MEASUREMENT PTOd_ena_sw_stat "Discrete PTO enable switch input status{PTOd_ena_sw_stat&0xff=0:Not Active}{PTOd_ena_sw_stat&0xff=1:Active}{PTOd_ena_sw_stat&0xff=2:Error/Fault}{PTOd_ena_sw_stat&0xff=3:Not Configured}" UBYTE PTOd_ena_sw_stat_COMPU_VTAB 0 0 0 255 ECU_ADDRESS 0x01014968 BIT_MASK 0xff /end MEASUREMENT
/begin COMPU_METHOD PTOd_ena_sw_stat_COMPU_VTAB "Verbal Table" TAB_VERB "%.0" "list" COMPU_TAB_REF PTOd_ena_sw_stat_COMPU_VTAB_REF /end COMPU_METHOD
/begin COMPU_VTAB PTOd_ena_sw_stat_COMPU_VTAB_REF "Verbal Table" TAB_VERB 4 0 "Not Active" 1 "Active" 2 "Error/Fault" 3 "Not Configured" DEFAULT_VALUE "UNKNOWN" /end COMPU_VTAB
/begin MEASUREMENT PTOd_dis_sw_stat "Discrete PTO disable switch input status{PTOd_dis_sw_stat&0xff=0:Not Active}{PTOd_dis_sw_stat&0xff=1:Active}{PTOd_dis_sw_stat&0xff=2:Error/Fault}{PTOd_dis_sw_stat&0xff=3:Not Configured}" UBYTE PTOd_dis_sw_stat_COMPU_VTAB 0 0 0 255 ECU_ADDRESS 0x01014970 BIT_MASK 0xff /end MEASUREMENT
/begin COMPU_METHOD PTOd_dis_sw_stat_COMPU_VTAB "Verbal Table" TAB_VERB "%.0" "list" COMPU_TAB_REF PTOd_dis_sw_stat_COMPU_VTAB_REF /end COMPU_METHOD
/begin COMPU_VTAB PTOd_dis_sw_stat_COMPU_VTAB_REF "Verbal Table" TAB_VERB 4 0 "Not Active" 1 "Active" 2 "Error/Fault" 3 "Not Configured" DEFAULT_VALUE "UNKNOWN" /end COMPU_VTAB
/begin MEASUREMENT PTOd_setinc_sw_stat "Discrete PTO set/increment switch input status{PTOd_setinc_sw_stat&0xff=0:Not Active}{PTOd_setinc_sw_stat&0xff=1:Active}{PTOd_setinc_sw_stat&0xff=2:Error/Fault}{PTOd_setinc_sw_stat&0xff=3:Not Configured}" UBYTE PTOd_setinc_sw_stat_COMPU_VTAB 0 0 0 255 ECU_ADDRESS 0x01014978 BIT_MASK 0xff /end MEASUREMENT
/begin COMPU_METHOD PTOd_setinc_sw_stat_COMPU_VTAB "Verbal Table" TAB_VERB "%.0" "list" COMPU_TAB_REF PTOd_setinc_sw_stat_COMPU_VTAB_REF /end COMPU_METHOD
/begin COMPU_VTAB PTOd_setinc_sw_stat_COMPU_VTAB_REF "Verbal Table" TAB_VERB 4 0 "Not Active" 1 "Active" 2 "Error/Fault" 3 "Not Configured" DEFAULT_VALUE "UNKNOWN" /end COMPU_VTAB
/begin MEASUREMENT PTOd_resdec_sw_stat "Discrete PTO resume/decrement switch input status{PTOd_resdec_sw_stat&0xff=0:Not Active}{PTOd_resdec_sw_stat&0xff=1:Active}{PTOd_resdec_sw_stat&0xff=2:Error/Fault}{PTOd_resdec_sw_stat&0xff=3:Not Configured}" UBYTE PTOd_resdec_sw_stat_COMPU_VTAB 0 0 0 255 ECU_ADDRESS 0x01014980 BIT_MASK 0xff /end MEASUREMENT
/begin COMPU_METHOD PTOd_resdec_sw_stat_COMPU_VTAB "Verbal Table" TAB_VERB "%.0" "list" COMPU_TAB_REF PTOd_resdec_sw_stat_COMPU_VTAB_REF /end COMPU_METHOD
/begin COMPU_VTAB PTOd_resdec_sw_stat_COMPU_VTAB_REF "Verbal Table" TAB_VERB 4 0 "Not Active" 1 "Active" 2 "Error/Fault" 3 "Not Configured" DEFAULT_VALUE "UNKNOWN" /end COMPU_VTAB
/begin MEASUREMENT PTOp_ena_sw_stat "Proportional PTO enable switch input status{PTOp_ena_sw_stat&0xff=0:Not Active}{PTOp_ena_sw_stat&0xff=1:Active}{PTOp_ena_sw_stat&0xff=2:Error/Fault}{PTOp_ena_sw_stat&0xff=3:Not Configured}" UBYTE PTOp_ena_sw_stat_COMPU_VTAB 0 0 0 255 ECU_ADDRESS 0x01014988 BIT_MASK 0xff /end MEASUREMENT
/begin COMPU_METHOD PTOp_ena_sw_stat_COMPU_VTAB "Verbal Table" TAB_VERB "%.0" "list" COMPU_TAB_REF PTOp_ena_sw_stat_COMPU_VTAB_REF /end COMPU_METHOD
/begin COMPU_VTAB PTOp_ena_sw_stat_COMPU_VTAB_REF "Verbal Table" TAB_VERB 4 0 "Not Active" 1 "Active" 2 "Error/Fault" 3 "Not Configured" DEFAULT_VALUE "UNKNOWN" /end COMPU_VTAB
/begin MEASUREMENT gov_type_engaged "Engaged governor type{gov_type_engaged&0xff=0x00:None}{gov_type_engaged&0xff=0x01:Gov1}{gov_type_engaged&0xff=0x02:Gov2}{gov_type_engaged&0xff=0x03:Gov3}{gov_type_engaged&0xff=0x04:Min}{gov_type_engaged&0xff=0x05:Max}" UBYTE gov_type_engaged_COMPU_VTAB 0 0 0 255 ECU_ADDRESS 0x01015098 BIT_MASK 0xff /end MEASUREMENT
/begin COMPU_METHOD gov_type_engaged_COMPU_VTAB "Verbal Table" TAB_VERB "%.0" "list" COMPU_TAB_REF gov_type_engaged_COMPU_VTAB_REF /end COMPU_METHOD
/begin COMPU_VTAB gov_type_engaged_COMPU_VTAB_REF "Verbal Table" TAB_VERB 6 0x00 "None" 0x01 "Gov1" 0x02 "Gov2" 0x03 "Gov3" 0x04 "Min" 0x05 "Max" DEFAULT_VALUE "UNKNOWN" /end COMPU_VTAB
/begin CHARACTERISTIC fm_NOx_derate_table "NOx Control Derate source{fm_NOx_derate_table&0xff=0:Disabled}{fm_NOx_derate_table&0xff=1:Table 1 / Gasoline Load-Limit}{fm_NOx_derate_table&0xff=2:Table 2 / LPG Load-Limit}{fm_NOx_derate_table&0xff=3:Table 3 / NG Load-Limit}{fm_NOx_derate_table&0xff=4:Ta" VALUE 0x001c901c /* @ECU_Address@fm_NOx_derate_table@0x010154F0@ */ ECIPP_ALIGNMENT_UBYTE 255 fm_NOx_derate_table_COMPU_VTAB 0 255 BIT_MASK 0xff /end CHARACTERISTIC
/begin COMPU_METHOD fm_NOx_derate_table_COMPU_VTAB "Verbal Table" TAB_VERB "%.0" "list" COMPU_TAB_REF fm_NOx_derate_table_COMPU_VTAB_REF /end COMPU_METHOD
/begin COMPU_VTAB fm_NOx_derate_table_COMPU_VTAB_REF "Verbal Table" TAB_VERB 9 0 "Disabled" 1 "Table 1 / Gasoline Load-Limit" 2 "Table 2 / LPG Load-Limit" 3 "Table 3 / NG Load-Limit" 4 "Table 4 / Power Load-Limit" 5 "Table 5" 6 "Table 6" 7 "Table 7" 8 "Table 8" DEFAULT_VALUE "UNKNOWN" /end COMPU_VTAB
/begin CHARACTERISTIC fm_NOx_dep_delay "NOx dependency delay" VALUE 0x001c43f4 /* @ECU_Address@fm_NOx_dep_delay@0x01015500@ */ ECIPP_ALIGNMENT_ULONG 1193046 Compu_fm_NOx_dep_delay 0 1193046.47083333 /end CHARACTERISTIC
/begin COMPU_METHOD Compu_fm_NOx_dep_delay " " RAT_FUNC "%.2" "hours" COEFFS 0 3600 0 0 0 1 /end COMPU_METHOD
/begin MEASUREMENT fm_NOx_dep_run_time "NOx dependency run time" ULONG Compu_fm_NOx_dep_run_time 0 0 0 71582788.25 ECU_ADDRESS 0x01015508 /end MEASUREMENT
/begin COMPU_METHOD Compu_fm_NOx_dep_run_time " " RAT_FUNC "%.0" "minutes" COEFFS 0 60 0 0 0 1 /end COMPU_METHOD
/begin CHARACTERISTIC TSSC_sw_LoadLim_pct "Switchback enforced load limit" VALUE 0x001c81d2 /* @ECU_Address@TSSC_sw_LoadLim_pct@0x01015518@ */ ECIPP_ALIGNMENT_UWORD 400 Compu_TSSC_sw_LoadLim_pct 0 399.993896484375 /end CHARACTERISTIC
/begin COMPU_METHOD Compu_TSSC_sw_LoadLim_pct " " RAT_FUNC "%.0" "%" COEFFS 0 163.84 0 0 0 1 /end COMPU_METHOD
/begin CHARACTERISTIC TSSC_sw_up_LoadLimdt "Switchback load slew up rate" VALUE 0x001c81de /* @ECU_Address@TSSC_sw_up_LoadLimdt@0x01015520@ */ ECIPP_ALIGNMENT_UWORD 79999 Compu_TSSC_sw_up_LoadLimdt 0 79998.779296875 /end CHARACTERISTIC
/begin COMPU_METHOD Compu_TSSC_sw_up_LoadLimdt " " RAT_FUNC "%.0" "% / sec" COEFFS 0 0.8192 0 0 0 1 /end COMPU_METHOD
/begin CHARACTERISTIC TSSC_rpm_limit_ena "TSSC speed limit mode{TSSC_rpm_limit_ena&0xff=0:Absolute}{TSSC_rpm_limit_ena&0xff=1:Base Idle Override}" VALUE 0x001c8f5a /* @ECU_Address@TSSC_rpm_limit_ena@0x01015528@ */ ECIPP_ALIGNMENT_UBYTE 255 TSSC_rpm_limit_ena_COMPU_VTAB 0 255 BIT_MASK 0xff /end CHARACTERISTIC
/begin COMPU_METHOD TSSC_rpm_limit_ena_COMPU_VTAB "Verbal Table" TAB_VERB "%.0" "list" COMPU_TAB_REF TSSC_rpm_limit_ena_COMPU_VTAB_REF /end COMPU_METHOD
/begin COMPU_VTAB TSSC_rpm_limit_ena_COMPU_VTAB_REF "Verbal Table" TAB_VERB 2 0 "Absolute" 1 "Base Idle Override" DEFAULT_VALUE "UNKNOWN" /end COMPU_VTAB
/begin COMPU_METHOD Compu_TspdA_rpm_rpm " " RAT_FUNC "%.0" "Speed (rpm)" COEFFS 0 1 0 0 0 1 /end COMPU_METHOD
/begin CHARACTERISTIC TspdA_rpm_Kp "Alt Isochronous Speed Gains" CURVE 0x001C66EC /* @ECU_Address@TspdA_rpm_Kp@0x020A9000@ */ ECIPP_ALIGNMENT_SWORD 3125 Compu_TspdA_rpm_Kp -3125 3124.90463256836
 /begin AXIS_DESCR COM_AXIS NO_INPUT_QUANTITY Compu_TspdA_rpm_rpm 4 -32768 32767 AXIS_PTS_REF TspdA_rpm_rpm /end AXIS_DESCR
/end CHARACTERISTIC
/begin AXIS_PTS TspdA_rpm_rpm " " 0x001C670C /* @ECU_Address@TspdA_rpm_rpm@0x020A8000@ */ NO_INPUT_QUANTITY ECIPP_Lookup_SWORD 0 Compu_TspdA_rpm_rpm 4 -32768 32767 /end AXIS_PTS
/begin COMPU_METHOD Compu_TspdA_rpm_Kp " " RAT_FUNC "%.1" "Kp rpm (%/krpm)" COEFFS 0 10.48576 0 0 0 1 /end COMPU_METHOD
/begin CHARACTERISTIC TspdA_rpm_Kd "Alt Isochronous Speed Gains" CURVE 0x001C66D4 /* @ECU_Address@TspdA_rpm_Kd@0x020AA000@ */ ECIPP_ALIGNMENT_SWORD 1600 Compu_TspdA_rpm_Kd -1600 1599.951171875
 /begin AXIS_DESCR COM_AXIS NO_INPUT_QUANTITY Compu_TspdA_rpm_rpm 4 -32768 32767 AXIS_PTS_REF TspdA_rpm_rpm /end AXIS_DESCR
/end CHARACTERISTIC
/begin COMPU_METHOD Compu_TspdA_rpm_Kd " " RAT_FUNC "%.2" "Kd rpm (%/(krpm/s))" COEFFS 0 20.48 0 0 0 1 /end COMPU_METHOD
/begin CHARACTERISTIC TspdA_rpm_Ki "Alt Isochronous Speed Gains" CURVE 0x001C66DC /* @ECU_Address@TspdA_rpm_Ki@0x020AB000@ */ ECIPP_ALIGNMENT_SWORD 12207 Compu_TspdA_rpm_Ki -12207.03125 12206.6587209702
 /begin AXIS_DESCR COM_AXIS NO_INPUT_QUANTITY Compu_TspdA_rpm_rpm 4 -32768 32767 AXIS_PTS_REF TspdA_rpm_rpm /end AXIS_DESCR
/end CHARACTERISTIC
/begin COMPU_METHOD Compu_TspdA_rpm_Ki " " RAT_FUNC "%.1" "Ki rpm (%/krpm/s)" COEFFS 0 2.68435456 0 0 0 1 /end COMPU_METHOD
/begin CHARACTERISTIC TspdA_rpm_KMAPdt "Alt Isochronous Speed Gains" CURVE 0x001C66C4 /* @ECU_Address@TspdA_rpm_KMAPdt@0x020AC000@ */ ECIPP_ALIGNMENT_SWORD 1000 Compu_TspdA_rpm_KMAPdt -1000 999.969482421875
 /begin AXIS_DESCR COM_AXIS NO_INPUT_QUANTITY Compu_TspdA_rpm_rpm 4 -32768 32767 AXIS_PTS_REF TspdA_rpm_rpm /end AXIS_DESCR
/end CHARACTERISTIC
/begin COMPU_METHOD Compu_TspdA_rpm_KMAPdt " " RAT_FUNC "%.1" "K dMAPdt (1/sec)" COEFFS 0 32.768 0 0 0 1 /end COMPU_METHOD
/begin CHARACTERISTIC TspdA_rpm_KMdtfb "Alt Isochronous Speed Gains" CURVE 0x001C66CC /* @ECU_Address@TspdA_rpm_KMdtfb@0x020AD000@ */ ECIPP_ALIGNMENT_SWORD 32 Compu_TspdA_rpm_KMdtfb -32 31.9990234375
 /begin AXIS_DESCR COM_AXIS NO_INPUT_QUANTITY Compu_TspdA_rpm_rpm 4 -32768 32767 AXIS_PTS_REF TspdA_rpm_rpm /end AXIS_DESCR
/end CHARACTERISTIC
/begin COMPU_METHOD Compu_TspdA_rpm_KMdtfb " " RAT_FUNC "%.3" "K dMAPdt FB (fraction)" COEFFS 0 1024 0 0 0 1 /end COMPU_METHOD
/begin CHARACTERISTIC TspdA_rpm_dzKp "Alt Isochronous Speed Gains" CURVE 0x001C6704 /* @ECU_Address@TspdA_rpm_dzKp@0x020AE000@ */ ECIPP_ALIGNMENT_SWORD 32767 Compu_TspdA_rpm_dzKp -32768 32767
 /begin AXIS_DESCR COM_AXIS NO_INPUT_QUANTITY Compu_TspdA_rpm_rpm 4 -32768 32767 AXIS_PTS_REF TspdA_rpm_rpm /end AXIS_DESCR
/end CHARACTERISTIC
/begin COMPU_METHOD Compu_TspdA_rpm_dzKp " " RAT_FUNC "%.0" "dead-zone (rpm)" COEFFS 0 1 0 0 0 1 /end COMPU_METHOD
/begin CHARACTERISTIC TspdA_rpm_dzKi "Alt Isochronous Speed Gains" CURVE 0x001C66FC /* @ECU_Address@TspdA_rpm_dzKi@0x020AF000@ */ ECIPP_ALIGNMENT_SWORD 32767 Compu_TspdA_rpm_dzKi -32768 32767
 /begin AXIS_DESCR COM_AXIS NO_INPUT_QUANTITY Compu_TspdA_rpm_rpm 4 -32768 32767 AXIS_PTS_REF TspdA_rpm_rpm /end AXIS_DESCR
/end CHARACTERISTIC
/begin COMPU_METHOD Compu_TspdA_rpm_dzKi " " RAT_FUNC "%.0" "dead-zone (rpm)" COEFFS 0 1 0 0 0 1 /end COMPU_METHOD
/begin CHARACTERISTIC TspdA_rpm_dzKd "Alt Isochronous Speed Gains" CURVE 0x001C66F4 /* @ECU_Address@TspdA_rpm_dzKd@0x020B0000@ */ ECIPP_ALIGNMENT_SWORD 63998 Compu_TspdA_rpm_dzKd -64000 63998.046875
 /begin AXIS_DESCR COM_AXIS NO_INPUT_QUANTITY Compu_TspdA_rpm_rpm 4 -32768 32767 AXIS_PTS_REF TspdA_rpm_rpm /end AXIS_DESCR
/end CHARACTERISTIC
/begin COMPU_METHOD Compu_TspdA_rpm_dzKd " " RAT_FUNC "%.0" "dead-zone (rpm/sec)" COEFFS 0 0.512 0 0 0 1 /end COMPU_METHOD
/begin CHARACTERISTIC TspdA_rpm_Ifrz "Alt Isochronous Speed Gains" CURVE 0x001C66BC /* @ECU_Address@TspdA_rpm_Ifrz@0x020B1000@ */ ECIPP_ALIGNMENT_SWORD 63998 Compu_TspdA_rpm_Ifrz -64000 63998.046875
 /begin AXIS_DESCR COM_AXIS NO_INPUT_QUANTITY Compu_TspdA_rpm_rpm 4 -32768 32767 AXIS_PTS_REF TspdA_rpm_rpm /end AXIS_DESCR
/end CHARACTERISTIC
/begin COMPU_METHOD Compu_TspdA_rpm_Ifrz " " RAT_FUNC "%.0" "freeze (rpm/sec)" COEFFS 0 0.512 0 0 0 1 /end COMPU_METHOD
/begin COMPU_METHOD Compu_TdrpA_rpm_rpm " " RAT_FUNC "%.0" "Speed (rpm)" COEFFS 0 1 0 0 0 1 /end COMPU_METHOD
/begin CHARACTERISTIC TdrpA_rpm_Kp "Alt Droop Speed Gains" CURVE 0x001C63A8 /* @ECU_Address@TdrpA_rpm_Kp@0x020B3000@ */ ECIPP_ALIGNMENT_SWORD 3125 Compu_TdrpA_rpm_Kp -3125 3124.90463256836
 /begin AXIS_DESCR COM_AXIS NO_INPUT_QUANTITY Compu_TdrpA_rpm_rpm 4 -32768 32767 AXIS_PTS_REF TdrpA_rpm_rpm /end AXIS_DESCR
/end CHARACTERISTIC
/begin AXIS_PTS TdrpA_rpm_rpm " " 0x001C63C8 /* @ECU_Address@TdrpA_rpm_rpm@0x020B2000@ */ NO_INPUT_QUANTITY ECIPP_Lookup_SWORD 0 Compu_TdrpA_rpm_rpm 4 -32768 32767 /end AXIS_PTS
/begin COMPU_METHOD Compu_TdrpA_rpm_Kp " " RAT_FUNC "%.1" "Kp rpm (%/krpm)" COEFFS 0 10.48576 0 0 0 1 /end COMPU_METHOD
/begin CHARACTERISTIC TdrpA_rpm_Kd "Alt Droop Speed Gains" CURVE 0x001C6390 /* @ECU_Address@TdrpA_rpm_Kd@0x020B4000@ */ ECIPP_ALIGNMENT_SWORD 1600 Compu_TdrpA_rpm_Kd -1600 1599.951171875
 /begin AXIS_DESCR COM_AXIS NO_INPUT_QUANTITY Compu_TdrpA_rpm_rpm 4 -32768 32767 AXIS_PTS_REF TdrpA_rpm_rpm /end AXIS_DESCR
/end CHARACTERISTIC
/begin COMPU_METHOD Compu_TdrpA_rpm_Kd " " RAT_FUNC "%.2" "Kd rpm (%/(krpm/s))" COEFFS 0 20.48 0 0 0 1 /end COMPU_METHOD
/begin CHARACTERISTIC TdrpA_rpm_Ki "Alt Droop Speed Gains" CURVE 0x001C6398 /* @ECU_Address@TdrpA_rpm_Ki@0x020B5000@ */ ECIPP_ALIGNMENT_SWORD 12207 Compu_TdrpA_rpm_Ki -12207.03125 12206.6587209702
 /begin AXIS_DESCR COM_AXIS NO_INPUT_QUANTITY Compu_TdrpA_rpm_rpm 4 -32768 32767 AXIS_PTS_REF TdrpA_rpm_rpm /end AXIS_DESCR
/end CHARACTERISTIC
/begin COMPU_METHOD Compu_TdrpA_rpm_Ki " " RAT_FUNC "%.1" "Ki rpm (%/krpm/s)" COEFFS 0 2.68435456 0 0 0 1 /end COMPU_METHOD
/begin CHARACTERISTIC TdrpA_rpm_KMAPdt "Alt Droop Speed Gains" CURVE 0x001C6380 /* @ECU_Address@TdrpA_rpm_KMAPdt@0x020B6000@ */ ECIPP_ALIGNMENT_SWORD 1000 Compu_TdrpA_rpm_KMAPdt -1000 999.969482421875
 /begin AXIS_DESCR COM_AXIS NO_INPUT_QUANTITY Compu_TdrpA_rpm_rpm 4 -32768 32767 AXIS_PTS_REF TdrpA_rpm_rpm /end AXIS_DESCR
/end CHARACTERISTIC
/begin COMPU_METHOD Compu_TdrpA_rpm_KMAPdt " " RAT_FUNC "%.1" "K dMAPdt (1/sec)" COEFFS 0 32.768 0 0 0 1 /end COMPU_METHOD
/begin CHARACTERISTIC TdrpA_rpm_KMdtfb "Alt Droop Speed Gains" CURVE 0x001C6388 /* @ECU_Address@TdrpA_rpm_KMdtfb@0x020B7000@ */ ECIPP_ALIGNMENT_SWORD 32 Compu_TdrpA_rpm_KMdtfb -32 31.9990234375
 /begin AXIS_DESCR COM_AXIS NO_INPUT_QUANTITY Compu_TdrpA_rpm_rpm 4 -32768 32767 AXIS_PTS_REF TdrpA_rpm_rpm /end AXIS_DESCR
/end CHARACTERISTIC
/begin COMPU_METHOD Compu_TdrpA_rpm_KMdtfb " " RAT_FUNC "%.3" "K dMAPdt FB (fraction)" COEFFS 0 1024 0 0 0 1 /end COMPU_METHOD
/begin CHARACTERISTIC TdrpA_rpm_dzKp "Alt Droop Speed Gains" CURVE 0x001C63C0 /* @ECU_Address@TdrpA_rpm_dzKp@0x020B8000@ */ ECIPP_ALIGNMENT_SWORD 32767 Compu_TdrpA_rpm_dzKp -32768 32767
 /begin AXIS_DESCR COM_AXIS NO_INPUT_QUANTITY Compu_TdrpA_rpm_rpm 4 -32768 32767 AXIS_PTS_REF TdrpA_rpm_rpm /end AXIS_DESCR
/end CHARACTERISTIC
/begin COMPU_METHOD Compu_TdrpA_rpm_dzKp " " RAT_FUNC "%.0" "dead-zone (rpm)" COEFFS 0 1 0 0 0 1 /end COMPU_METHOD
/begin CHARACTERISTIC TdrpA_rpm_dzKi "Alt Droop Speed Gains" CURVE 0x001C63B8 /* @ECU_Address@TdrpA_rpm_dzKi@0x020B9000@ */ ECIPP_ALIGNMENT_SWORD 32767 Compu_TdrpA_rpm_dzKi -32768 32767
 /begin AXIS_DESCR COM_AXIS NO_INPUT_QUANTITY Compu_TdrpA_rpm_rpm 4 -32768 32767 AXIS_PTS_REF TdrpA_rpm_rpm /end AXIS_DESCR
/end CHARACTERISTIC
/begin COMPU_METHOD Compu_TdrpA_rpm_dzKi " " RAT_FUNC "%.0" "dead-zone (rpm)" COEFFS 0 1 0 0 0 1 /end COMPU_METHOD
/begin CHARACTERISTIC TdrpA_rpm_dzKd "Alt Droop Speed Gains" CURVE 0x001C63B0 /* @ECU_Address@TdrpA_rpm_dzKd@0x020BA000@ */ ECIPP_ALIGNMENT_SWORD 63998 Compu_TdrpA_rpm_dzKd -64000 63998.046875
 /begin AXIS_DESCR COM_AXIS NO_INPUT_QUANTITY Compu_TdrpA_rpm_rpm 4 -32768 32767 AXIS_PTS_REF TdrpA_rpm_rpm /end AXIS_DESCR
/end CHARACTERISTIC
/begin COMPU_METHOD Compu_TdrpA_rpm_dzKd " " RAT_FUNC "%.0" "dead-zone (rpm/sec)" COEFFS 0 0.512 0 0 0 1 /end COMPU_METHOD
/begin CHARACTERISTIC TdrpA_rpm_Ifrz "Alt Droop Speed Gains" CURVE 0x001C6378 /* @ECU_Address@TdrpA_rpm_Ifrz@0x020BB000@ */ ECIPP_ALIGNMENT_SWORD 63998 Compu_TdrpA_rpm_Ifrz -64000 63998.046875
 /begin AXIS_DESCR COM_AXIS NO_INPUT_QUANTITY Compu_TdrpA_rpm_rpm 4 -32768 32767 AXIS_PTS_REF TdrpA_rpm_rpm /end AXIS_DESCR
/end CHARACTERISTIC
/begin COMPU_METHOD Compu_TdrpA_rpm_Ifrz " " RAT_FUNC "%.0" "freeze (rpm/sec)" COEFFS 0 0.512 0 0 0 1 /end COMPU_METHOD
/begin CHARACTERISTIC TspdA_rpm_Kiv "Alt Isochronous Speed Gains" CURVE 0x001C66E4 /* @ECU_Address@TspdA_rpm_Kiv@0x020EF000@ */ ECIPP_ALIGNMENT_SWORD 6250 Compu_TspdA_rpm_Kiv -6250 6249.80926513672
 /begin AXIS_DESCR COM_AXIS NO_INPUT_QUANTITY Compu_TspdA_rpm_rpm 4 -32768 32767 AXIS_PTS_REF TspdA_rpm_rpm /end AXIS_DESCR
/end CHARACTERISTIC
/begin COMPU_METHOD Compu_TspdA_rpm_Kiv " " RAT_FUNC "%.1" "Kiv rpm (%/krpm)" COEFFS 0 5.24288 0 0 0 1 /end COMPU_METHOD
/begin CHARACTERISTIC TdrpA_rpm_Kiv "Alt Droop Speed Gains" CURVE 0x001C63A0 /* @ECU_Address@TdrpA_rpm_Kiv@0x020F0000@ */ ECIPP_ALIGNMENT_SWORD 6250 Compu_TdrpA_rpm_Kiv -6250 6249.80926513672
 /begin AXIS_DESCR COM_AXIS NO_INPUT_QUANTITY Compu_TdrpA_rpm_rpm 4 -32768 32767 AXIS_PTS_REF TdrpA_rpm_rpm /end AXIS_DESCR
/end CHARACTERISTIC
/begin COMPU_METHOD Compu_TdrpA_rpm_Kiv " " RAT_FUNC "%.1" "Kiv rpm (%/krpm)" COEFFS 0 5.24288 0 0 0 1 /end COMPU_METHOD
/begin COMPU_METHOD Compu_TFPPSC_FPP " " RAT_FUNC "%.1" "FPP (%)" COEFFS 0 163.84 0 0 0 1 /end COMPU_METHOD
/begin CHARACTERISTIC TFPPSC_rpm "FPP Based Allspeed Control" CURVE 0x001C4CD8 /* @ECU_Address@TFPPSC_rpm@0x0213C000@ */ ECIPP_ALIGNMENT_SWORD 32767 Compu_TFPPSC_rpm -32768 32767
 /begin AXIS_DESCR COM_AXIS NO_INPUT_QUANTITY Compu_TFPPSC_FPP 4 -200 199.993896484375 AXIS_PTS_REF TFPPSC_FPP /end AXIS_DESCR
/end CHARACTERISTIC
/begin AXIS_PTS TFPPSC_FPP " " 0x001C4CB8 /* @ECU_Address@TFPPSC_FPP@0x0213B000@ */ NO_INPUT_QUANTITY ECIPP_Lookup_SWORD 0 Compu_TFPPSC_FPP 4 -200 199.993896484375 /end AXIS_PTS
/begin COMPU_METHOD Compu_TFPPSC_rpm " " RAT_FUNC "%.0" "Target Speed (rpm)" COEFFS 0 1 0 0 0 1 /end COMPU_METHOD
/begin CHARACTERISTIC TFPPSC_nomload "FPP Based Allspeed Nom Load Adder" CURVE 0x001C4CD0 /* @ECU_Address@TFPPSC_nomload@0x0213D000@ */ ECIPP_ALIGNMENT_SWORD 800 Compu_TFPPSC_nomload -800 799.9755859375
 /begin AXIS_DESCR COM_AXIS NO_INPUT_QUANTITY Compu_TFPPSC_FPP 4 -200 199.993896484375 AXIS_PTS_REF TFPPSC_FPP /end AXIS_DESCR
/end CHARACTERISTIC
/begin COMPU_METHOD Compu_TFPPSC_nomload " " RAT_FUNC "%.1" "Nom Load Adder (%)" COEFFS 0 40.96 0 0 0 1 /end COMPU_METHOD
/begin CHARACTERISTIC TFPPSC_int_max "FPP Based Allspeed Int Max" CURVE 0x001C4CC0 /* @ECU_Address@TFPPSC_int_max@0x0213E000@ */ ECIPP_ALIGNMENT_SWORD 800 Compu_TFPPSC_int_max -800 799.9755859375
 /begin AXIS_DESCR COM_AXIS NO_INPUT_QUANTITY Compu_TFPPSC_FPP 4 -200 199.993896484375 AXIS_PTS_REF TFPPSC_FPP /end AXIS_DESCR
/end CHARACTERISTIC
/begin COMPU_METHOD Compu_TFPPSC_int_max " " RAT_FUNC "%.1" "Integrator Max (%)" COEFFS 0 40.96 0 0 0 1 /end COMPU_METHOD
/begin CHARACTERISTIC TFPPSC_int_min "FPP Based Allspeed Int Min" CURVE 0x001C4CC8 /* @ECU_Address@TFPPSC_int_min@0x0213F000@ */ ECIPP_ALIGNMENT_SWORD 800 Compu_TFPPSC_int_min -800 799.9755859375
 /begin AXIS_DESCR COM_AXIS NO_INPUT_QUANTITY Compu_TFPPSC_FPP 4 -200 199.993896484375 AXIS_PTS_REF TFPPSC_FPP /end AXIS_DESCR
/end CHARACTERISTIC
/begin COMPU_METHOD Compu_TFPPSC_int_min " " RAT_FUNC "%.1" "Integrator Min (%)" COEFFS 0 40.96 0 0 0 1 /end COMPU_METHOD
/begin COMPU_METHOD Compu_TASspkgv_att_rpm " " RAT_FUNC "%.0" "Speed (rpm)" COEFFS 0 1 0 0 0 1 /end COMPU_METHOD
/begin COMPU_METHOD Compu_TASspkgv_att_MAP " " RAT_FUNC "%.1" "MAP load (psia)" COEFFS 0 256 0 0 0 1 /end COMPU_METHOD
/begin CHARACTERISTIC TASspkgv_att_ret "Spark governor retard attenuation" MAP 0x001C4654 /* @ECU_Address@TASspkgv_att_ret@0x0214B000@ */ ECIPP_ALIGNMENT_SWORD 1 Compu_TASspkgv_att_ret -1 0.999969482421875
 /begin AXIS_DESCR COM_AXIS NO_INPUT_QUANTITY Compu_TASspkgv_att_MAP 2 -128 127.99609375 AXIS_PTS_REF TASspkgv_att_MAP /end AXIS_DESCR
 /begin AXIS_DESCR COM_AXIS NO_INPUT_QUANTITY Compu_TASspkgv_att_rpm 4 -32768 32767 AXIS_PTS_REF TASspkgv_att_rpm /end AXIS_DESCR
/end CHARACTERISTIC
/begin AXIS_PTS TASspkgv_att_MAP " " 0x001C4640 /* @ECU_Address@TASspkgv_att_MAP@0x0214A000@ */ NO_INPUT_QUANTITY ECIPP_Lookup_SWORD 0 Compu_TASspkgv_att_MAP 2 -128 127.99609375 /end AXIS_PTS
/begin AXIS_PTS TASspkgv_att_rpm " " 0x001C4664 /* @ECU_Address@TASspkgv_att_rpm@0x02149000@ */ NO_INPUT_QUANTITY ECIPP_Lookup_SWORD 0 Compu_TASspkgv_att_rpm 4 -32768 32767 /end AXIS_PTS
/begin COMPU_METHOD Compu_TASspkgv_att_ret "" RAT_FUNC "%.3" "Retard Attenuation" COEFFS 0 32768 0 0 0 1 /end COMPU_METHOD
/begin CHARACTERISTIC TASspkgv_att_adv "Spark governor advance attenuation" MAP 0x001C4644 /* @ECU_Address@TASspkgv_att_adv@0x0214C000@ */ ECIPP_ALIGNMENT_SWORD 1 Compu_TASspkgv_att_adv -1 0.999969482421875
 /begin AXIS_DESCR COM_AXIS NO_INPUT_QUANTITY Compu_TASspkgv_att_MAP 2 -128 127.99609375 AXIS_PTS_REF TASspkgv_att_MAP /end AXIS_DESCR
 /begin AXIS_DESCR COM_AXIS NO_INPUT_QUANTITY Compu_TASspkgv_att_rpm 4 -32768 32767 AXIS_PTS_REF TASspkgv_att_rpm /end AXIS_DESCR
/end CHARACTERISTIC
/begin COMPU_METHOD Compu_TASspkgv_att_adv "" RAT_FUNC "%.3" "Advance Attenuation" COEFFS 0 32768 0 0 0 1 /end COMPU_METHOD
/begin MEASUREMENT ICAV_ind_cts "Misfire continuous indicator - 1" SLONG Compu_ICAV_ind_cts 0 0 -1024 1023.99999952316 ECU_ADDRESS 0x02169000 MATRIX_DIM 10 1 1 /end MEASUREMENT
/begin COMPU_METHOD Compu_ICAV_ind_cts " " RAT_FUNC "%.1" "-" COEFFS 0 2097152 0 0 0 1 /end COMPU_METHOD
/begin MEASUREMENT ICAV_ind_rdm "Misfire random indicator - 1" SWORD Compu_ICAV_ind_rdm 0 0 -1024 1023.96875 ECU_ADDRESS 0x0216A000 MATRIX_DIM 10 1 1 /end MEASUREMENT
/begin COMPU_METHOD Compu_ICAV_ind_rdm " " RAT_FUNC "%.1" "-" COEFFS 0 32 0 0 0 1 /end COMPU_METHOD
/begin MEASUREMENT ICAV_pct_LP2 "Misfire percent - 1" ULONG Compu_ICAV_pct_LP2 0 0 0 399.999999906868 ECU_ADDRESS 0x0216D000 MATRIX_DIM 10 1 1 /end MEASUREMENT
/begin COMPU_METHOD Compu_ICAV_pct_LP2 " " RAT_FUNC "%.1" "-" COEFFS 0 10737418.24 0 0 0 1 /end COMPU_METHOD
/begin MEASUREMENT ICAV_nrm_LP2 "Misfire normalized - 1" ULONG Compu_ICAV_nrm_LP2 0 0 0 255.999999940395 ECU_ADDRESS 0x0216E000 MATRIX_DIM 10 1 1 /end MEASUREMENT
/begin COMPU_METHOD Compu_ICAV_nrm_LP2 " " RAT_FUNC "%.1" "-" COEFFS 0 16777216 0 0 0 1 /end COMPU_METHOD
/begin MEASUREMENT ICAV_adpt_cyl "Adaptive correction - 1" FLOAT32_IEEE Compu_ICAV_adpt_cyl 0 0 -10000000000 10000000000 ECU_ADDRESS 0x02179000 MATRIX_DIM 10 1 1 /end MEASUREMENT
/begin COMPU_METHOD Compu_ICAV_adpt_cyl " " RAT_FUNC "%.2" "% speed" COEFFS 0 0.01 0 0 0 1 /end COMPU_METHOD
/begin COMPU_METHOD Compu_TspdA_rs_rs " " RAT_FUNC "%.0" "Speed (kph)" COEFFS 0 128 0 0 0 1 /end COMPU_METHOD
/begin CHARACTERISTIC TspdA_rs_Kpm "Alternate Governor Roadspeed Multipliers" CURVE 0x001C6774 /* @ECU_Address@TspdA_rs_Kpm@0x0237E000@ */ ECIPP_ALIGNMENT_SWORD 8 Compu_TspdA_rs_Kpm -8 7.999755859375
 /begin AXIS_DESCR COM_AXIS NO_INPUT_QUANTITY Compu_TspdA_rs_rs 8 -256 255.9921875 AXIS_PTS_REF TspdA_rs_rs /end AXIS_DESCR
/end CHARACTERISTIC
/begin AXIS_PTS TspdA_rs_rs " " 0x001C67B4 /* @ECU_Address@TspdA_rs_rs@0x0237D000@ */ NO_INPUT_QUANTITY ECIPP_Lookup_SWORD 0 Compu_TspdA_rs_rs 8 -256 255.9921875 /end AXIS_PTS
/begin COMPU_METHOD Compu_TspdA_rs_Kpm " " RAT_FUNC "%.3" "Kp Multiplier" COEFFS 0 4096 0 0 0 1 /end COMPU_METHOD
/begin CHARACTERISTIC TspdA_rs_Kim "Alternate Governor Roadspeed Multipliers" CURVE 0x001C6754 /* @ECU_Address@TspdA_rs_Kim@0x0237F000@ */ ECIPP_ALIGNMENT_SWORD 8 Compu_TspdA_rs_Kim -8 7.999755859375
 /begin AXIS_DESCR COM_AXIS NO_INPUT_QUANTITY Compu_TspdA_rs_rs 8 -256 255.9921875 AXIS_PTS_REF TspdA_rs_rs /end AXIS_DESCR
/end CHARACTERISTIC
/begin COMPU_METHOD Compu_TspdA_rs_Kim " " RAT_FUNC "%.3" "Ki Multiplier" COEFFS 0 4096 0 0 0 1 /end COMPU_METHOD
/begin CHARACTERISTIC TspdA_rs_Kivm "Alternate Governor Roadspeed Multipliers" CURVE 0x001C6764 /* @ECU_Address@TspdA_rs_Kivm@0x02380000@ */ ECIPP_ALIGNMENT_SWORD 8 Compu_TspdA_rs_Kivm -8 7.999755859375
 /begin AXIS_DESCR COM_AXIS NO_INPUT_QUANTITY Compu_TspdA_rs_rs 8 -256 255.9921875 AXIS_PTS_REF TspdA_rs_rs /end AXIS_DESCR
/end CHARACTERISTIC
/begin COMPU_METHOD Compu_TspdA_rs_Kivm " " RAT_FUNC "%.3" "Kiv Multiplier" COEFFS 0 4096 0 0 0 1 /end COMPU_METHOD
/begin CHARACTERISTIC TspdA_rs_Kdm "Alternate Governor Roadspeed Multipliers" CURVE 0x001C6744 /* @ECU_Address@TspdA_rs_Kdm@0x02381000@ */ ECIPP_ALIGNMENT_SWORD 8 Compu_TspdA_rs_Kdm -8 7.999755859375
 /begin AXIS_DESCR COM_AXIS NO_INPUT_QUANTITY Compu_TspdA_rs_rs 8 -256 255.9921875 AXIS_PTS_REF TspdA_rs_rs /end AXIS_DESCR
/end CHARACTERISTIC
/begin COMPU_METHOD Compu_TspdA_rs_Kdm " " RAT_FUNC "%.3" "Kd Multiplier" COEFFS 0 4096 0 0 0 1 /end COMPU_METHOD
/begin CHARACTERISTIC TspdA_rs_KMAPdtm "Alternate Governor Roadspeed Multipliers" CURVE 0x001C6724 /* @ECU_Address@TspdA_rs_KMAPdtm@0x02382000@ */ ECIPP_ALIGNMENT_SWORD 8 Compu_TspdA_rs_KMAPdtm -8 7.999755859375
 /begin AXIS_DESCR COM_AXIS NO_INPUT_QUANTITY Compu_TspdA_rs_rs 8 -256 255.9921875 AXIS_PTS_REF TspdA_rs_rs /end AXIS_DESCR
/end CHARACTERISTIC
/begin COMPU_METHOD Compu_TspdA_rs_KMAPdtm " " RAT_FUNC "%.3" "dMAP/dt Multiplier" COEFFS 0 4096 0 0 0 1 /end COMPU_METHOD
/begin CHARACTERISTIC TspdA_rs_KMdtfbm "Alternate Governor Roadspeed Multipliers" CURVE 0x001C6734 /* @ECU_Address@TspdA_rs_KMdtfbm@0x02383000@ */ ECIPP_ALIGNMENT_SWORD 8 Compu_TspdA_rs_KMdtfbm -8 7.999755859375
 /begin AXIS_DESCR COM_AXIS NO_INPUT_QUANTITY Compu_TspdA_rs_rs 8 -256 255.9921875 AXIS_PTS_REF TspdA_rs_rs /end AXIS_DESCR
/end CHARACTERISTIC
/begin COMPU_METHOD Compu_TspdA_rs_KMdtfbm " " RAT_FUNC "%.3" "dMAP/dt FB Multiplier" COEFFS 0 4096 0 0 0 1 /end COMPU_METHOD
/begin CHARACTERISTIC TspdA_rs_dzKpm "Alternate Governor Roadspeed Multipliers" CURVE 0x001C67A4 /* @ECU_Address@TspdA_rs_dzKpm@0x02384000@ */ ECIPP_ALIGNMENT_SWORD 8 Compu_TspdA_rs_dzKpm -8 7.999755859375
 /begin AXIS_DESCR COM_AXIS NO_INPUT_QUANTITY Compu_TspdA_rs_rs 8 -256 255.9921875 AXIS_PTS_REF TspdA_rs_rs /end AXIS_DESCR
/end CHARACTERISTIC
/begin COMPU_METHOD Compu_TspdA_rs_dzKpm " " RAT_FUNC "%.3" "Kp dz Multiplier" COEFFS 0 4096 0 0 0 1 /end COMPU_METHOD
/begin CHARACTERISTIC TspdA_rs_dzKim "Alternate Governor Roadspeed Multipliers" CURVE 0x001C6794 /* @ECU_Address@TspdA_rs_dzKim@0x02385000@ */ ECIPP_ALIGNMENT_SWORD 8 Compu_TspdA_rs_dzKim -8 7.999755859375
 /begin AXIS_DESCR COM_AXIS NO_INPUT_QUANTITY Compu_TspdA_rs_rs 8 -256 255.9921875 AXIS_PTS_REF TspdA_rs_rs /end AXIS_DESCR
/end CHARACTERISTIC
/begin COMPU_METHOD Compu_TspdA_rs_dzKim " " RAT_FUNC "%.3" "Ki dz Multiplier" COEFFS 0 4096 0 0 0 1 /end COMPU_METHOD
/begin CHARACTERISTIC TspdA_rs_dzKdm "Alternate Governor Roadspeed Multipliers" CURVE 0x001C6784 /* @ECU_Address@TspdA_rs_dzKdm@0x02386000@ */ ECIPP_ALIGNMENT_SWORD 8 Compu_TspdA_rs_dzKdm -8 7.999755859375
 /begin AXIS_DESCR COM_AXIS NO_INPUT_QUANTITY Compu_TspdA_rs_rs 8 -256 255.9921875 AXIS_PTS_REF TspdA_rs_rs /end AXIS_DESCR
/end CHARACTERISTIC
/begin COMPU_METHOD Compu_TspdA_rs_dzKdm " " RAT_FUNC "%.3" "Kd dz Multiplier" COEFFS 0 4096 0 0 0 1 /end COMPU_METHOD
/begin CHARACTERISTIC TspdA_rs_Ifrzm "Alternate Governor Roadspeed Multipliers" CURVE 0x001C6714 /* @ECU_Address@TspdA_rs_Ifrzm@0x02387000@ */ ECIPP_ALIGNMENT_SWORD 8 Compu_TspdA_rs_Ifrzm -8 7.999755859375
 /begin AXIS_DESCR COM_AXIS NO_INPUT_QUANTITY Compu_TspdA_rs_rs 8 -256 255.9921875 AXIS_PTS_REF TspdA_rs_rs /end AXIS_DESCR
/end CHARACTERISTIC
/begin COMPU_METHOD Compu_TspdA_rs_Ifrzm " " RAT_FUNC "%.3" "I Freeze Multiplier" COEFFS 0 4096 0 0 0 1 /end COMPU_METHOD
/begin CHARACTERISTIC TspdA_rs_TPSLP "Alternate Governor Roadspeed Multipliers" CURVE 0x001C861A /* @ECU_Address@TspdA_rs_TPSLP@0x02388000@ */ ECIPP_ALIGNMENT_UWORD 327680 Compu_TspdA_rs_TPSLP 0.45084 327680
 /begin AXIS_DESCR COM_AXIS NO_INPUT_QUANTITY Compu_TspdA_rs_rs 8 -256 255.9921875 AXIS_PTS_REF TspdA_rs_rs /end AXIS_DESCR
/end CHARACTERISTIC
/begin COMPU_METHOD Compu_TspdA_rs_TPSLP " " FORM "%.1" "TPS Output low-pass"
 /begin FORMULA "-5 / log(1 - (X1 / 65536))" FORMULA_INV "(1 - exp(-5/X1)) * 65536" /end FORMULA
/end COMPU_METHOD
/begin COMPU_METHOD Compu_TspdA2_rpm_rpm " " RAT_FUNC "%.0" "Speed (rpm)" COEFFS 0 1 0 0 0 1 /end COMPU_METHOD
/begin CHARACTERISTIC TspdA2_rpm_Kp "Alt Isochronous Speed Gains" CURVE 0x001C6694 /* @ECU_Address@TspdA2_rpm_Kp@0x0249C000@ */ ECIPP_ALIGNMENT_SWORD 3125 Compu_TspdA2_rpm_Kp -3125 3124.90463256836
 /begin AXIS_DESCR COM_AXIS NO_INPUT_QUANTITY Compu_TspdA2_rpm_rpm 4 -32768 32767 AXIS_PTS_REF TspdA2_rpm_rpm /end AXIS_DESCR
/end CHARACTERISTIC
/begin AXIS_PTS TspdA2_rpm_rpm " " 0x001C66B4 /* @ECU_Address@TspdA2_rpm_rpm@0x0249B000@ */ NO_INPUT_QUANTITY ECIPP_Lookup_SWORD 0 Compu_TspdA2_rpm_rpm 4 -32768 32767 /end AXIS_PTS
/begin COMPU_METHOD Compu_TspdA2_rpm_Kp " " RAT_FUNC "%.1" "Kp rpm (%/krpm)" COEFFS 0 10.48576 0 0 0 1 /end COMPU_METHOD
/begin CHARACTERISTIC TspdA2_rpm_Kd "Alt Isochronous Speed Gains" CURVE 0x001C667C /* @ECU_Address@TspdA2_rpm_Kd@0x0249D000@ */ ECIPP_ALIGNMENT_SWORD 1600 Compu_TspdA2_rpm_Kd -1600 1599.951171875
 /begin AXIS_DESCR COM_AXIS NO_INPUT_QUANTITY Compu_TspdA2_rpm_rpm 4 -32768 32767 AXIS_PTS_REF TspdA2_rpm_rpm /end AXIS_DESCR
/end CHARACTERISTIC
/begin COMPU_METHOD Compu_TspdA2_rpm_Kd " " RAT_FUNC "%.2" "Kd rpm (%/(krpm/s))" COEFFS 0 20.48 0 0 0 1 /end COMPU_METHOD
/begin CHARACTERISTIC TspdA2_rpm_Ki "Alt Isochronous Speed Gains" CURVE 0x001C6684 /* @ECU_Address@TspdA2_rpm_Ki@0x0249E000@ */ ECIPP_ALIGNMENT_SWORD 12207 Compu_TspdA2_rpm_Ki -12207.03125 12206.6587209702
 /begin AXIS_DESCR COM_AXIS NO_INPUT_QUANTITY Compu_TspdA2_rpm_rpm 4 -32768 32767 AXIS_PTS_REF TspdA2_rpm_rpm /end AXIS_DESCR
/end CHARACTERISTIC
/begin COMPU_METHOD Compu_TspdA2_rpm_Ki " " RAT_FUNC "%.1" "Ki rpm (%/krpm/s)" COEFFS 0 2.68435456 0 0 0 1 /end COMPU_METHOD
/begin CHARACTERISTIC TspdA2_rpm_KMAPdt "Alt Isochronous Speed Gains" CURVE 0x001C666C /* @ECU_Address@TspdA2_rpm_KMAPdt@0x0249F000@ */ ECIPP_ALIGNMENT_SWORD 1000 Compu_TspdA2_rpm_KMAPdt -1000 999.969482421875
 /begin AXIS_DESCR COM_AXIS NO_INPUT_QUANTITY Compu_TspdA2_rpm_rpm 4 -32768 32767 AXIS_PTS_REF TspdA2_rpm_rpm /end AXIS_DESCR
/end CHARACTERISTIC
/begin COMPU_METHOD Compu_TspdA2_rpm_KMAPdt " " RAT_FUNC "%.1" "K dMAPdt (1/sec)" COEFFS 0 32.768 0 0 0 1 /end COMPU_METHOD
/begin CHARACTERISTIC TspdA2_rpm_KMdtfb "Alt Isochronous Speed Gains" CURVE 0x001C6674 /* @ECU_Address@TspdA2_rpm_KMdtfb@0x024A0000@ */ ECIPP_ALIGNMENT_SWORD 32 Compu_TspdA2_rpm_KMdtfb -32 31.9990234375
 /begin AXIS_DESCR COM_AXIS NO_INPUT_QUANTITY Compu_TspdA2_rpm_rpm 4 -32768 32767 AXIS_PTS_REF TspdA2_rpm_rpm /end AXIS_DESCR
/end CHARACTERISTIC
/begin COMPU_METHOD Compu_TspdA2_rpm_KMdtfb " " RAT_FUNC "%.3" "K dMAPdt FB (fraction)" COEFFS 0 1024 0 0 0 1 /end COMPU_METHOD
/begin CHARACTERISTIC TspdA2_rpm_dzKp "Alt Isochronous Speed Gains" CURVE 0x001C66AC /* @ECU_Address@TspdA2_rpm_dzKp@0x024A1000@ */ ECIPP_ALIGNMENT_SWORD 32767 Compu_TspdA2_rpm_dzKp -32768 32767
 /begin AXIS_DESCR COM_AXIS NO_INPUT_QUANTITY Compu_TspdA2_rpm_rpm 4 -32768 32767 AXIS_PTS_REF TspdA2_rpm_rpm /end AXIS_DESCR
/end CHARACTERISTIC
/begin COMPU_METHOD Compu_TspdA2_rpm_dzKp " " RAT_FUNC "%.0" "dead-zone (rpm)" COEFFS 0 1 0 0 0 1 /end COMPU_METHOD
/begin CHARACTERISTIC TspdA2_rpm_dzKi "Alt Isochronous Speed Gains" CURVE 0x001C66A4 /* @ECU_Address@TspdA2_rpm_dzKi@0x024A2000@ */ ECIPP_ALIGNMENT_SWORD 32767 Compu_TspdA2_rpm_dzKi -32768 32767
 /begin AXIS_DESCR COM_AXIS NO_INPUT_QUANTITY Compu_TspdA2_rpm_rpm 4 -32768 32767 AXIS_PTS_REF TspdA2_rpm_rpm /end AXIS_DESCR
/end CHARACTERISTIC
/begin COMPU_METHOD Compu_TspdA2_rpm_dzKi " " RAT_FUNC "%.0" "dead-zone (rpm)" COEFFS 0 1 0 0 0 1 /end COMPU_METHOD
/begin CHARACTERISTIC TspdA2_rpm_dzKd "Alt Isochronous Speed Gains" CURVE 0x001C669C /* @ECU_Address@TspdA2_rpm_dzKd@0x024A3000@ */ ECIPP_ALIGNMENT_SWORD 63998 Compu_TspdA2_rpm_dzKd -64000 63998.046875
 /begin AXIS_DESCR COM_AXIS NO_INPUT_QUANTITY Compu_TspdA2_rpm_rpm 4 -32768 32767 AXIS_PTS_REF TspdA2_rpm_rpm /end AXIS_DESCR
/end CHARACTERISTIC
/begin COMPU_METHOD Compu_TspdA2_rpm_dzKd " " RAT_FUNC "%.0" "dead-zone (rpm/sec)" COEFFS 0 0.512 0 0 0 1 /end COMPU_METHOD
/begin CHARACTERISTIC TspdA2_rpm_Ifrz "Alt Isochronous Speed Gains" CURVE 0x001C6664 /* @ECU_Address@TspdA2_rpm_Ifrz@0x024A4000@ */ ECIPP_ALIGNMENT_SWORD 63998 Compu_TspdA2_rpm_Ifrz -64000 63998.046875
 /begin AXIS_DESCR COM_AXIS NO_INPUT_QUANTITY Compu_TspdA2_rpm_rpm 4 -32768 32767 AXIS_PTS_REF TspdA2_rpm_rpm /end AXIS_DESCR
/end CHARACTERISTIC
/begin COMPU_METHOD Compu_TspdA2_rpm_Ifrz " " RAT_FUNC "%.0" "freeze (rpm/sec)" COEFFS 0 0.512 0 0 0 1 /end COMPU_METHOD
/begin CHARACTERISTIC TspdA2_rpm_Kiv "Alt Isochronous Speed Gains" CURVE 0x001C668C /* @ECU_Address@TspdA2_rpm_Kiv@0x024A5000@ */ ECIPP_ALIGNMENT_SWORD 6250 Compu_TspdA2_rpm_Kiv -6250 6249.80926513672
 /begin AXIS_DESCR COM_AXIS NO_INPUT_QUANTITY Compu_TspdA2_rpm_rpm 4 -32768 32767 AXIS_PTS_REF TspdA2_rpm_rpm /end AXIS_DESCR
/end CHARACTERISTIC
/begin COMPU_METHOD Compu_TspdA2_rpm_Kiv " " RAT_FUNC "%.1" "Kiv rpm (%/krpm)" COEFFS 0 5.24288 0 0 0 1 /end COMPU_METHOD
/begin COMPU_METHOD Compu_TdrpA2_rpm_rpm " " RAT_FUNC "%.0" "Speed (rpm)" COEFFS 0 1 0 0 0 1 /end COMPU_METHOD
/begin CHARACTERISTIC TdrpA2_rpm_Kp "Alt Droop Speed Gains" CURVE 0x001C6350 /* @ECU_Address@TdrpA2_rpm_Kp@0x024A7000@ */ ECIPP_ALIGNMENT_SWORD 3125 Compu_TdrpA2_rpm_Kp -3125 3124.90463256836
 /begin AXIS_DESCR COM_AXIS NO_INPUT_QUANTITY Compu_TdrpA2_rpm_rpm 4 -32768 32767 AXIS_PTS_REF TdrpA2_rpm_rpm /end AXIS_DESCR
/end CHARACTERISTIC
/begin AXIS_PTS TdrpA2_rpm_rpm " " 0x001C6370 /* @ECU_Address@TdrpA2_rpm_rpm@0x024A6000@ */ NO_INPUT_QUANTITY ECIPP_Lookup_SWORD 0 Compu_TdrpA2_rpm_rpm 4 -32768 32767 /end AXIS_PTS
/begin COMPU_METHOD Compu_TdrpA2_rpm_Kp " " RAT_FUNC "%.1" "Kp rpm (%/krpm)" COEFFS 0 10.48576 0 0 0 1 /end COMPU_METHOD
/begin CHARACTERISTIC TdrpA2_rpm_Kd "Alt Droop Speed Gains" CURVE 0x001C6338 /* @ECU_Address@TdrpA2_rpm_Kd@0x024A8000@ */ ECIPP_ALIGNMENT_SWORD 1600 Compu_TdrpA2_rpm_Kd -1600 1599.951171875
 /begin AXIS_DESCR COM_AXIS NO_INPUT_QUANTITY Compu_TdrpA2_rpm_rpm 4 -32768 32767 AXIS_PTS_REF TdrpA2_rpm_rpm /end AXIS_DESCR
/end CHARACTERISTIC
/begin COMPU_METHOD Compu_TdrpA2_rpm_Kd " " RAT_FUNC "%.2" "Kd rpm (%/(krpm/s))" COEFFS 0 20.48 0 0 0 1 /end COMPU_METHOD
/begin CHARACTERISTIC TdrpA2_rpm_Ki "Alt Droop Speed Gains" CURVE 0x001C6340 /* @ECU_Address@TdrpA2_rpm_Ki@0x024A9000@ */ ECIPP_ALIGNMENT_SWORD 12207 Compu_TdrpA2_rpm_Ki -12207.03125 12206.6587209702
 /begin AXIS_DESCR COM_AXIS NO_INPUT_QUANTITY Compu_TdrpA2_rpm_rpm 4 -32768 32767 AXIS_PTS_REF TdrpA2_rpm_rpm /end AXIS_DESCR
/end CHARACTERISTIC
/begin COMPU_METHOD Compu_TdrpA2_rpm_Ki " " RAT_FUNC "%.1" "Ki rpm (%/krpm/s)" COEFFS 0 2.68435456 0 0 0 1 /end COMPU_METHOD
/begin CHARACTERISTIC TdrpA2_rpm_KMAPdt "Alt Droop Speed Gains" CURVE 0x001C6328 /* @ECU_Address@TdrpA2_rpm_KMAPdt@0x024AA000@ */ ECIPP_ALIGNMENT_SWORD 1000 Compu_TdrpA2_rpm_KMAPdt -1000 999.969482421875
 /begin AXIS_DESCR COM_AXIS NO_INPUT_QUANTITY Compu_TdrpA2_rpm_rpm 4 -32768 32767 AXIS_PTS_REF TdrpA2_rpm_rpm /end AXIS_DESCR
/end CHARACTERISTIC
/begin COMPU_METHOD Compu_TdrpA2_rpm_KMAPdt " " RAT_FUNC "%.1" "K dMAPdt (1/sec)" COEFFS 0 32.768 0 0 0 1 /end COMPU_METHOD
/begin CHARACTERISTIC TdrpA2_rpm_KMdtfb "Alt Droop Speed Gains" CURVE 0x001C6330 /* @ECU_Address@TdrpA2_rpm_KMdtfb@0x024AB000@ */ ECIPP_ALIGNMENT_SWORD 32 Compu_TdrpA2_rpm_KMdtfb -32 31.9990234375
 /begin AXIS_DESCR COM_AXIS NO_INPUT_QUANTITY Compu_TdrpA2_rpm_rpm 4 -32768 32767 AXIS_PTS_REF TdrpA2_rpm_rpm /end AXIS_DESCR
/end CHARACTERISTIC
/begin COMPU_METHOD Compu_TdrpA2_rpm_KMdtfb " " RAT_FUNC "%.3" "K dMAPdt FB (fraction)" COEFFS 0 1024 0 0 0 1 /end COMPU_METHOD
/begin CHARACTERISTIC TdrpA2_rpm_dzKp "Alt Droop Speed Gains" CURVE 0x001C6368 /* @ECU_Address@TdrpA2_rpm_dzKp@0x024AC000@ */ ECIPP_ALIGNMENT_SWORD 32767 Compu_TdrpA2_rpm_dzKp -32768 32767
 /begin AXIS_DESCR COM_AXIS NO_INPUT_QUANTITY Compu_TdrpA2_rpm_rpm 4 -32768 32767 AXIS_PTS_REF TdrpA2_rpm_rpm /end AXIS_DESCR
/end CHARACTERISTIC
/begin COMPU_METHOD Compu_TdrpA2_rpm_dzKp " " RAT_FUNC "%.0" "dead-zone (rpm)" COEFFS 0 1 0 0 0 1 /end COMPU_METHOD
/begin CHARACTERISTIC TdrpA2_rpm_dzKi "Alt Droop Speed Gains" CURVE 0x001C6360 /* @ECU_Address@TdrpA2_rpm_dzKi@0x024AD000@ */ ECIPP_ALIGNMENT_SWORD 32767 Compu_TdrpA2_rpm_dzKi -32768 32767
 /begin AXIS_DESCR COM_AXIS NO_INPUT_QUANTITY Compu_TdrpA2_rpm_rpm 4 -32768 32767 AXIS_PTS_REF TdrpA2_rpm_rpm /end AXIS_DESCR
/end CHARACTERISTIC
/begin COMPU_METHOD Compu_TdrpA2_rpm_dzKi " " RAT_FUNC "%.0" "dead-zone (rpm)" COEFFS 0 1 0 0 0 1 /end COMPU_METHOD
/begin CHARACTERISTIC TdrpA2_rpm_dzKd "Alt Droop Speed Gains" CURVE 0x001C6358 /* @ECU_Address@TdrpA2_rpm_dzKd@0x024AE000@ */ ECIPP_ALIGNMENT_SWORD 63998 Compu_TdrpA2_rpm_dzKd -64000 63998.046875
 /begin AXIS_DESCR COM_AXIS NO_INPUT_QUANTITY Compu_TdrpA2_rpm_rpm 4 -32768 32767 AXIS_PTS_REF TdrpA2_rpm_rpm /end AXIS_DESCR
/end CHARACTERISTIC
/begin COMPU_METHOD Compu_TdrpA2_rpm_dzKd " " RAT_FUNC "%.0" "dead-zone (rpm/sec)" COEFFS 0 0.512 0 0 0 1 /end COMPU_METHOD
/begin CHARACTERISTIC TdrpA2_rpm_Ifrz "Alt Droop Speed Gains" CURVE 0x001C6320 /* @ECU_Address@TdrpA2_rpm_Ifrz@0x024AF000@ */ ECIPP_ALIGNMENT_SWORD 63998 Compu_TdrpA2_rpm_Ifrz -64000 63998.046875
 /begin AXIS_DESCR COM_AXIS NO_INPUT_QUANTITY Compu_TdrpA2_rpm_rpm 4 -32768 32767 AXIS_PTS_REF TdrpA2_rpm_rpm /end AXIS_DESCR
/end CHARACTERISTIC
/begin COMPU_METHOD Compu_TdrpA2_rpm_Ifrz " " RAT_FUNC "%.0" "freeze (rpm/sec)" COEFFS 0 0.512 0 0 0 1 /end COMPU_METHOD
/begin CHARACTERISTIC TdrpA2_rpm_Kiv "Alt Droop Speed Gains" CURVE 0x001C6348 /* @ECU_Address@TdrpA2_rpm_Kiv@0x024B0000@ */ ECIPP_ALIGNMENT_SWORD 6250 Compu_TdrpA2_rpm_Kiv -6250 6249.80926513672
 /begin AXIS_DESCR COM_AXIS NO_INPUT_QUANTITY Compu_TdrpA2_rpm_rpm 4 -32768 32767 AXIS_PTS_REF TdrpA2_rpm_rpm /end AXIS_DESCR
/end CHARACTERISTIC
/begin COMPU_METHOD Compu_TdrpA2_rpm_Kiv " " RAT_FUNC "%.1" "Kiv rpm (%/krpm)" COEFFS 0 5.24288 0 0 0 1 /end COMPU_METHOD
/begin CHARACTERISTIC STR_OEM_EOL2 "EOL 2" ASCII 0x001E7540 /* @ECU_Address@STR_OEM_EOL2@0x025D3000@ */ ECIPP_ALIGNMENT_UBYTE 255 Compu_ECIPP_STRINGS 0 255 MATRIX_DIM 255 1 1 /end CHARACTERISTIC
/begin CHARACTERISTIC STR_OEM_EOL3 "EOL 3" ASCII 0x001E7640 /* @ECU_Address@STR_OEM_EOL3@0x025D4000@ */ ECIPP_ALIGNMENT_UBYTE 255 Compu_ECIPP_STRINGS 0 255 MATRIX_DIM 255 1 1 /end CHARACTERISTIC
/begin GROUP EC_GovCalAlt "ECONTROLS" ROOT
 /begin REF_CHARACTERISTIC FPPSC_nomload_ena FPPSC_int_min_ena FPPSC_int_max_ena PTO_sw PTO_spdinput PTO_gov_type PTO_Vslow PTO_Vfast PTO_rpmslow PTO_rpmfast PTOd_sw PTOd_setinc_chan PTOd_resdec_chan PTO_clutch_override PTO_ebrake_override PTO_max_load_pct PTOd_setres_rpm PTOd_setinc_rpm PTOd_resdec_rpm PTOd_setres_wait PTOd_setinc_wait PTOd_resdec_wait PTOd_setinc_ramp PTOd_resdec_ramp PTO_brake_override PTO_vehspd_limit PTO_sw_validation PTOd_sw_cfg PTO_sw_cfg PTOd_setinc_cfg PTOd_resdec_cfg PTOd_enable_moment PTOd_disable PTOd_disable_cfg IdleTrim_ena IdleTrim_ena_cfg IdleTrim_inc IdleTrim_inc_cfg IdleTrim_dec IdleTrim_dec_cfg IdleTrim_step IdleTrim_ECT IdleTrim_run_wait IdleTrim_min_rpm IdleTrim_max_rpm PTOd_setinc_tap PTOd_resdec_tap PTOd_setinc_store_EE PTO_vehspd_min PTOd_enable_mode PTOd_btn_rls_tout PTOd_disable_2inputs PTOd_rpm_init PTO_rpm_dz TSSC_ena TSSC_up_dur TSSC_up_delta_rpm TSSC_up_min_rpm TSSC_up_down_rpmdt TSSC_up_up_rpmdt TSSC_up_RS_Iacc_rst TSSC_sw_RS_lmt TSSC_sw_RS_delay TSSC_sw_delta_rpm TSSC_sw_min_rpm TSSC_sw_down_rpmdt TSSC_sw_up_rpmdt TSSC_sw_LoadLim_pct TSSC_sw_up_LoadLimdt TSSC_rpm_limit_ena TspdA_rpm_Kp TspdA_rpm_Kd TspdA_rpm_Ki TspdA_rpm_KMAPdt TspdA_rpm_KMdtfb TspdA_rpm_dzKp TspdA_rpm_dzKi TspdA_rpm_dzKd TspdA_rpm_Ifrz TdrpA_rpm_Kp TdrpA_rpm_Kd TdrpA_rpm_Ki TdrpA_rpm_KMAPdt TdrpA_rpm_KMdtfb TdrpA_rpm_dzKp TdrpA_rpm_dzKi TdrpA_rpm_dzKd TdrpA_rpm_Ifrz TspdA_rpm_Kiv TdrpA_rpm_Kiv TFPPSC_rpm TFPPSC_nomload TFPPSC_int_max TFPPSC_int_min TASspkgv_att_ret TASspkgv_att_adv TspdA_rs_Kpm TspdA_rs_Kim TspdA_rs_Kivm TspdA_rs_Kdm TspdA_rs_KMAPdtm TspdA_rs_KMdtfbm TspdA_rs_dzKpm TspdA_rs_dzKim TspdA_rs_dzKdm TspdA_rs_Ifrzm TspdA_rs_TPSLP TspdA2_rpm_Kp TspdA2_rpm_Kd TspdA2_rpm_Ki TspdA2_rpm_KMAPdt TspdA2_rpm_KMdtfb TspdA2_rpm_dzKp TspdA2_rpm_dzKi TspdA2_rpm_dzKd TspdA2_rpm_Ifrz TspdA2_rpm_Kiv TdrpA2_rpm_Kp TdrpA2_rpm_Kd TdrpA2_rpm_Ki TdrpA2_rpm_KMAPdt TdrpA2_rpm_KMdtfb TdrpA2_rpm_dzKp TdrpA2_rpm_dzKi TdrpA2_rpm_dzKd TdrpA2_rpm_Ifrz TdrpA2_rpm_Kiv /end REF_CHARACTERISTIC
 /begin REF_MEASUREMENT PTO_ena PTO_rpmd PTOd_ena PTOp_rpm_inst PTOd_rpm_accum PTOd_inc_sw PTOd_res_sw PTOd_dec_sw PTOd_set_sw IdleTrim_rpm IdleTrim_ctls IdleTrim_active TSSC_gear_d TSSC_rpm_max TSSC_rpm_min IdleTrim_ena_sw_stat IdleTrim_inc_sw_stat IdleTrim_dec_sw_stat PTOd_ena_sw_stat PTOd_dis_sw_stat PTOd_setinc_sw_stat PTOd_resdec_sw_stat PTOp_ena_sw_stat gov_type_engaged /end REF_MEASUREMENT
/end GROUP
/begin GROUP EC_HDOBD "ECONTROLS" ROOT
 /begin REF_CHARACTERISTIC fault_store_EE MIL_start_cnt_min FltStartMax fm_wus_ect_min fm_wus_ect_delta fm_nox_retention fm_derate_clear fm_mode fm_ac_cyc_type fm_dtc_svr_ena fm_induce_ena fm_induce_actv_chan INDUCE_lamp fm_operation_cycle fm_gd_oper_req_env fm_gd_idle_req_env fm_gd_oper_rs_ena fm_gd_oper_rpm_ena fm_gd_oper_load_ena gen_den_idle_src fm_op_reset_key_on fm_hybrid_mode FltStartMaxPnd fm_pending_cycle fm_NOx_derate_table fm_NOx_dep_delay /end REF_CHARACTERISTIC
 /begin REF_MEASUREMENT fm_wus_ect_target fm_wus_ect_start FSF2_NOX_FAULT_MIL fm_rt_while_nox_MIL fm_discmil FSF_FAULT_MIL FSF2_SHORT_MIL FSF2_ON_DEMAND_MIL FSF2_ALL_MON_READY FSFP_WARMED_UP FSFP_MIL_THIS_CYCLE FSFP_CLR_THIS_CYCLE FSF_MIL_STATE J1939_MIL_state MIL_status fm_gd_cum_rt_env fm_gd_cum_rt_oper fm_gd_cont_rt_idle FSF2_GD_INC rdy_rdy_nmhc_cat rdy_rdy_heated_cat rdy_rdy_nox rdy_rdy_evap rdy_rdy_sec_air rdy_rdy_exhaust_gas rdy_rdy_pm_filter rdy_sup_nmhc_cat rdy_sup_heated_cat rdy_sup_nox rdy_sup_evap rdy_sup_sec_air rdy_sup_exhaust_gas rdy_sup_pm_filter rdy_ena_misfire rdy_ena_fuel rdy_ena_compcomp rdy_ena_cat rdy_ena_nmhc_cat rdy_ena_heated_cat rdy_ena_nox rdy_ena_evap rdy_ena_sec_air rdy_ena_boost rdy_ena_o2 rdy_ena_exhaust_gas rdy_ena_o2_heater rdy_ena_pm_filter rdy_ena_egr_vvt rdy_com_misfire rdy_com_fuel rdy_com_compcomp rdy_com_cat rdy_com_nmhc_cat rdy_com_heated_cat rdy_com_nox rdy_com_evap rdy_com_sec_air rdy_com_boost rdy_com_o2 rdy_com_exhaust_gas rdy_com_o2_heater rdy_com_pm_filter rdy_com_egr_vvt iupr_sup_sec_air iupr_sup_evap iupr_sup_nmhc_cat iupr_sup_nox_scr_cat iupr_sup_nox_adsorb iupr_sup_pm_filter iupr_sup_exhaust_gas iupr_sup_fuel iupr_num_sec_air iupr_num_evap iupr_num_nmhc_cat iupr_num_nox_scr_cat iupr_num_nox_adsorb iupr_num_pm_filter iupr_num_exhaust_gas iupr_num_fuel iupr_den_sec_air iupr_den_evap iupr_den_nmhc_cat iupr_den_nox_scr_cat iupr_den_nox_adsorb iupr_den_pm_filter iupr_den_exhaust_gas iupr_den_fuel FSF2_GD_FAULT FltStartMaxa fm_ac_cyc_typea MIL_start_cnt_mina fault_store_EEa fm_oper_cyc_counter fm_drive_cyc_tmr fm_pending_cycle_act fm_induce_derate fm_induce_state fm_induce_l3_tmr fm_induce_up_EGR fm_induce_up_Mon fm_induce_dn_EGR fm_induce_dn_Mon fm_clr_mode FltStartMaxPnda INDUCEout_mirror MIL_persist_tmr MIL_start_cnt fm_NOx_dep_run_time /end REF_MEASUREMENT
/end GROUP
/begin GROUP EC_HDService "ECONTROLS" ROOT
 /begin REF_CHARACTERISTIC PN_CFV_eng_cal_mod tech_SNPN_write_ena STR_OEM_EOL2 STR_OEM_EOL3 /end REF_CHARACTERISTIC
 /begin REF_MEASUREMENT WGP_gage CFV_man_mode CFV_status CFVI_cur_cal_mod CFVI_cur_SW_mod CFVI_cur_HW_mod CFV_P_act_DC CFV_x_act_DC CFV_P_act_I CFV_x_act_I CFV_P_act_kPa CFV_x_act CFV_Tfuel_degK CFV_mdot_act_pct CFV_mdot_act CFV_mdot_cmd_pct CFV_mdot_cmd CFV_P_man_kPa CFV_x_man CFV_x_err CFV_P_err_kPa CFV_x_cmd CFV_P_cmd_kPa CFV_FSO_cmd CFV_mdot_pct_err UEGO_reset_action CFV_mdot_choke tech_SNPN_write_key TWCmod_OSC_reset /end REF_MEASUREMENT
/end GROUP
/begin GROUP EC_HDService2 "ECONTROLS" ROOT /begin REF_CHARACTERISTIC RS_pulses_per_km /end REF_CHARACTERISTIC
 /begin REF_MEASUREMENT KNK_retard RS_speed RS_speed_d RS_setsrc_stat fm_induce_derate fm_induce_state fm_induce_l3_tmr fm_induce_up_EGR fm_induce_up_Mon fm_induce_dn_EGR fm_induce_dn_Mon OCT_learning EGR_stuckvlv_tot_cnt ICAV_ind_cts ICAV_ind_rdm ICAV_pct_LP2 ICAV_nrm_LP2 ICAV_adpt_cyl /end REF_MEASUREMENT
/end GROUP
/begin GROUP EC_HWConfig "ECONTROLS" ROOT
 /begin REF_CHARACTERISTIC DBW_output_Hz HBA_output_Hz HBB_output_Hz DBW_output_type HBA_output_type HBB_output_type DBW_output_invert HBA_output_invert HBB_output_invert /end REF_CHARACTERISTIC
 /begin REF_MEASUREMENT KNK_HW_scale2 PCB1_assembly_raw PCB2_assembly_raw Aux_PWM3_manual LOCKOFF_PWM_manual /end REF_MEASUREMENT
/end GROUP
/begin GROUP EC_Knock "ECONTROLS" ROOT /begin REF_MEASUREMENT KNK_retard KNK_HW_scale2 OCT_learning /end REF_MEASUREMENT /end GROUP
/begin GROUP EC_LEService "ECONTROLS" ROOT /begin REF_MEASUREMENT KNK_retard /end REF_MEASUREMENT /end GROUP
/begin GROUP EC_Megajector "ECONTROLS" ROOT /begin REF_CHARACTERISTIC PN_CFV_eng_cal_mod /end REF_CHARACTERISTIC
 /begin REF_MEASUREMENT CFV_man_mode CFV_status CFVI_cur_cal_mod CFVI_cur_SW_mod CFVI_cur_HW_mod CFV_P_act_DC CFV_x_act_DC CFV_P_act_I CFV_x_act_I CFV_P_act_kPa CFV_x_act CFV_Tfuel_degK CFV_mdot_act_pct CFV_mdot_act CFV_mdot_cmd CFV_P_man_kPa CFV_x_man CFV_x_err CFV_P_err_kPa CFV_x_cmd CFV_P_cmd_kPa CFV_FSO_cmd CFV_mdot_pct_err CFV_mdot_choke /end REF_MEASUREMENT
/end GROUP
/begin GROUP EC_Misfire "ECONTROLS" ROOT
 /begin REF_MEASUREMENT ICAV_ind_cts ICAV_ind_rdm ICAV_pct_LP2 ICAV_nrm_LP2 ICAV_adpt_cyl /end REF_MEASUREMENT
/end GROUP
/begin GROUP EC_OEMEOLConf "ECONTROLS" ROOT /begin REF_CHARACTERISTIC RS_pulses_per_km STR_OEM_EOL2 STR_OEM_EOL3 /end REF_CHARACTERISTIC /begin REF_MEASUREMENT RS_speed RS_speed_d RS_setsrc_stat /end REF_MEASUREMENT /end GROUP
/begin GROUP EC_RawVolts "ECONTROLS" ROOT /begin REF_MEASUREMENT PCB1_assembly_raw PCB2_assembly_raw /end REF_MEASUREMENT /end GROUP
/begin GROUP EC_Roadspeed "ECONTROLS" ROOT /begin REF_CHARACTERISTIC RS_pulses_per_km /end REF_CHARACTERISTIC /begin REF_MEASUREMENT RS_speed RS_speed_d RS_setsrc_stat /end REF_MEASUREMENT /end GROUP
/begin GROUP EC_SparkCal "ECONTROLS" ROOT /begin REF_MEASUREMENT KNK_retard /end REF_MEASUREMENT /end GROUP
/begin GROUP EC_SparkCalLP "ECONTROLS" ROOT /begin REF_MEASUREMENT KNK_retard /end REF_MEASUREMENT /end GROUP
/begin GROUP EC_SparkCalNG "ECONTROLS" ROOT /begin REF_MEASUREMENT KNK_retard /end REF_MEASUREMENT /end GROUP
/begin GROUP EC_SparkOfst "ECONTROLS" ROOT /begin REF_MEASUREMENT KNK_retard /end REF_MEASUREMENT /end GROUP
/end MODULE
/end PROJECT
