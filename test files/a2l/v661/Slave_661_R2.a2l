ASAP2_VERSION 1 61
/begin PROJECT Econtrols_4G "4G Test"
/begin HEADER "4G A2L Configuration" PROJECT_NO EControls4G /* config for version control */ VERSION "$Revision: 82130 $:" /* config for version control */ /end HEADER
/begin MODULE EControls_4G_SH2A "EControls 4G"
/begin MOD_COMMON "" DEPOSIT ABSOLUTE BYTE_ORDER MSB_FIRST /end MOD_COMMON
/* Define the Record Layouts */
/begin RECORD_LAYOUT ECIPP_ALIGNMENT_UBYTE FNC_VALUES 1 UBYTE COLUMN_DIR DIRECT /end RECORD_LAYOUT
/begin RECORD_LAYOUT ECIPP_ALIGNMENT_UWORD FNC_VALUES 1 UWORD COLUMN_DIR DIRECT /end RECORD_LAYOUT
/begin RECORD_LAYOUT ECIPP_ALIGNMENT_ULONG FNC_VALUES 1 ULONG COLUMN_DIR DIRECT /end RECORD_LAYOUT
/begin RECORD_LAYOUT ECIPP_ALIGNMENT_FLOAT32_IEEE FNC_VALUES 1 FLOAT32_IEEE COLUMN_DIR DIRECT /end RECORD_LAYOUT
/begin COMPU_METHOD Compu_IDENTITY "Discrete Values " /* Identifier */ IDENTICAL "%.0" /* Format */ "-" /* Units */ /end COMPU_METHOD
/begin CHARACTERISTIC FCdc4_ADIG22_min "FCtl_DTC_0x04(589)" VALUE 0x001E4530 /* @ECU_Address@FCtl_DTC_0x04@0x024C449A@ */ ECIPP_ALIGNMENT_UWORD 65535 Compu_IDENTITY 0 65535 PHYS_UNIT "System ID + DTC" /end CHARACTERISTIC
/begin CHARACTERISTIC FCdc4_ADIG23_max "FCtl_DTC_0x04(590)" VALUE 0x001E4532 /* @ECU_Address@FCtl_DTC_0x04@0x024C449C@ */ ECIPP_ALIGNMENT_UWORD 65535 Compu_IDENTITY 0 65535 PHYS_UNIT "System ID + DTC" /end CHARACTERISTIC
/begin CHARACTERISTIC FCdc4_ADIG23_min "FCtl_DTC_0x04(591)" VALUE 0x001E4534 /* @ECU_Address@FCtl_DTC_0x04@0x024C449E@ */ ECIPP_ALIGNMENT_UWORD 65535 Compu_IDENTITY 0 65535 PHYS_UNIT "System ID + DTC" /end CHARACTERISTIC
/begin CHARACTERISTIC FCdc4_ADIG24_max "FCtl_DTC_0x04(592)" VALUE 0x001E4536 /* @ECU_Address@FCtl_DTC_0x04@0x024C44A0@ */ ECIPP_ALIGNMENT_UWORD 65535 Compu_IDENTITY 0 65535 PHYS_UNIT "System ID + DTC" /end CHARACTERISTIC
/begin CHARACTERISTIC FCdc4_ADIG24_min "FCtl_DTC_0x04(593)" VALUE 0x001E4538 /* @ECU_Address@FCtl_DTC_0x04@0x024C44A2@ */ ECIPP_ALIGNMENT_UWORD 65535 Compu_IDENTITY 0 65535 PHYS_UNIT "System ID + DTC" /end CHARACTERISTIC
/begin CHARACTERISTIC FCdc4_ADIG25_max "FCtl_DTC_0x04(594)" VALUE 0x001E453A /* @ECU_Address@FCtl_DTC_0x04@0x024C44A4@ */ ECIPP_ALIGNMENT_UWORD 65535 Compu_IDENTITY 0 65535 PHYS_UNIT "System ID + DTC" /end CHARACTERISTIC
/begin CHARACTERISTIC FCdc4_ADIG25_min "FCtl_DTC_0x04(595)" VALUE 0x001E453C /* @ECU_Address@FCtl_DTC_0x04@0x024C44A6@ */ ECIPP_ALIGNMENT_UWORD 65535 Compu_IDENTITY 0 65535 PHYS_UNIT "System ID + DTC" /end CHARACTERISTIC
/begin CHARACTERISTIC FCdc4_ADIG3_max "FCtl_DTC_0x04(213)" VALUE 0x001E4240 /* @ECU_Address@FCtl_DTC_0x04@0x024C41AA@ */ ECIPP_ALIGNMENT_UWORD 65535 Compu_IDENTITY 0 65535 PHYS_UNIT "System ID + DTC" /end CHARACTERISTIC
/begin CHARACTERISTIC FCdc4_ADIG3_min "FCtl_DTC_0x04(214)" VALUE 0x001E4242 /* @ECU_Address@FCtl_DTC_0x04@0x024C41AC@ */ ECIPP_ALIGNMENT_UWORD 65535 Compu_IDENTITY 0 65535 PHYS_UNIT "System ID + DTC" /end CHARACTERISTIC
/begin CHARACTERISTIC FCdc4_ADIG4_max "FCtl_DTC_0x04(337)" VALUE 0x001E4338 /* @ECU_Address@FCtl_DTC_0x04@0x024C42A2@ */ ECIPP_ALIGNMENT_UWORD 65535 Compu_IDENTITY 0 65535 PHYS_UNIT "System ID + DTC" /end CHARACTERISTIC
/begin CHARACTERISTIC FCdc4_ADIG4_min "FCtl_DTC_0x04(338)" VALUE 0x001E433A /* @ECU_Address@FCtl_DTC_0x04@0x024C42A4@ */ ECIPP_ALIGNMENT_UWORD 65535 Compu_IDENTITY 0 65535 PHYS_UNIT "System ID + DTC" /end CHARACTERISTIC
/begin CHARACTERISTIC FCdc4_ADIG5_max "FCtl_DTC_0x04(339)" VALUE 0x001E433C /* @ECU_Address@FCtl_DTC_0x04@0x024C42A6@ */ ECIPP_ALIGNMENT_UWORD 65535 Compu_IDENTITY 0 65535 PHYS_UNIT "System ID + DTC" /end CHARACTERISTIC
/begin CHARACTERISTIC FCdc4_ADIG5_min "FCtl_DTC_0x04(340)" VALUE 0x001E433E /* @ECU_Address@FCtl_DTC_0x04@0x024C42A8@ */ ECIPP_ALIGNMENT_UWORD 65535 Compu_IDENTITY 0 65535 PHYS_UNIT "System ID + DTC" /end CHARACTERISTIC
/begin CHARACTERISTIC FCdc4_ADIG6_max "FCtl_DTC_0x04(341)" VALUE 0x001E4340 /* @ECU_Address@FCtl_DTC_0x04@0x024C42AA@ */ ECIPP_ALIGNMENT_UWORD 65535 Compu_IDENTITY 0 65535 PHYS_UNIT "System ID + DTC" /end CHARACTERISTIC
/begin CHARACTERISTIC FCdc4_ADIG6_min "FCtl_DTC_0x04(342)" VALUE 0x001E4342 /* @ECU_Address@FCtl_DTC_0x04@0x024C42AC@ */ ECIPP_ALIGNMENT_UWORD 65535 Compu_IDENTITY 0 65535 PHYS_UNIT "System ID + DTC" /end CHARACTERISTIC
/begin CHARACTERISTIC FCdc4_ADIG7_max "FCtl_DTC_0x04(343)" VALUE 0x001E4344 /* @ECU_Address@FCtl_DTC_0x04@0x024C42AE@ */ ECIPP_ALIGNMENT_UWORD 65535 Compu_IDENTITY 0 65535 PHYS_UNIT "System ID + DTC" /end CHARACTERISTIC
/begin CHARACTERISTIC FCdc4_ADIG7_min "FCtl_DTC_0x04(344)" VALUE 0x001E4346 /* @ECU_Address@FCtl_DTC_0x04@0x024C42B0@ */ ECIPP_ALIGNMENT_UWORD 65535 Compu_IDENTITY 0 65535 PHYS_UNIT "System ID + DTC" /end CHARACTERISTIC
/begin CHARACTERISTIC FCdc4_ADIG8_max "FCtl_DTC_0x04(345)" VALUE 0x001E4348 /* @ECU_Address@FCtl_DTC_0x04@0x024C42B2@ */ ECIPP_ALIGNMENT_UWORD 65535 Compu_IDENTITY 0 65535 PHYS_UNIT "System ID + DTC" /end CHARACTERISTIC
/begin CHARACTERISTIC FCdc4_ADIG8_min "FCtl_DTC_0x04(346)" VALUE 0x001E434A /* @ECU_Address@FCtl_DTC_0x04@0x024C42B4@ */ ECIPP_ALIGNMENT_UWORD 65535 Compu_IDENTITY 0 65535 PHYS_UNIT "System ID + DTC" /end CHARACTERISTIC
/begin CHARACTERISTIC FCdc4_ADIG9_max "FCtl_DTC_0x04(347)" VALUE 0x001E434C /* @ECU_Address@FCtl_DTC_0x04@0x024C42B6@ */ ECIPP_ALIGNMENT_UWORD 65535 Compu_IDENTITY 0 65535 PHYS_UNIT "System ID + DTC" /end CHARACTERISTIC
/begin CHARACTERISTIC FCdc4_ADIG9_min "FCtl_DTC_0x04(348)" VALUE 0x001E434E /* @ECU_Address@FCtl_DTC_0x04@0x024C42B8@ */ ECIPP_ALIGNMENT_UWORD 65535 Compu_IDENTITY 0 65535 PHYS_UNIT "System ID + DTC" /end CHARACTERISTIC
/begin CHARACTERISTIC FCdc4_ADloss "FCtl_DTC_0x04(103)" VALUE 0x001E4164 /* @ECU_Address@FCtl_DTC_0x04@0x024C40CE@ */ ECIPP_ALIGNMENT_UWORD 65535 Compu_IDENTITY 0 65535 PHYS_UNIT "System ID + DTC" /end CHARACTERISTIC
/begin CHARACTERISTIC FCdc4_AFILT_dP_high "FCtl_DTC_0x04(732)" VALUE 0x001E464E /* @ECU_Address@FCtl_DTC_0x04@0x024C45B8@ */ ECIPP_ALIGNMENT_UWORD 65535 Compu_IDENTITY 0 65535 PHYS_UNIT "System ID + DTC" /end CHARACTERISTIC
/begin CHARACTERISTIC FCdc4_AL_hi "FCtl_DTC_0x04(30)" VALUE 0x001E40D2 /* @ECU_Address@FCtl_DTC_0x04@0x024C403C@ */ ECIPP_ALIGNMENT_UWORD 65535 Compu_IDENTITY 0 65535 PHYS_UNIT "System ID + DTC" /end CHARACTERISTIC
/begin CHARACTERISTIC FCdc4_AL_lo "FCtl_DTC_0x04(31)" VALUE 0x001E40D4 /* @ECU_Address@FCtl_DTC_0x04@0x024C403E@ */ ECIPP_ALIGNMENT_UWORD 65535 Compu_IDENTITY 0 65535 PHYS_UNIT "System ID + DTC" /end CHARACTERISTIC
/begin CHARACTERISTIC FCdc4_ALLP_hi "FCtl_DTC_0x04(42)" VALUE 0x001E40EA /* @ECU_Address@FCtl_DTC_0x04@0x024C4054@ */ ECIPP_ALIGNMENT_UWORD 65535 Compu_IDENTITY 0 65535 PHYS_UNIT "System ID + DTC" /end CHARACTERISTIC
/begin CHARACTERISTIC FCdc4_ALLP_lo "FCtl_DTC_0x04(43)" VALUE 0x001E40EC /* @ECU_Address@FCtl_DTC_0x04@0x024C4056@ */ ECIPP_ALIGNMENT_UWORD 65535 Compu_IDENTITY 0 65535 PHYS_UNIT "System ID + DTC" /end CHARACTERISTIC
/begin CHARACTERISTIC FCdc4_ALNG_hi "FCtl_DTC_0x04(44)" VALUE 0x001E40EE /* @ECU_Address@FCtl_DTC_0x04@0x024C4058@ */ ECIPP_ALIGNMENT_UWORD 65535 Compu_IDENTITY 0 65535 PHYS_UNIT "System ID + DTC" /end CHARACTERISTIC
/begin CHARACTERISTIC FCdc4_ALNG_lo "FCtl_DTC_0x04(45)" VALUE 0x001E40F0 /* @ECU_Address@FCtl_DTC_0x04@0x024C405A@ */ ECIPP_ALIGNMENT_UWORD 65535 Compu_IDENTITY 0 65535 PHYS_UNIT "System ID + DTC" /end CHARACTERISTIC
/begin CHARACTERISTIC FCdc4_APD1_max "FCtl_DTC_0x04(116)" VALUE 0x001E417E /* @ECU_Address@FCtl_DTC_0x04@0x024C40E8@ */ ECIPP_ALIGNMENT_UWORD 65535 Compu_IDENTITY 0 65535 PHYS_UNIT "System ID + DTC" /end CHARACTERISTIC
/begin CHARACTERISTIC FCdc4_APD1_min "FCtl_DTC_0x04(117)" VALUE 0x001E4180 /* @ECU_Address@FCtl_DTC_0x04@0x024C40EA@ */ ECIPP_ALIGNMENT_UWORD 65535 Compu_IDENTITY 0 65535 PHYS_UNIT "System ID + DTC" /end CHARACTERISTIC
/begin CHARACTERISTIC FCdc4_APD2_max "FCtl_DTC_0x04(229)" VALUE 0x001E4260 /* @ECU_Address@FCtl_DTC_0x04@0x024C41CA@ */ ECIPP_ALIGNMENT_UWORD 65535 Compu_IDENTITY 0 65535 PHYS_UNIT "System ID + DTC" /end CHARACTERISTIC
/begin CHARACTERISTIC FCdc4_APD2_min "FCtl_DTC_0x04(230)" VALUE 0x001E4262 /* @ECU_Address@FCtl_DTC_0x04@0x024C41CC@ */ ECIPP_ALIGNMENT_UWORD 65535 Compu_IDENTITY 0 65535 PHYS_UNIT "System ID + DTC" /end CHARACTERISTIC
/begin CHARACTERISTIC FCdc4_APD3_max "FCtl_DTC_0x04(231)" VALUE 0x001E4264 /* @ECU_Address@FCtl_DTC_0x04@0x024C41CE@ */ ECIPP_ALIGNMENT_UWORD 65535 Compu_IDENTITY 0 65535 PHYS_UNIT "System ID + DTC" /end CHARACTERISTIC
/begin CHARACTERISTIC FCdc4_APD3_min "FCtl_DTC_0x04(232)" VALUE 0x001E4266 /* @ECU_Address@FCtl_DTC_0x04@0x024C41D0@ */ ECIPP_ALIGNMENT_UWORD 65535 Compu_IDENTITY 0 65535 PHYS_UNIT "System ID + DTC" /end CHARACTERISTIC
/begin CHARACTERISTIC FCdc4_APS1_max "FCtl_DTC_0x04(465)" VALUE 0x001E4438 /* @ECU_Address@FCtl_DTC_0x04@0x024C43A2@ */ ECIPP_ALIGNMENT_UWORD 65535 Compu_IDENTITY 0 65535 PHYS_UNIT "System ID + DTC" /end CHARACTERISTIC
/begin CHARACTERISTIC FCdc4_APS1_min "FCtl_DTC_0x04(466)" VALUE 0x001E443A /* @ECU_Address@FCtl_DTC_0x04@0x024C43A4@ */ ECIPP_ALIGNMENT_UWORD 65535 Compu_IDENTITY 0 65535 PHYS_UNIT "System ID + DTC" /end CHARACTERISTIC
/begin CHARACTERISTIC FCdc4_APS12_OOR "FCtl_DTC_0x04(473)" VALUE 0x001E4448 /* @ECU_Address@FCtl_DTC_0x04@0x024C43B2@ */ ECIPP_ALIGNMENT_UWORD 65535 Compu_IDENTITY 0 65535 PHYS_UNIT "System ID + DTC" /end CHARACTERISTIC
/begin CHARACTERISTIC FCdc4_APS12pct_hi "FCtl_DTC_0x04(469)" VALUE 0x001E4440 /* @ECU_Address@FCtl_DTC_0x04@0x024C43AA@ */ ECIPP_ALIGNMENT_UWORD 65535 Compu_IDENTITY 0 65535 PHYS_UNIT "System ID + DTC" /end CHARACTERISTIC
/begin CHARACTERISTIC FCdc4_APS12pct_lo "FCtl_DTC_0x04(470)" VALUE 0x001E4442 /* @ECU_Address@FCtl_DTC_0x04@0x024C43AC@ */ ECIPP_ALIGNMENT_UWORD 65535 Compu_IDENTITY 0 65535 PHYS_UNIT "System ID + DTC" /end CHARACTERISTIC
/begin CHARACTERISTIC FCdc4_APS2_max "FCtl_DTC_0x04(467)" VALUE 0x001E443C /* @ECU_Address@FCtl_DTC_0x04@0x024C43A6@ */ ECIPP_ALIGNMENT_UWORD 65535 Compu_IDENTITY 0 65535 PHYS_UNIT "System ID + DTC" /end CHARACTERISTIC
/begin CHARACTERISTIC FCdc4_APS2_min "FCtl_DTC_0x04(468)" VALUE 0x001E443E /* @ECU_Address@FCtl_DTC_0x04@0x024C43A8@ */ ECIPP_ALIGNMENT_UWORD 65535 Compu_IDENTITY 0 65535 PHYS_UNIT "System ID + DTC" /end CHARACTERISTIC
/begin CHARACTERISTIC FCdc4_APSerr_neg "FCtl_DTC_0x04(472)" VALUE 0x001E4446 /* @ECU_Address@FCtl_DTC_0x04@0x024C43B0@ */ ECIPP_ALIGNMENT_UWORD 65535 Compu_IDENTITY 0 65535 PHYS_UNIT "System ID + DTC" /end CHARACTERISTIC
/begin CHARACTERISTIC FCdc4_APSerr_pos "FCtl_DTC_0x04(471)" VALUE 0x001E4444 /* @ECU_Address@FCtl_DTC_0x04@0x024C43AE@ */ ECIPP_ALIGNMENT_UWORD 65535 Compu_IDENTITY 0 65535 PHYS_UNIT "System ID + DTC" /end CHARACTERISTIC
/begin CHARACTERISTIC FCdc4_APU1_max "FCtl_DTC_0x04(118)" VALUE 0x001E4182 /* @ECU_Address@FCtl_DTC_0x04@0x024C40EC@ */ ECIPP_ALIGNMENT_UWORD 65535 Compu_IDENTITY 0 65535 PHYS_UNIT "System ID + DTC" /end CHARACTERISTIC
/begin CHARACTERISTIC FCdc4_APU1_min "FCtl_DTC_0x04(119)" VALUE 0x001E4184 /* @ECU_Address@FCtl_DTC_0x04@0x024C40EE@ */ ECIPP_ALIGNMENT_UWORD 65535 Compu_IDENTITY 0 65535 PHYS_UNIT "System ID + DTC" /end CHARACTERISTIC
/begin CHARACTERISTIC FCdc4_APU2_max "FCtl_DTC_0x04(120)" VALUE 0x001E4186 /* @ECU_Address@FCtl_DTC_0x04@0x024C40F0@ */ ECIPP_ALIGNMENT_UWORD 65535 Compu_IDENTITY 0 65535 PHYS_UNIT "System ID + DTC" /end CHARACTERISTIC
/begin CHARACTERISTIC FCdc4_APU2_min "FCtl_DTC_0x04(121)" VALUE 0x001E4188 /* @ECU_Address@FCtl_DTC_0x04@0x024C40F2@ */ ECIPP_ALIGNMENT_UWORD 65535 Compu_IDENTITY 0 65535 PHYS_UNIT "System ID + DTC" /end CHARACTERISTIC
/begin CHARACTERISTIC FCdc4_APU3_max "FCtl_DTC_0x04(201)" VALUE 0x001E4228 /* @ECU_Address@FCtl_DTC_0x04@0x024C4192@ */ ECIPP_ALIGNMENT_UWORD 65535 Compu_IDENTITY 0 65535 PHYS_UNIT "System ID + DTC" /end CHARACTERISTIC
/begin CHARACTERISTIC FCdc4_APU3_min "FCtl_DTC_0x04(202)" VALUE 0x001E422A /* @ECU_Address@FCtl_DTC_0x04@0x024C4194@ */ ECIPP_ALIGNMENT_UWORD 65535 Compu_IDENTITY 0 65535 PHYS_UNIT "System ID + DTC" /end CHARACTERISTIC
/begin CHARACTERISTIC FCdc4_APUD1_max "FCtl_DTC_0x04(203)" VALUE 0x001E422C /* @ECU_Address@FCtl_DTC_0x04@0x024C4196@ */ ECIPP_ALIGNMENT_UWORD 65535 Compu_IDENTITY 0 65535 PHYS_UNIT "System ID + DTC" /end CHARACTERISTIC
/begin CHARACTERISTIC FCdc4_APUD1_min "FCtl_DTC_0x04(204)" VALUE 0x001E422E /* @ECU_Address@FCtl_DTC_0x04@0x024C4198@ */ ECIPP_ALIGNMENT_UWORD 65535 Compu_IDENTITY 0 65535 PHYS_UNIT "System ID + DTC" /end CHARACTERISTIC
/begin CHARACTERISTIC FCdc4_APUD10_max "FCtl_DTC_0x04(361)" VALUE 0x001E4368 /* @ECU_Address@FCtl_DTC_0x04@0x024C42D2@ */ ECIPP_ALIGNMENT_UWORD 65535 Compu_IDENTITY 0 65535 PHYS_UNIT "System ID + DTC" /end CHARACTERISTIC
/begin CHARACTERISTIC FCdc4_APUD10_min "FCtl_DTC_0x04(362)" VALUE 0x001E436A /* @ECU_Address@FCtl_DTC_0x04@0x024C42D4@ */ ECIPP_ALIGNMENT_UWORD 65535 Compu_IDENTITY 0 65535 PHYS_UNIT "System ID + DTC" /end CHARACTERISTIC
/begin CHARACTERISTIC FCdc4_APUD11_max "FCtl_DTC_0x04(363)" VALUE 0x001E436C /* @ECU_Address@FCtl_DTC_0x04@0x024C42D6@ */ ECIPP_ALIGNMENT_UWORD 65535 Compu_IDENTITY 0 65535 PHYS_UNIT "System ID + DTC" /end CHARACTERISTIC
/begin CHARACTERISTIC FCdc4_APUD11_min "FCtl_DTC_0x04(364)" VALUE 0x001E436E /* @ECU_Address@FCtl_DTC_0x04@0x024C42D8@ */ ECIPP_ALIGNMENT_UWORD 65535 Compu_IDENTITY 0 65535 PHYS_UNIT "System ID + DTC" /end CHARACTERISTIC
/begin CHARACTERISTIC FCdc4_APUD12_max "FCtl_DTC_0x04(365)" VALUE 0x001E4370 /* @ECU_Address@FCtl_DTC_0x04@0x024C42DA@ */ ECIPP_ALIGNMENT_UWORD 65535 Compu_IDENTITY 0 65535 PHYS_UNIT "System ID + DTC" /end CHARACTERISTIC
/begin CHARACTERISTIC FCdc4_APUD12_min "FCtl_DTC_0x04(366)" VALUE 0x001E4372 /* @ECU_Address@FCtl_DTC_0x04@0x024C42DC@ */ ECIPP_ALIGNMENT_UWORD 65535 Compu_IDENTITY 0 65535 PHYS_UNIT "System ID + DTC" /end CHARACTERISTIC
/begin CHARACTERISTIC FCdc4_APUD13_max "FCtl_DTC_0x04(367)" VALUE 0x001E4374 /* @ECU_Address@FCtl_DTC_0x04@0x024C42DE@ */ ECIPP_ALIGNMENT_UWORD 65535 Compu_IDENTITY 0 65535 PHYS_UNIT "System ID + DTC" /end CHARACTERISTIC
/begin CHARACTERISTIC FCdc4_APUD13_min "FCtl_DTC_0x04(368)" VALUE 0x001E4376 /* @ECU_Address@FCtl_DTC_0x04@0x024C42E0@ */ ECIPP_ALIGNMENT_UWORD 65535 Compu_IDENTITY 0 65535 PHYS_UNIT "System ID + DTC" /end CHARACTERISTIC
/begin CHARACTERISTIC FCdc4_APUD14_max "FCtl_DTC_0x04(369)" VALUE 0x001E4378 /* @ECU_Address@FCtl_DTC_0x04@0x024C42E2@ */ ECIPP_ALIGNMENT_UWORD 65535 Compu_IDENTITY 0 65535 PHYS_UNIT "System ID + DTC" /end CHARACTERISTIC
/begin CHARACTERISTIC FCdc4_APUD14_min "FCtl_DTC_0x04(370)" VALUE 0x001E437A /* @ECU_Address@FCtl_DTC_0x04@0x024C42E4@ */ ECIPP_ALIGNMENT_UWORD 65535 Compu_IDENTITY 0 65535 PHYS_UNIT "System ID + DTC" /end CHARACTERISTIC
/begin CHARACTERISTIC FCdc4_APUD15_max "FCtl_DTC_0x04(371)" VALUE 0x001E437C /* @ECU_Address@FCtl_DTC_0x04@0x024C42E6@ */ ECIPP_ALIGNMENT_UWORD 65535 Compu_IDENTITY 0 65535 PHYS_UNIT "System ID + DTC" /end CHARACTERISTIC
/begin CHARACTERISTIC FCdc4_APUD15_min "FCtl_DTC_0x04(372)" VALUE 0x001E437E /* @ECU_Address@FCtl_DTC_0x04@0x024C42E8@ */ ECIPP_ALIGNMENT_UWORD 65535 Compu_IDENTITY 0 65535 PHYS_UNIT "System ID + DTC" /end CHARACTERISTIC
/begin CHARACTERISTIC FCdc4_APUD16_max "FCtl_DTC_0x04(373)" VALUE 0x001E4380 /* @ECU_Address@FCtl_DTC_0x04@0x024C42EA@ */ ECIPP_ALIGNMENT_UWORD 65535 Compu_IDENTITY 0 65535 PHYS_UNIT "System ID + DTC" /end CHARACTERISTIC
/begin CHARACTERISTIC FCdc4_APUD16_min "FCtl_DTC_0x04(374)" VALUE 0x001E4382 /* @ECU_Address@FCtl_DTC_0x04@0x024C42EC@ */ ECIPP_ALIGNMENT_UWORD 65535 Compu_IDENTITY 0 65535 PHYS_UNIT "System ID + DTC" /end CHARACTERISTIC
/begin CHARACTERISTIC FCdc4_APUD17_max "FCtl_DTC_0x04(375)" VALUE 0x001E4384 /* @ECU_Address@FCtl_DTC_0x04@0x024C42EE@ */ ECIPP_ALIGNMENT_UWORD 65535 Compu_IDENTITY 0 65535 PHYS_UNIT "System ID + DTC" /end CHARACTERISTIC
/begin CHARACTERISTIC FCdc4_APUD17_min "FCtl_DTC_0x04(376)" VALUE 0x001E4386 /* @ECU_Address@FCtl_DTC_0x04@0x024C42F0@ */ ECIPP_ALIGNMENT_UWORD 65535 Compu_IDENTITY 0 65535 PHYS_UNIT "System ID + DTC" /end CHARACTERISTIC
/begin CHARACTERISTIC FCdc4_APUD18_max "FCtl_DTC_0x04(377)" VALUE 0x001E4388 /* @ECU_Address@FCtl_DTC_0x04@0x024C42F2@ */ ECIPP_ALIGNMENT_UWORD 65535 Compu_IDENTITY 0 65535 PHYS_UNIT "System ID + DTC" /end CHARACTERISTIC
/begin CHARACTERISTIC FCdc4_APUD18_min "FCtl_DTC_0x04(378)" VALUE 0x001E438A /* @ECU_Address@FCtl_DTC_0x04@0x024C42F4@ */ ECIPP_ALIGNMENT_UWORD 65535 Compu_IDENTITY 0 65535 PHYS_UNIT "System ID + DTC" /end CHARACTERISTIC
/begin CHARACTERISTIC FCdc4_APUD19_max "FCtl_DTC_0x04(379)" VALUE 0x001E438C /* @ECU_Address@FCtl_DTC_0x04@0x024C42F6@ */ ECIPP_ALIGNMENT_UWORD 65535 Compu_IDENTITY 0 65535 PHYS_UNIT "System ID + DTC" /end CHARACTERISTIC
/begin CHARACTERISTIC FCdc4_APUD19_min "FCtl_DTC_0x04(380)" VALUE 0x001E438E /* @ECU_Address@FCtl_DTC_0x04@0x024C42F8@ */ ECIPP_ALIGNMENT_UWORD 65535 Compu_IDENTITY 0 65535 PHYS_UNIT "System ID + DTC" /end CHARACTERISTIC
/begin CHARACTERISTIC FPnd_ADIG22_min "FPrm_pending(443)" VALUE 0x001E5488 /* @ECU_Address@FPrm_pending@0x021BE376@ */ ECIPP_ALIGNMENT_UWORD 65535 Compu_IDENTITY 0 65535 PHYS_UNIT "Bit Mask" /end CHARACTERISTIC
/begin CHARACTERISTIC FPnd_ADIG23_max "FPrm_pending(444)" VALUE 0x001E548A /* @ECU_Address@FPrm_pending@0x021BE378@ */ ECIPP_ALIGNMENT_UWORD 65535 Compu_IDENTITY 0 65535 PHYS_UNIT "Bit Mask" /end CHARACTERISTIC
/begin CHARACTERISTIC FPnd_ADIG23_min "FPrm_pending(445)" VALUE 0x001E548C /* @ECU_Address@FPrm_pending@0x021BE37A@ */ ECIPP_ALIGNMENT_UWORD 65535 Compu_IDENTITY 0 65535 PHYS_UNIT "Bit Mask" /end CHARACTERISTIC
/begin CHARACTERISTIC FPnd_ADIG24_max "FPrm_pending(446)" VALUE 0x001E548E /* @ECU_Address@FPrm_pending@0x021BE37C@ */ ECIPP_ALIGNMENT_UWORD 65535 Compu_IDENTITY 0 65535 PHYS_UNIT "Bit Mask" /end CHARACTERISTIC
/begin CHARACTERISTIC FPnd_ADIG24_min "FPrm_pending(447)" VALUE 0x001E5490 /* @ECU_Address@FPrm_pending@0x021BE37E@ */ ECIPP_ALIGNMENT_UWORD 65535 Compu_IDENTITY 0 65535 PHYS_UNIT "Bit Mask" /end CHARACTERISTIC
/begin CHARACTERISTIC FPnd_ADIG25_max "FPrm_pending(448)" VALUE 0x001E5492 /* @ECU_Address@FPrm_pending@0x021BE380@ */ ECIPP_ALIGNMENT_UWORD 65535 Compu_IDENTITY 0 65535 PHYS_UNIT "Bit Mask" /end CHARACTERISTIC
/begin CHARACTERISTIC FPnd_ADIG25_min "FPrm_pending(449)" VALUE 0x001E5494 /* @ECU_Address@FPrm_pending@0x021BE382@ */ ECIPP_ALIGNMENT_UWORD 65535 Compu_IDENTITY 0 65535 PHYS_UNIT "Bit Mask" /end CHARACTERISTIC
/begin CHARACTERISTIC FPnd_ADIG3_max "FPrm_pending(169)" VALUE 0x001E5264 /* @ECU_Address@FPrm_pending@0x021BE152@ */ ECIPP_ALIGNMENT_UWORD 65535 Compu_IDENTITY 0 65535 PHYS_UNIT "Bit Mask" /end CHARACTERISTIC
/begin CHARACTERISTIC FPnd_ADIG3_min "FPrm_pending(170)" VALUE 0x001E5266 /* @ECU_Address@FPrm_pending@0x021BE154@ */ ECIPP_ALIGNMENT_UWORD 65535 Compu_IDENTITY 0 65535 PHYS_UNIT "Bit Mask" /end CHARACTERISTIC
/begin CHARACTERISTIC FPnd_ADIG4_max "FPrm_pending(246)" VALUE 0x001E52FE /* @ECU_Address@FPrm_pending@0x021BE1EC@ */ ECIPP_ALIGNMENT_UWORD 65535 Compu_IDENTITY 0 65535 PHYS_UNIT "Bit Mask" /end CHARACTERISTIC
/begin CHARACTERISTIC FPnd_ADIG4_min "FPrm_pending(247)" VALUE 0x001E5300 /* @ECU_Address@FPrm_pending@0x021BE1EE@ */ ECIPP_ALIGNMENT_UWORD 65535 Compu_IDENTITY 0 65535 PHYS_UNIT "Bit Mask" /end CHARACTERISTIC
/begin CHARACTERISTIC FPnd_ADIG5_max "FPrm_pending(248)" VALUE 0x001E5302 /* @ECU_Address@FPrm_pending@0x021BE1F0@ */ ECIPP_ALIGNMENT_UWORD 65535 Compu_IDENTITY 0 65535 PHYS_UNIT "Bit Mask" /end CHARACTERISTIC
/begin CHARACTERISTIC FPnd_ADIG5_min "FPrm_pending(249)" VALUE 0x001E5304 /* @ECU_Address@FPrm_pending@0x021BE1F2@ */ ECIPP_ALIGNMENT_UWORD 65535 Compu_IDENTITY 0 65535 PHYS_UNIT "Bit Mask" /end CHARACTERISTIC
/begin CHARACTERISTIC FPnd_ADIG6_max "FPrm_pending(250)" VALUE 0x001E5306 /* @ECU_Address@FPrm_pending@0x021BE1F4@ */ ECIPP_ALIGNMENT_UWORD 65535 Compu_IDENTITY 0 65535 PHYS_UNIT "Bit Mask" /end CHARACTERISTIC
/begin CHARACTERISTIC FPnd_ADIG6_min "FPrm_pending(251)" VALUE 0x001E5308 /* @ECU_Address@FPrm_pending@0x021BE1F6@ */ ECIPP_ALIGNMENT_UWORD 65535 Compu_IDENTITY 0 65535 PHYS_UNIT "Bit Mask" /end CHARACTERISTIC
/begin CHARACTERISTIC FPnd_ADIG7_max "FPrm_pending(252)" VALUE 0x001E530A /* @ECU_Address@FPrm_pending@0x021BE1F8@ */ ECIPP_ALIGNMENT_UWORD 65535 Compu_IDENTITY 0 65535 PHYS_UNIT "Bit Mask" /end CHARACTERISTIC
/begin CHARACTERISTIC FPnd_ADIG7_min "FPrm_pending(253)" VALUE 0x001E530C /* @ECU_Address@FPrm_pending@0x021BE1FA@ */ ECIPP_ALIGNMENT_UWORD 65535 Compu_IDENTITY 0 65535 PHYS_UNIT "Bit Mask" /end CHARACTERISTIC
/begin CHARACTERISTIC FPnd_ADIG8_max "FPrm_pending(254)" VALUE 0x001E530E /* @ECU_Address@FPrm_pending@0x021BE1FC@ */ ECIPP_ALIGNMENT_UWORD 65535 Compu_IDENTITY 0 65535 PHYS_UNIT "Bit Mask" /end CHARACTERISTIC
/begin CHARACTERISTIC FPnd_ADIG8_min "FPrm_pending(255)" VALUE 0x001E5310 /* @ECU_Address@FPrm_pending@0x021BE1FE@ */ ECIPP_ALIGNMENT_UWORD 65535 Compu_IDENTITY 0 65535 PHYS_UNIT "Bit Mask" /end CHARACTERISTIC
/begin CHARACTERISTIC FPnd_ADIG9_max "FPrm_pending(256)" VALUE 0x001E5312 /* @ECU_Address@FPrm_pending@0x021BE200@ */ ECIPP_ALIGNMENT_UWORD 65535 Compu_IDENTITY 0 65535 PHYS_UNIT "Bit Mask" /end CHARACTERISTIC
/begin CHARACTERISTIC FPnd_ADIG9_min "FPrm_pending(257)" VALUE 0x001E5314 /* @ECU_Address@FPrm_pending@0x021BE202@ */ ECIPP_ALIGNMENT_UWORD 65535 Compu_IDENTITY 0 65535 PHYS_UNIT "Bit Mask" /end CHARACTERISTIC
/begin CHARACTERISTIC FPnd_ADloss "FPrm_pending(67)" VALUE 0x001E5198 /* @ECU_Address@FPrm_pending@0x021BE086@ */ ECIPP_ALIGNMENT_UWORD 65535 Compu_IDENTITY 0 65535 PHYS_UNIT "Bit Mask" /end CHARACTERISTIC
/begin CHARACTERISTIC FPnd_AFILT_dP_high "FPrm_pending(562)" VALUE 0x001E5576 /* @ECU_Address@FPrm_pending@0x021BE464@ */ ECIPP_ALIGNMENT_UWORD 65535 Compu_IDENTITY 0 65535 PHYS_UNIT "Bit Mask" /end CHARACTERISTIC
/begin CHARACTERISTIC FPnd_AL_hi "FPrm_pending(41)" VALUE 0x001E5164 /* @ECU_Address@FPrm_pending@0x021BE052@ */ ECIPP_ALIGNMENT_UWORD 65535 Compu_IDENTITY 0 65535 PHYS_UNIT "Bit Mask" /end CHARACTERISTIC
/begin CHARACTERISTIC FPnd_AL_lo "FPrm_pending(42)" VALUE 0x001E5166 /* @ECU_Address@FPrm_pending@0x021BE054@ */ ECIPP_ALIGNMENT_UWORD 65535 Compu_IDENTITY 0 65535 PHYS_UNIT "Bit Mask" /end CHARACTERISTIC
/begin CHARACTERISTIC FPnd_ALLP_hi "FPrm_pending(43)" VALUE 0x001E5168 /* @ECU_Address@FPrm_pending@0x021BE056@ */ ECIPP_ALIGNMENT_UWORD 65535 Compu_IDENTITY 0 65535 PHYS_UNIT "Bit Mask" /end CHARACTERISTIC
/begin CHARACTERISTIC FPnd_ALLP_lo "FPrm_pending(44)" VALUE 0x001E516A /* @ECU_Address@FPrm_pending@0x021BE058@ */ ECIPP_ALIGNMENT_UWORD 65535 Compu_IDENTITY 0 65535 PHYS_UNIT "Bit Mask" /end CHARACTERISTIC
/begin CHARACTERISTIC FPnd_ALNG_hi "FPrm_pending(45)" VALUE 0x001E516C /* @ECU_Address@FPrm_pending@0x021BE05A@ */ ECIPP_ALIGNMENT_UWORD 65535 Compu_IDENTITY 0 65535 PHYS_UNIT "Bit Mask" /end CHARACTERISTIC
/begin CHARACTERISTIC FPnd_ALNG_lo "FPrm_pending(46)" VALUE 0x001E516E /* @ECU_Address@FPrm_pending@0x021BE05C@ */ ECIPP_ALIGNMENT_UWORD 65535 Compu_IDENTITY 0 65535 PHYS_UNIT "Bit Mask" /end CHARACTERISTIC
/begin CHARACTERISTIC FPnd_APD1_max "FPrm_pending(75)" VALUE 0x001E51A8 /* @ECU_Address@FPrm_pending@0x021BE096@ */ ECIPP_ALIGNMENT_UWORD 65535 Compu_IDENTITY 0 65535 PHYS_UNIT "Bit Mask" /end CHARACTERISTIC
/begin CHARACTERISTIC FPnd_APD1_min "FPrm_pending(76)" VALUE 0x001E51AA /* @ECU_Address@FPrm_pending@0x021BE098@ */ ECIPP_ALIGNMENT_UWORD 65535 Compu_IDENTITY 0 65535 PHYS_UNIT "Bit Mask" /end CHARACTERISTIC
/begin CHARACTERISTIC FPnd_APD2_max "FPrm_pending(181)" VALUE 0x001E527C /* @ECU_Address@FPrm_pending@0x021BE16A@ */ ECIPP_ALIGNMENT_UWORD 65535 Compu_IDENTITY 0 65535 PHYS_UNIT "Bit Mask" /end CHARACTERISTIC
/begin CHARACTERISTIC FPnd_APD2_min "FPrm_pending(182)" VALUE 0x001E527E /* @ECU_Address@FPrm_pending@0x021BE16C@ */ ECIPP_ALIGNMENT_UWORD 65535 Compu_IDENTITY 0 65535 PHYS_UNIT "Bit Mask" /end CHARACTERISTIC
/begin CHARACTERISTIC FPnd_APD3_max "FPrm_pending(183)" VALUE 0x001E5280 /* @ECU_Address@FPrm_pending@0x021BE16E@ */ ECIPP_ALIGNMENT_UWORD 65535 Compu_IDENTITY 0 65535 PHYS_UNIT "Bit Mask" /end CHARACTERISTIC
/begin CHARACTERISTIC FPnd_APD3_min "FPrm_pending(184)" VALUE 0x001E5282 /* @ECU_Address@FPrm_pending@0x021BE170@ */ ECIPP_ALIGNMENT_UWORD 65535 Compu_IDENTITY 0 65535 PHYS_UNIT "Bit Mask" /end CHARACTERISTIC
/begin CHARACTERISTIC FPnd_APS1_max "FPrm_pending(362)" VALUE 0x001E53E6 /* @ECU_Address@FPrm_pending@0x021BE2D4@ */ ECIPP_ALIGNMENT_UWORD 65535 Compu_IDENTITY 0 65535 PHYS_UNIT "Bit Mask" /end CHARACTERISTIC
/begin CHARACTERISTIC FPnd_APS1_min "FPrm_pending(363)" VALUE 0x001E53E8 /* @ECU_Address@FPrm_pending@0x021BE2D6@ */ ECIPP_ALIGNMENT_UWORD 65535 Compu_IDENTITY 0 65535 PHYS_UNIT "Bit Mask" /end CHARACTERISTIC
/begin CHARACTERISTIC FPnd_APS12_OOR "FPrm_pending(370)" VALUE 0x001E53F6 /* @ECU_Address@FPrm_pending@0x021BE2E4@ */ ECIPP_ALIGNMENT_UWORD 65535 Compu_IDENTITY 0 65535 PHYS_UNIT "Bit Mask" /end CHARACTERISTIC
/begin CHARACTERISTIC FPnd_APS12pct_hi "FPrm_pending(366)" VALUE 0x001E53EE /* @ECU_Address@FPrm_pending@0x021BE2DC@ */ ECIPP_ALIGNMENT_UWORD 65535 Compu_IDENTITY 0 65535 PHYS_UNIT "Bit Mask" /end CHARACTERISTIC
/begin CHARACTERISTIC FPnd_APS12pct_lo "FPrm_pending(367)" VALUE 0x001E53F0 /* @ECU_Address@FPrm_pending@0x021BE2DE@ */ ECIPP_ALIGNMENT_UWORD 65535 Compu_IDENTITY 0 65535 PHYS_UNIT "Bit Mask" /end CHARACTERISTIC
/begin CHARACTERISTIC FPnd_APS2_max "FPrm_pending(364)" VALUE 0x001E53EA /* @ECU_Address@FPrm_pending@0x021BE2D8@ */ ECIPP_ALIGNMENT_UWORD 65535 Compu_IDENTITY 0 65535 PHYS_UNIT "Bit Mask" /end CHARACTERISTIC
/begin CHARACTERISTIC FPnd_APS2_min "FPrm_pending(365)" VALUE 0x001E53EC /* @ECU_Address@FPrm_pending@0x021BE2DA@ */ ECIPP_ALIGNMENT_UWORD 65535 Compu_IDENTITY 0 65535 PHYS_UNIT "Bit Mask" /end CHARACTERISTIC
/begin CHARACTERISTIC FPnd_APSerr_neg "FPrm_pending(369)" VALUE 0x001E53F4 /* @ECU_Address@FPrm_pending@0x021BE2E2@ */ ECIPP_ALIGNMENT_UWORD 65535 Compu_IDENTITY 0 65535 PHYS_UNIT "Bit Mask" /end CHARACTERISTIC
/begin CHARACTERISTIC FPnd_APSerr_pos "FPrm_pending(368)" VALUE 0x001E53F2 /* @ECU_Address@FPrm_pending@0x021BE2E0@ */ ECIPP_ALIGNMENT_UWORD 65535 Compu_IDENTITY 0 65535 PHYS_UNIT "Bit Mask" /end CHARACTERISTIC
/begin CHARACTERISTIC FPnd_APU1_max "FPrm_pending(77)" VALUE 0x001E51AC /* @ECU_Address@FPrm_pending@0x021BE09A@ */ ECIPP_ALIGNMENT_UWORD 65535 Compu_IDENTITY 0 65535 PHYS_UNIT "Bit Mask" /end CHARACTERISTIC
/begin CHARACTERISTIC FPnd_APU1_min "FPrm_pending(78)" VALUE 0x001E51AE /* @ECU_Address@FPrm_pending@0x021BE09C@ */ ECIPP_ALIGNMENT_UWORD 65535 Compu_IDENTITY 0 65535 PHYS_UNIT "Bit Mask" /end CHARACTERISTIC
/begin CHARACTERISTIC FPnd_APU2_max "FPrm_pending(79)" VALUE 0x001E51B0 /* @ECU_Address@FPrm_pending@0x021BE09E@ */ ECIPP_ALIGNMENT_UWORD 65535 Compu_IDENTITY 0 65535 PHYS_UNIT "Bit Mask" /end CHARACTERISTIC
/begin CHARACTERISTIC FPnd_APU2_min "FPrm_pending(80)" VALUE 0x001E51B2 /* @ECU_Address@FPrm_pending@0x021BE0A0@ */ ECIPP_ALIGNMENT_UWORD 65535 Compu_IDENTITY 0 65535 PHYS_UNIT "Bit Mask" /end CHARACTERISTIC
/begin CHARACTERISTIC FPnd_APU3_max "FPrm_pending(157)" VALUE 0x001E524C /* @ECU_Address@FPrm_pending@0x021BE13A@ */ ECIPP_ALIGNMENT_UWORD 65535 Compu_IDENTITY 0 65535 PHYS_UNIT "Bit Mask" /end CHARACTERISTIC
/begin CHARACTERISTIC FPnd_APU3_min "FPrm_pending(158)" VALUE 0x001E524E /* @ECU_Address@FPrm_pending@0x021BE13C@ */ ECIPP_ALIGNMENT_UWORD 65535 Compu_IDENTITY 0 65535 PHYS_UNIT "Bit Mask" /end CHARACTERISTIC
/begin CHARACTERISTIC FPnd_APUD1_max "FPrm_pending(159)" VALUE 0x001E5250 /* @ECU_Address@FPrm_pending@0x021BE13E@ */ ECIPP_ALIGNMENT_UWORD 65535 Compu_IDENTITY 0 65535 PHYS_UNIT "Bit Mask" /end CHARACTERISTIC
/begin CHARACTERISTIC FPnd_APUD1_min "FPrm_pending(160)" VALUE 0x001E5252 /* @ECU_Address@FPrm_pending@0x021BE140@ */ ECIPP_ALIGNMENT_UWORD 65535 Compu_IDENTITY 0 65535 PHYS_UNIT "Bit Mask" /end CHARACTERISTIC
/begin CHARACTERISTIC FPnd_APUD10_max "FPrm_pending(270)" VALUE 0x001E532E /* @ECU_Address@FPrm_pending@0x021BE21C@ */ ECIPP_ALIGNMENT_UWORD 65535 Compu_IDENTITY 0 65535 PHYS_UNIT "Bit Mask" /end CHARACTERISTIC
/begin CHARACTERISTIC FPnd_APUD10_min "FPrm_pending(271)" VALUE 0x001E5330 /* @ECU_Address@FPrm_pending@0x021BE21E@ */ ECIPP_ALIGNMENT_UWORD 65535 Compu_IDENTITY 0 65535 PHYS_UNIT "Bit Mask" /end CHARACTERISTIC
/begin CHARACTERISTIC FPnd_APUD11_max "FPrm_pending(272)" VALUE 0x001E5332 /* @ECU_Address@FPrm_pending@0x021BE220@ */ ECIPP_ALIGNMENT_UWORD 65535 Compu_IDENTITY 0 65535 PHYS_UNIT "Bit Mask" /end CHARACTERISTIC
/begin CHARACTERISTIC FPnd_APUD11_min "FPrm_pending(273)" VALUE 0x001E5334 /* @ECU_Address@FPrm_pending@0x021BE222@ */ ECIPP_ALIGNMENT_UWORD 65535 Compu_IDENTITY 0 65535 PHYS_UNIT "Bit Mask" /end CHARACTERISTIC
/begin CHARACTERISTIC FPnd_APUD12_max "FPrm_pending(274)" VALUE 0x001E5336 /* @ECU_Address@FPrm_pending@0x021BE224@ */ ECIPP_ALIGNMENT_UWORD 65535 Compu_IDENTITY 0 65535 PHYS_UNIT "Bit Mask" /end CHARACTERISTIC
/begin CHARACTERISTIC FPnd_APUD12_min "FPrm_pending(275)" VALUE 0x001E5338 /* @ECU_Address@FPrm_pending@0x021BE226@ */ ECIPP_ALIGNMENT_UWORD 65535 Compu_IDENTITY 0 65535 PHYS_UNIT "Bit Mask" /end CHARACTERISTIC
/begin CHARACTERISTIC FPnd_APUD13_max "FPrm_pending(276)" VALUE 0x001E533A /* @ECU_Address@FPrm_pending@0x021BE228@ */ ECIPP_ALIGNMENT_UWORD 65535 Compu_IDENTITY 0 65535 PHYS_UNIT "Bit Mask" /end CHARACTERISTIC
/begin CHARACTERISTIC FPnd_APUD13_min "FPrm_pending(277)" VALUE 0x001E533C /* @ECU_Address@FPrm_pending@0x021BE22A@ */ ECIPP_ALIGNMENT_UWORD 65535 Compu_IDENTITY 0 65535 PHYS_UNIT "Bit Mask" /end CHARACTERISTIC
/begin CHARACTERISTIC FPnd_APUD14_max "FPrm_pending(278)" VALUE 0x001E533E /* @ECU_Address@FPrm_pending@0x021BE22C@ */ ECIPP_ALIGNMENT_UWORD 65535 Compu_IDENTITY 0 65535 PHYS_UNIT "Bit Mask" /end CHARACTERISTIC
/begin CHARACTERISTIC FPnd_APUD14_min "FPrm_pending(279)" VALUE 0x001E5340 /* @ECU_Address@FPrm_pending@0x021BE22E@ */ ECIPP_ALIGNMENT_UWORD 65535 Compu_IDENTITY 0 65535 PHYS_UNIT "Bit Mask" /end CHARACTERISTIC
/begin CHARACTERISTIC FPnd_APUD15_max "FPrm_pending(280)" VALUE 0x001E5342 /* @ECU_Address@FPrm_pending@0x021BE230@ */ ECIPP_ALIGNMENT_UWORD 65535 Compu_IDENTITY 0 65535 PHYS_UNIT "Bit Mask" /end CHARACTERISTIC
/begin CHARACTERISTIC FPnd_APUD15_min "FPrm_pending(281)" VALUE 0x001E5344 /* @ECU_Address@FPrm_pending@0x021BE232@ */ ECIPP_ALIGNMENT_UWORD 65535 Compu_IDENTITY 0 65535 PHYS_UNIT "Bit Mask" /end CHARACTERISTIC
/begin CHARACTERISTIC FPnd_APUD16_max "FPrm_pending(282)" VALUE 0x001E5346 /* @ECU_Address@FPrm_pending@0x021BE234@ */ ECIPP_ALIGNMENT_UWORD 65535 Compu_IDENTITY 0 65535 PHYS_UNIT "Bit Mask" /end CHARACTERISTIC
/begin CHARACTERISTIC FPnd_APUD16_min "FPrm_pending(283)" VALUE 0x001E5348 /* @ECU_Address@FPrm_pending@0x021BE236@ */ ECIPP_ALIGNMENT_UWORD 65535 Compu_IDENTITY 0 65535 PHYS_UNIT "Bit Mask" /end CHARACTERISTIC
/begin CHARACTERISTIC FPnd_APUD17_max "FPrm_pending(284)" VALUE 0x001E534A /* @ECU_Address@FPrm_pending@0x021BE238@ */ ECIPP_ALIGNMENT_UWORD 65535 Compu_IDENTITY 0 65535 PHYS_UNIT "Bit Mask" /end CHARACTERISTIC
/begin CHARACTERISTIC FPnd_APUD17_min "FPrm_pending(285)" VALUE 0x001E534C /* @ECU_Address@FPrm_pending@0x021BE23A@ */ ECIPP_ALIGNMENT_UWORD 65535 Compu_IDENTITY 0 65535 PHYS_UNIT "Bit Mask" /end CHARACTERISTIC
/begin CHARACTERISTIC FPnd_APUD18_max "FPrm_pending(286)" VALUE 0x001E534E /* @ECU_Address@FPrm_pending@0x021BE23C@ */ ECIPP_ALIGNMENT_UWORD 65535 Compu_IDENTITY 0 65535 PHYS_UNIT "Bit Mask" /end CHARACTERISTIC
/begin CHARACTERISTIC FPnd_APUD18_min "FPrm_pending(287)" VALUE 0x001E5350 /* @ECU_Address@FPrm_pending@0x021BE23E@ */ ECIPP_ALIGNMENT_UWORD 65535 Compu_IDENTITY 0 65535 PHYS_UNIT "Bit Mask" /end CHARACTERISTIC
/begin CHARACTERISTIC FPnd_APUD19_max "FPrm_pending(288)" VALUE 0x001E5352 /* @ECU_Address@FPrm_pending@0x021BE240@ */ ECIPP_ALIGNMENT_UWORD 65535 Compu_IDENTITY 0 65535 PHYS_UNIT "Bit Mask" /end CHARACTERISTIC
/begin CHARACTERISTIC FPnd_APUD19_min "FPrm_pending(289)" VALUE 0x001E5354 /* @ECU_Address@FPrm_pending@0x021BE242@ */ ECIPP_ALIGNMENT_UWORD 65535 Compu_IDENTITY 0 65535 PHYS_UNIT "Bit Mask" /end CHARACTERISTIC
/begin CHARACTERISTIC FPsvr_ADIG22_min "FPrm_severity(443)" VALUE 0x001E69D0 /* @ECU_Address@FPrm_severity@0x024B31BB@ */ ECIPP_ALIGNMENT_UBYTE 255 Compu_IDENTITY 0 255 PHYS_UNIT "Severity+Class" /end CHARACTERISTIC
/begin CHARACTERISTIC FPsvr_ADIG23_max "FPrm_severity(444)" VALUE 0x001E69D1 /* @ECU_Address@FPrm_severity@0x024B31BC@ */ ECIPP_ALIGNMENT_UBYTE 255 Compu_IDENTITY 0 255 PHYS_UNIT "Severity+Class" /end CHARACTERISTIC
/begin CHARACTERISTIC FPsvr_ADIG23_min "FPrm_severity(445)" VALUE 0x001E69D2 /* @ECU_Address@FPrm_severity@0x024B31BD@ */ ECIPP_ALIGNMENT_UBYTE 255 Compu_IDENTITY 0 255 PHYS_UNIT "Severity+Class" /end CHARACTERISTIC
/begin CHARACTERISTIC FPsvr_ADIG24_max "FPrm_severity(446)" VALUE 0x001E69D3 /* @ECU_Address@FPrm_severity@0x024B31BE@ */ ECIPP_ALIGNMENT_UBYTE 255 Compu_IDENTITY 0 255 PHYS_UNIT "Severity+Class" /end CHARACTERISTIC
/begin CHARACTERISTIC FPsvr_ADIG24_min "FPrm_severity(447)" VALUE 0x001E69D4 /* @ECU_Address@FPrm_severity@0x024B31BF@ */ ECIPP_ALIGNMENT_UBYTE 255 Compu_IDENTITY 0 255 PHYS_UNIT "Severity+Class" /end CHARACTERISTIC
/begin CHARACTERISTIC FPsvr_ADIG25_max "FPrm_severity(448)" VALUE 0x001E69D5 /* @ECU_Address@FPrm_severity@0x024B31C0@ */ ECIPP_ALIGNMENT_UBYTE 255 Compu_IDENTITY 0 255 PHYS_UNIT "Severity+Class" /end CHARACTERISTIC
/begin CHARACTERISTIC FPsvr_ADIG25_min "FPrm_severity(449)" VALUE 0x001E69D6 /* @ECU_Address@FPrm_severity@0x024B31C1@ */ ECIPP_ALIGNMENT_UBYTE 255 Compu_IDENTITY 0 255 PHYS_UNIT "Severity+Class" /end CHARACTERISTIC
/begin CHARACTERISTIC FPsvr_ADIG3_max "FPrm_severity(169)" VALUE 0x001E68BE /* @ECU_Address@FPrm_severity@0x024B30A9@ */ ECIPP_ALIGNMENT_UBYTE 255 Compu_IDENTITY 0 255 PHYS_UNIT "Severity+Class" /end CHARACTERISTIC
/begin CHARACTERISTIC FPsvr_ADIG3_min "FPrm_severity(170)" VALUE 0x001E68BF /* @ECU_Address@FPrm_severity@0x024B30AA@ */ ECIPP_ALIGNMENT_UBYTE 255 Compu_IDENTITY 0 255 PHYS_UNIT "Severity+Class" /end CHARACTERISTIC
/begin CHARACTERISTIC FPsvr_ADIG4_max "FPrm_severity(246)" VALUE 0x001E690B /* @ECU_Address@FPrm_severity@0x024B30F6@ */ ECIPP_ALIGNMENT_UBYTE 255 Compu_IDENTITY 0 255 PHYS_UNIT "Severity+Class" /end CHARACTERISTIC
/begin CHARACTERISTIC FPsvr_ADIG4_min "FPrm_severity(247)" VALUE 0x001E690C /* @ECU_Address@FPrm_severity@0x024B30F7@ */ ECIPP_ALIGNMENT_UBYTE 255 Compu_IDENTITY 0 255 PHYS_UNIT "Severity+Class" /end CHARACTERISTIC
/begin CHARACTERISTIC FPsvr_ADIG5_max "FPrm_severity(248)" VALUE 0x001E690D /* @ECU_Address@FPrm_severity@0x024B30F8@ */ ECIPP_ALIGNMENT_UBYTE 255 Compu_IDENTITY 0 255 PHYS_UNIT "Severity+Class" /end CHARACTERISTIC
/begin CHARACTERISTIC FPsvr_ADIG5_min "FPrm_severity(249)" VALUE 0x001E690E /* @ECU_Address@FPrm_severity@0x024B30F9@ */ ECIPP_ALIGNMENT_UBYTE 255 Compu_IDENTITY 0 255 PHYS_UNIT "Severity+Class" /end CHARACTERISTIC
/begin CHARACTERISTIC FPsvr_ADIG6_max "FPrm_severity(250)" VALUE 0x001E690F /* @ECU_Address@FPrm_severity@0x024B30FA@ */ ECIPP_ALIGNMENT_UBYTE 255 Compu_IDENTITY 0 255 PHYS_UNIT "Severity+Class" /end CHARACTERISTIC
/begin CHARACTERISTIC FPsvr_ADIG6_min "FPrm_severity(251)" VALUE 0x001E6910 /* @ECU_Address@FPrm_severity@0x024B30FB@ */ ECIPP_ALIGNMENT_UBYTE 255 Compu_IDENTITY 0 255 PHYS_UNIT "Severity+Class" /end CHARACTERISTIC
/begin CHARACTERISTIC FPsvr_ADIG7_max "FPrm_severity(252)" VALUE 0x001E6911 /* @ECU_Address@FPrm_severity@0x024B30FC@ */ ECIPP_ALIGNMENT_UBYTE 255 Compu_IDENTITY 0 255 PHYS_UNIT "Severity+Class" /end CHARACTERISTIC
/begin CHARACTERISTIC FPsvr_ADIG7_min "FPrm_severity(253)" VALUE 0x001E6912 /* @ECU_Address@FPrm_severity@0x024B30FD@ */ ECIPP_ALIGNMENT_UBYTE 255 Compu_IDENTITY 0 255 PHYS_UNIT "Severity+Class" /end CHARACTERISTIC
/begin CHARACTERISTIC FPsvr_ADIG8_max "FPrm_severity(254)" VALUE 0x001E6913 /* @ECU_Address@FPrm_severity@0x024B30FE@ */ ECIPP_ALIGNMENT_UBYTE 255 Compu_IDENTITY 0 255 PHYS_UNIT "Severity+Class" /end CHARACTERISTIC
/begin CHARACTERISTIC FPsvr_ADIG8_min "FPrm_severity(255)" VALUE 0x001E6914 /* @ECU_Address@FPrm_severity@0x024B30FF@ */ ECIPP_ALIGNMENT_UBYTE 255 Compu_IDENTITY 0 255 PHYS_UNIT "Severity+Class" /end CHARACTERISTIC
/begin CHARACTERISTIC FPsvr_ADIG9_max "FPrm_severity(256)" VALUE 0x001E6915 /* @ECU_Address@FPrm_severity@0x024B3100@ */ ECIPP_ALIGNMENT_UBYTE 255 Compu_IDENTITY 0 255 PHYS_UNIT "Severity+Class" /end CHARACTERISTIC
/begin CHARACTERISTIC FPsvr_ADIG9_min "FPrm_severity(257)" VALUE 0x001E6916 /* @ECU_Address@FPrm_severity@0x024B3101@ */ ECIPP_ALIGNMENT_UBYTE 255 Compu_IDENTITY 0 255 PHYS_UNIT "Severity+Class" /end CHARACTERISTIC
/begin CHARACTERISTIC FPsvr_ADloss "FPrm_severity(67)" VALUE 0x001E6858 /* @ECU_Address@FPrm_severity@0x024B3043@ */ ECIPP_ALIGNMENT_UBYTE 255 Compu_IDENTITY 0 255 PHYS_UNIT "Severity+Class" /end CHARACTERISTIC
/begin CHARACTERISTIC FPsvr_AFILT_dP_high "FPrm_severity(562)" VALUE 0x001E6A47 /* @ECU_Address@FPrm_severity@0x024B3232@ */ ECIPP_ALIGNMENT_UBYTE 255 Compu_IDENTITY 0 255 PHYS_UNIT "Severity+Class" /end CHARACTERISTIC
/begin CHARACTERISTIC FPsvr_AL_hi "FPrm_severity(41)" VALUE 0x001E683E /* @ECU_Address@FPrm_severity@0x024B3029@ */ ECIPP_ALIGNMENT_UBYTE 255 Compu_IDENTITY 0 255 PHYS_UNIT "Severity+Class" /end CHARACTERISTIC
/begin CHARACTERISTIC FPsvr_AL_lo "FPrm_severity(42)" VALUE 0x001E683F /* @ECU_Address@FPrm_severity@0x024B302A@ */ ECIPP_ALIGNMENT_UBYTE 255 Compu_IDENTITY 0 255 PHYS_UNIT "Severity+Class" /end CHARACTERISTIC
/begin CHARACTERISTIC FPsvr_ALLP_hi "FPrm_severity(43)" VALUE 0x001E6840 /* @ECU_Address@FPrm_severity@0x024B302B@ */ ECIPP_ALIGNMENT_UBYTE 255 Compu_IDENTITY 0 255 PHYS_UNIT "Severity+Class" /end CHARACTERISTIC
/begin CHARACTERISTIC FPsvr_ALLP_lo "FPrm_severity(44)" VALUE 0x001E6841 /* @ECU_Address@FPrm_severity@0x024B302C@ */ ECIPP_ALIGNMENT_UBYTE 255 Compu_IDENTITY 0 255 PHYS_UNIT "Severity+Class" /end CHARACTERISTIC
/begin CHARACTERISTIC FPsvr_ALNG_hi "FPrm_severity(45)" VALUE 0x001E6842 /* @ECU_Address@FPrm_severity@0x024B302D@ */ ECIPP_ALIGNMENT_UBYTE 255 Compu_IDENTITY 0 255 PHYS_UNIT "Severity+Class" /end CHARACTERISTIC
/begin CHARACTERISTIC FPsvr_ALNG_lo "FPrm_severity(46)" VALUE 0x001E6843 /* @ECU_Address@FPrm_severity@0x024B302E@ */ ECIPP_ALIGNMENT_UBYTE 255 Compu_IDENTITY 0 255 PHYS_UNIT "Severity+Class" /end CHARACTERISTIC
/begin CHARACTERISTIC FPsvr_APD1_max "FPrm_severity(75)" VALUE 0x001E6860 /* @ECU_Address@FPrm_severity@0x024B304B@ */ ECIPP_ALIGNMENT_UBYTE 255 Compu_IDENTITY 0 255 PHYS_UNIT "Severity+Class" /end CHARACTERISTIC
/begin CHARACTERISTIC FPsvr_APD1_min "FPrm_severity(76)" VALUE 0x001E6861 /* @ECU_Address@FPrm_severity@0x024B304C@ */ ECIPP_ALIGNMENT_UBYTE 255 Compu_IDENTITY 0 255 PHYS_UNIT "Severity+Class" /end CHARACTERISTIC
/begin CHARACTERISTIC FPsvr_APD2_max "FPrm_severity(181)" VALUE 0x001E68CA /* @ECU_Address@FPrm_severity@0x024B30B5@ */ ECIPP_ALIGNMENT_UBYTE 255 Compu_IDENTITY 0 255 PHYS_UNIT "Severity+Class" /end CHARACTERISTIC
/begin CHARACTERISTIC FPsvr_APD2_min "FPrm_severity(182)" VALUE 0x001E68CB /* @ECU_Address@FPrm_severity@0x024B30B6@ */ ECIPP_ALIGNMENT_UBYTE 255 Compu_IDENTITY 0 255 PHYS_UNIT "Severity+Class" /end CHARACTERISTIC
/begin CHARACTERISTIC FPsvr_APD3_max "FPrm_severity(183)" VALUE 0x001E68CC /* @ECU_Address@FPrm_severity@0x024B30B7@ */ ECIPP_ALIGNMENT_UBYTE 255 Compu_IDENTITY 0 255 PHYS_UNIT "Severity+Class" /end CHARACTERISTIC
/begin CHARACTERISTIC FPsvr_APD3_min "FPrm_severity(184)" VALUE 0x001E68CD /* @ECU_Address@FPrm_severity@0x024B30B8@ */ ECIPP_ALIGNMENT_UBYTE 255 Compu_IDENTITY 0 255 PHYS_UNIT "Severity+Class" /end CHARACTERISTIC
/begin CHARACTERISTIC FPsvr_APS1_max "FPrm_severity(362)" VALUE 0x001E697F /* @ECU_Address@FPrm_severity@0x024B316A@ */ ECIPP_ALIGNMENT_UBYTE 255 Compu_IDENTITY 0 255 PHYS_UNIT "Severity+Class" /end CHARACTERISTIC
/begin CHARACTERISTIC FPsvr_APS1_min "FPrm_severity(363)" VALUE 0x001E6980 /* @ECU_Address@FPrm_severity@0x024B316B@ */ ECIPP_ALIGNMENT_UBYTE 255 Compu_IDENTITY 0 255 PHYS_UNIT "Severity+Class" /end CHARACTERISTIC
/begin CHARACTERISTIC FPsvr_APS12_OOR "FPrm_severity(370)" VALUE 0x001E6987 /* @ECU_Address@FPrm_severity@0x024B3172@ */ ECIPP_ALIGNMENT_UBYTE 255 Compu_IDENTITY 0 255 PHYS_UNIT "Severity+Class" /end CHARACTERISTIC
/begin CHARACTERISTIC FPsvr_APS12pct_hi "FPrm_severity(366)" VALUE 0x001E6983 /* @ECU_Address@FPrm_severity@0x024B316E@ */ ECIPP_ALIGNMENT_UBYTE 255 Compu_IDENTITY 0 255 PHYS_UNIT "Severity+Class" /end CHARACTERISTIC
/begin CHARACTERISTIC FPsvr_APS12pct_lo "FPrm_severity(367)" VALUE 0x001E6984 /* @ECU_Address@FPrm_severity@0x024B316F@ */ ECIPP_ALIGNMENT_UBYTE 255 Compu_IDENTITY 0 255 PHYS_UNIT "Severity+Class" /end CHARACTERISTIC
/begin CHARACTERISTIC FPsvr_APS2_max "FPrm_severity(364)" VALUE 0x001E6981 /* @ECU_Address@FPrm_severity@0x024B316C@ */ ECIPP_ALIGNMENT_UBYTE 255 Compu_IDENTITY 0 255 PHYS_UNIT "Severity+Class" /end CHARACTERISTIC
/begin CHARACTERISTIC FPsvr_APS2_min "FPrm_severity(365)" VALUE 0x001E6982 /* @ECU_Address@FPrm_severity@0x024B316D@ */ ECIPP_ALIGNMENT_UBYTE 255 Compu_IDENTITY 0 255 PHYS_UNIT "Severity+Class" /end CHARACTERISTIC
/begin CHARACTERISTIC FPsvr_APSerr_neg "FPrm_severity(369)" VALUE 0x001E6986 /* @ECU_Address@FPrm_severity@0x024B3171@ */ ECIPP_ALIGNMENT_UBYTE 255 Compu_IDENTITY 0 255 PHYS_UNIT "Severity+Class" /end CHARACTERISTIC
/begin CHARACTERISTIC FPsvr_APSerr_pos "FPrm_severity(368)" VALUE 0x001E6985 /* @ECU_Address@FPrm_severity@0x024B3170@ */ ECIPP_ALIGNMENT_UBYTE 255 Compu_IDENTITY 0 255 PHYS_UNIT "Severity+Class" /end CHARACTERISTIC
/begin CHARACTERISTIC FPsvr_APU1_max "FPrm_severity(77)" VALUE 0x001E6862 /* @ECU_Address@FPrm_severity@0x024B304D@ */ ECIPP_ALIGNMENT_UBYTE 255 Compu_IDENTITY 0 255 PHYS_UNIT "Severity+Class" /end CHARACTERISTIC
/begin CHARACTERISTIC FPsvr_APU1_min "FPrm_severity(78)" VALUE 0x001E6863 /* @ECU_Address@FPrm_severity@0x024B304E@ */ ECIPP_ALIGNMENT_UBYTE 255 Compu_IDENTITY 0 255 PHYS_UNIT "Severity+Class" /end CHARACTERISTIC
/begin CHARACTERISTIC FPsvr_APU2_max "FPrm_severity(79)" VALUE 0x001E6864 /* @ECU_Address@FPrm_severity@0x024B304F@ */ ECIPP_ALIGNMENT_UBYTE 255 Compu_IDENTITY 0 255 PHYS_UNIT "Severity+Class" /end CHARACTERISTIC
/begin CHARACTERISTIC FPsvr_APU2_min "FPrm_severity(80)" VALUE 0x001E6865 /* @ECU_Address@FPrm_severity@0x024B3050@ */ ECIPP_ALIGNMENT_UBYTE 255 Compu_IDENTITY 0 255 PHYS_UNIT "Severity+Class" /end CHARACTERISTIC
/begin CHARACTERISTIC FPsvr_APU3_max "FPrm_severity(157)" VALUE 0x001E68B2 /* @ECU_Address@FPrm_severity@0x024B309D@ */ ECIPP_ALIGNMENT_UBYTE 255 Compu_IDENTITY 0 255 PHYS_UNIT "Severity+Class" /end CHARACTERISTIC
/begin CHARACTERISTIC FPsvr_APU3_min "FPrm_severity(158)" VALUE 0x001E68B3 /* @ECU_Address@FPrm_severity@0x024B309E@ */ ECIPP_ALIGNMENT_UBYTE 255 Compu_IDENTITY 0 255 PHYS_UNIT "Severity+Class" /end CHARACTERISTIC
/begin CHARACTERISTIC FPsvr_APUD1_max "FPrm_severity(159)" VALUE 0x001E68B4 /* @ECU_Address@FPrm_severity@0x024B309F@ */ ECIPP_ALIGNMENT_UBYTE 255 Compu_IDENTITY 0 255 PHYS_UNIT "Severity+Class" /end CHARACTERISTIC
/begin CHARACTERISTIC FPsvr_APUD1_min "FPrm_severity(160)" VALUE 0x001E68B5 /* @ECU_Address@FPrm_severity@0x024B30A0@ */ ECIPP_ALIGNMENT_UBYTE 255 Compu_IDENTITY 0 255 PHYS_UNIT "Severity+Class" /end CHARACTERISTIC
/begin CHARACTERISTIC FPsvr_APUD10_max "FPrm_severity(270)" VALUE 0x001E6923 /* @ECU_Address@FPrm_severity@0x024B310E@ */ ECIPP_ALIGNMENT_UBYTE 255 Compu_IDENTITY 0 255 PHYS_UNIT "Severity+Class" /end CHARACTERISTIC
/begin CHARACTERISTIC FPsvr_APUD10_min "FPrm_severity(271)" VALUE 0x001E6924 /* @ECU_Address@FPrm_severity@0x024B310F@ */ ECIPP_ALIGNMENT_UBYTE 255 Compu_IDENTITY 0 255 PHYS_UNIT "Severity+Class" /end CHARACTERISTIC
/begin CHARACTERISTIC FPsvr_APUD11_max "FPrm_severity(272)" VALUE 0x001E6925 /* @ECU_Address@FPrm_severity@0x024B3110@ */ ECIPP_ALIGNMENT_UBYTE 255 Compu_IDENTITY 0 255 PHYS_UNIT "Severity+Class" /end CHARACTERISTIC
/begin CHARACTERISTIC FPsvr_APUD11_min "FPrm_severity(273)" VALUE 0x001E6926 /* @ECU_Address@FPrm_severity@0x024B3111@ */ ECIPP_ALIGNMENT_UBYTE 255 Compu_IDENTITY 0 255 PHYS_UNIT "Severity+Class" /end CHARACTERISTIC
/begin CHARACTERISTIC FPsvr_APUD12_max "FPrm_severity(274)" VALUE 0x001E6927 /* @ECU_Address@FPrm_severity@0x024B3112@ */ ECIPP_ALIGNMENT_UBYTE 255 Compu_IDENTITY 0 255 PHYS_UNIT "Severity+Class" /end CHARACTERISTIC
/begin CHARACTERISTIC FPsvr_APUD12_min "FPrm_severity(275)" VALUE 0x001E6928 /* @ECU_Address@FPrm_severity@0x024B3113@ */ ECIPP_ALIGNMENT_UBYTE 255 Compu_IDENTITY 0 255 PHYS_UNIT "Severity+Class" /end CHARACTERISTIC
/begin CHARACTERISTIC FPsvr_APUD13_max "FPrm_severity(276)" VALUE 0x001E6929 /* @ECU_Address@FPrm_severity@0x024B3114@ */ ECIPP_ALIGNMENT_UBYTE 255 Compu_IDENTITY 0 255 PHYS_UNIT "Severity+Class" /end CHARACTERISTIC
/begin CHARACTERISTIC FPsvr_APUD13_min "FPrm_severity(277)" VALUE 0x001E692A /* @ECU_Address@FPrm_severity@0x024B3115@ */ ECIPP_ALIGNMENT_UBYTE 255 Compu_IDENTITY 0 255 PHYS_UNIT "Severity+Class" /end CHARACTERISTIC
/begin CHARACTERISTIC FPsvr_APUD14_max "FPrm_severity(278)" VALUE 0x001E692B /* @ECU_Address@FPrm_severity@0x024B3116@ */ ECIPP_ALIGNMENT_UBYTE 255 Compu_IDENTITY 0 255 PHYS_UNIT "Severity+Class" /end CHARACTERISTIC
/begin CHARACTERISTIC FPsvr_APUD14_min "FPrm_severity(279)" VALUE 0x001E692C /* @ECU_Address@FPrm_severity@0x024B3117@ */ ECIPP_ALIGNMENT_UBYTE 255 Compu_IDENTITY 0 255 PHYS_UNIT "Severity+Class" /end CHARACTERISTIC
/begin CHARACTERISTIC FPsvr_APUD15_max "FPrm_severity(280)" VALUE 0x001E692D /* @ECU_Address@FPrm_severity@0x024B3118@ */ ECIPP_ALIGNMENT_UBYTE 255 Compu_IDENTITY 0 255 PHYS_UNIT "Severity+Class" /end CHARACTERISTIC
/begin CHARACTERISTIC FPsvr_APUD15_min "FPrm_severity(281)" VALUE 0x001E692E /* @ECU_Address@FPrm_severity@0x024B3119@ */ ECIPP_ALIGNMENT_UBYTE 255 Compu_IDENTITY 0 255 PHYS_UNIT "Severity+Class" /end CHARACTERISTIC
/begin CHARACTERISTIC FPsvr_APUD16_max "FPrm_severity(282)" VALUE 0x001E692F /* @ECU_Address@FPrm_severity@0x024B311A@ */ ECIPP_ALIGNMENT_UBYTE 255 Compu_IDENTITY 0 255 PHYS_UNIT "Severity+Class" /end CHARACTERISTIC
/begin CHARACTERISTIC FPsvr_APUD16_min "FPrm_severity(283)" VALUE 0x001E6930 /* @ECU_Address@FPrm_severity@0x024B311B@ */ ECIPP_ALIGNMENT_UBYTE 255 Compu_IDENTITY 0 255 PHYS_UNIT "Severity+Class" /end CHARACTERISTIC
/begin CHARACTERISTIC FPsvr_APUD17_max "FPrm_severity(284)" VALUE 0x001E6931 /* @ECU_Address@FPrm_severity@0x024B311C@ */ ECIPP_ALIGNMENT_UBYTE 255 Compu_IDENTITY 0 255 PHYS_UNIT "Severity+Class" /end CHARACTERISTIC
/begin CHARACTERISTIC FPsvr_APUD17_min "FPrm_severity(285)" VALUE 0x001E6932 /* @ECU_Address@FPrm_severity@0x024B311D@ */ ECIPP_ALIGNMENT_UBYTE 255 Compu_IDENTITY 0 255 PHYS_UNIT "Severity+Class" /end CHARACTERISTIC
/begin CHARACTERISTIC FPsvr_APUD18_max "FPrm_severity(286)" VALUE 0x001E6933 /* @ECU_Address@FPrm_severity@0x024B311E@ */ ECIPP_ALIGNMENT_UBYTE 255 Compu_IDENTITY 0 255 PHYS_UNIT "Severity+Class" /end CHARACTERISTIC
/begin CHARACTERISTIC FPsvr_APUD18_min "FPrm_severity(287)" VALUE 0x001E6934 /* @ECU_Address@FPrm_severity@0x024B311F@ */ ECIPP_ALIGNMENT_UBYTE 255 Compu_IDENTITY 0 255 PHYS_UNIT "Severity+Class" /end CHARACTERISTIC
/begin CHARACTERISTIC FPsvr_APUD19_max "FPrm_severity(288)" VALUE 0x001E6935 /* @ECU_Address@FPrm_severity@0x024B3120@ */ ECIPP_ALIGNMENT_UBYTE 255 Compu_IDENTITY 0 255 PHYS_UNIT "Severity+Class" /end CHARACTERISTIC
/begin CHARACTERISTIC FPsvr_APUD19_min "FPrm_severity(289)" VALUE 0x001E6936 /* @ECU_Address@FPrm_severity@0x024B3121@ */ ECIPP_ALIGNMENT_UBYTE 255 Compu_IDENTITY 0 255 PHYS_UNIT "Severity+Class" /end CHARACTERISTIC
/begin CHARACTERISTIC FPsw_ADIG22_min "FPrm_switches(443)" VALUE 0x001C7350 /* @ECU_Address@FPrm_switches@0x021B9376@ */ ECIPP_ALIGNMENT_UWORD 65535 Compu_IDENTITY 0 65535 PHYS_UNIT "Enable bits" /end CHARACTERISTIC
/begin CHARACTERISTIC FPsw_ADIG23_max "FPrm_switches(444)" VALUE 0x001C7352 /* @ECU_Address@FPrm_switches@0x021B9378@ */ ECIPP_ALIGNMENT_UWORD 65535 Compu_IDENTITY 0 65535 PHYS_UNIT "Enable bits" /end CHARACTERISTIC
/begin CHARACTERISTIC FPsw_ADIG23_min "FPrm_switches(445)" VALUE 0x001C7354 /* @ECU_Address@FPrm_switches@0x021B937A@ */ ECIPP_ALIGNMENT_UWORD 65535 Compu_IDENTITY 0 65535 PHYS_UNIT "Enable bits" /end CHARACTERISTIC
/begin CHARACTERISTIC FPsw_ADIG24_max "FPrm_switches(446)" VALUE 0x001C7356 /* @ECU_Address@FPrm_switches@0x021B937C@ */ ECIPP_ALIGNMENT_UWORD 65535 Compu_IDENTITY 0 65535 PHYS_UNIT "Enable bits" /end CHARACTERISTIC
/begin CHARACTERISTIC FPsw_ADIG24_min "FPrm_switches(447)" VALUE 0x001C7358 /* @ECU_Address@FPrm_switches@0x021B937E@ */ ECIPP_ALIGNMENT_UWORD 65535 Compu_IDENTITY 0 65535 PHYS_UNIT "Enable bits" /end CHARACTERISTIC
/begin CHARACTERISTIC FPsw_ADIG25_max "FPrm_switches(448)" VALUE 0x001C735A /* @ECU_Address@FPrm_switches@0x021B9380@ */ ECIPP_ALIGNMENT_UWORD 65535 Compu_IDENTITY 0 65535 PHYS_UNIT "Enable bits" /end CHARACTERISTIC
/begin CHARACTERISTIC FPsw_ADIG25_min "FPrm_switches(449)" VALUE 0x001C735C /* @ECU_Address@FPrm_switches@0x021B9382@ */ ECIPP_ALIGNMENT_UWORD 65535 Compu_IDENTITY 0 65535 PHYS_UNIT "Enable bits" /end CHARACTERISTIC
/begin CHARACTERISTIC FPsw_ADIG3_max "FPrm_switches(169)" VALUE 0x001C712C /* @ECU_Address@FPrm_switches@0x021B9152@ */ ECIPP_ALIGNMENT_UWORD 65535 Compu_IDENTITY 0 65535 PHYS_UNIT "Enable bits" /end CHARACTERISTIC
/begin CHARACTERISTIC FPsw_ADIG3_min "FPrm_switches(170)" VALUE 0x001C712E /* @ECU_Address@FPrm_switches@0x021B9154@ */ ECIPP_ALIGNMENT_UWORD 65535 Compu_IDENTITY 0 65535 PHYS_UNIT "Enable bits" /end CHARACTERISTIC
/begin CHARACTERISTIC FPsw_ADIG4_max "FPrm_switches(246)" VALUE 0x001C71C6 /* @ECU_Address@FPrm_switches@0x021B91EC@ */ ECIPP_ALIGNMENT_UWORD 65535 Compu_IDENTITY 0 65535 PHYS_UNIT "Enable bits" /end CHARACTERISTIC
/begin CHARACTERISTIC FPsw_ADIG4_min "FPrm_switches(247)" VALUE 0x001C71C8 /* @ECU_Address@FPrm_switches@0x021B91EE@ */ ECIPP_ALIGNMENT_UWORD 65535 Compu_IDENTITY 0 65535 PHYS_UNIT "Enable bits" /end CHARACTERISTIC
/begin CHARACTERISTIC FPsw_ADIG5_max "FPrm_switches(248)" VALUE 0x001C71CA /* @ECU_Address@FPrm_switches@0x021B91F0@ */ ECIPP_ALIGNMENT_UWORD 65535 Compu_IDENTITY 0 65535 PHYS_UNIT "Enable bits" /end CHARACTERISTIC
/begin CHARACTERISTIC FPsw_ADIG5_min "FPrm_switches(249)" VALUE 0x001C71CC /* @ECU_Address@FPrm_switches@0x021B91F2@ */ ECIPP_ALIGNMENT_UWORD 65535 Compu_IDENTITY 0 65535 PHYS_UNIT "Enable bits" /end CHARACTERISTIC
/begin CHARACTERISTIC FPsw_ADIG6_max "FPrm_switches(250)" VALUE 0x001C71CE /* @ECU_Address@FPrm_switches@0x021B91F4@ */ ECIPP_ALIGNMENT_UWORD 65535 Compu_IDENTITY 0 65535 PHYS_UNIT "Enable bits" /end CHARACTERISTIC
/begin CHARACTERISTIC FPsw_ADIG6_min "FPrm_switches(251)" VALUE 0x001C71D0 /* @ECU_Address@FPrm_switches@0x021B91F6@ */ ECIPP_ALIGNMENT_UWORD 65535 Compu_IDENTITY 0 65535 PHYS_UNIT "Enable bits" /end CHARACTERISTIC
/begin CHARACTERISTIC FPsw_ADIG7_max "FPrm_switches(252)" VALUE 0x001C71D2 /* @ECU_Address@FPrm_switches@0x021B91F8@ */ ECIPP_ALIGNMENT_UWORD 65535 Compu_IDENTITY 0 65535 PHYS_UNIT "Enable bits" /end CHARACTERISTIC
/begin CHARACTERISTIC FPsw_ADIG7_min "FPrm_switches(253)" VALUE 0x001C71D4 /* @ECU_Address@FPrm_switches@0x021B91FA@ */ ECIPP_ALIGNMENT_UWORD 65535 Compu_IDENTITY 0 65535 PHYS_UNIT "Enable bits" /end CHARACTERISTIC
/begin CHARACTERISTIC FPsw_ADIG8_max "FPrm_switches(254)" VALUE 0x001C71D6 /* @ECU_Address@FPrm_switches@0x021B91FC@ */ ECIPP_ALIGNMENT_UWORD 65535 Compu_IDENTITY 0 65535 PHYS_UNIT "Enable bits" /end CHARACTERISTIC
/begin CHARACTERISTIC FPsw_ADIG8_min "FPrm_switches(255)" VALUE 0x001C71D8 /* @ECU_Address@FPrm_switches@0x021B91FE@ */ ECIPP_ALIGNMENT_UWORD 65535 Compu_IDENTITY 0 65535 PHYS_UNIT "Enable bits" /end CHARACTERISTIC
/begin CHARACTERISTIC FPsw_ADIG9_max "FPrm_switches(256)" VALUE 0x001C71DA /* @ECU_Address@FPrm_switches@0x021B9200@ */ ECIPP_ALIGNMENT_UWORD 65535 Compu_IDENTITY 0 65535 PHYS_UNIT "Enable bits" /end CHARACTERISTIC
/begin CHARACTERISTIC FPsw_ADIG9_min "FPrm_switches(257)" VALUE 0x001C71DC /* @ECU_Address@FPrm_switches@0x021B9202@ */ ECIPP_ALIGNMENT_UWORD 65535 Compu_IDENTITY 0 65535 PHYS_UNIT "Enable bits" /end CHARACTERISTIC
/begin CHARACTERISTIC FPsw_ADloss "FPrm_switches(67)" VALUE 0x001C7060 /* @ECU_Address@FPrm_switches@0x021B9086@ */ ECIPP_ALIGNMENT_UWORD 65535 Compu_IDENTITY 0 65535 PHYS_UNIT "Enable bits" /end CHARACTERISTIC
/begin CHARACTERISTIC FPsw_AFILT_dP_high "FPrm_switches(562)" VALUE 0x001C743E /* @ECU_Address@FPrm_switches@0x021B9464@ */ ECIPP_ALIGNMENT_UWORD 65535 Compu_IDENTITY 0 65535 PHYS_UNIT "Enable bits" /end CHARACTERISTIC
/begin CHARACTERISTIC FPsw_AL_hi "FPrm_switches(41)" VALUE 0x001C702C /* @ECU_Address@FPrm_switches@0x021B9052@ */ ECIPP_ALIGNMENT_UWORD 65535 Compu_IDENTITY 0 65535 PHYS_UNIT "Enable bits" /end CHARACTERISTIC
/begin CHARACTERISTIC FPsw_AL_lo "FPrm_switches(42)" VALUE 0x001C702E /* @ECU_Address@FPrm_switches@0x021B9054@ */ ECIPP_ALIGNMENT_UWORD 65535 Compu_IDENTITY 0 65535 PHYS_UNIT "Enable bits" /end CHARACTERISTIC
/begin CHARACTERISTIC FPsw_ALLP_hi "FPrm_switches(43)" VALUE 0x001C7030 /* @ECU_Address@FPrm_switches@0x021B9056@ */ ECIPP_ALIGNMENT_UWORD 65535 Compu_IDENTITY 0 65535 PHYS_UNIT "Enable bits" /end CHARACTERISTIC
/begin CHARACTERISTIC FPsw_ALLP_lo "FPrm_switches(44)" VALUE 0x001C7032 /* @ECU_Address@FPrm_switches@0x021B9058@ */ ECIPP_ALIGNMENT_UWORD 65535 Compu_IDENTITY 0 65535 PHYS_UNIT "Enable bits" /end CHARACTERISTIC
/begin CHARACTERISTIC FPsw_ALNG_hi "FPrm_switches(45)" VALUE 0x001C7034 /* @ECU_Address@FPrm_switches@0x021B905A@ */ ECIPP_ALIGNMENT_UWORD 65535 Compu_IDENTITY 0 65535 PHYS_UNIT "Enable bits" /end CHARACTERISTIC
/begin CHARACTERISTIC FPsw_ALNG_lo "FPrm_switches(46)" VALUE 0x001C7036 /* @ECU_Address@FPrm_switches@0x021B905C@ */ ECIPP_ALIGNMENT_UWORD 65535 Compu_IDENTITY 0 65535 PHYS_UNIT "Enable bits" /end CHARACTERISTIC
/begin CHARACTERISTIC FPsw_APD1_max "FPrm_switches(75)" VALUE 0x001C7070 /* @ECU_Address@FPrm_switches@0x021B9096@ */ ECIPP_ALIGNMENT_UWORD 65535 Compu_IDENTITY 0 65535 PHYS_UNIT "Enable bits" /end CHARACTERISTIC
/begin CHARACTERISTIC FPsw_APD1_min "FPrm_switches(76)" VALUE 0x001C7072 /* @ECU_Address@FPrm_switches@0x021B9098@ */ ECIPP_ALIGNMENT_UWORD 65535 Compu_IDENTITY 0 65535 PHYS_UNIT "Enable bits" /end CHARACTERISTIC
/begin CHARACTERISTIC FPsw_APD2_max "FPrm_switches(181)" VALUE 0x001C7144 /* @ECU_Address@FPrm_switches@0x021B916A@ */ ECIPP_ALIGNMENT_UWORD 65535 Compu_IDENTITY 0 65535 PHYS_UNIT "Enable bits" /end CHARACTERISTIC
/begin CHARACTERISTIC FPsw_APD2_min "FPrm_switches(182)" VALUE 0x001C7146 /* @ECU_Address@FPrm_switches@0x021B916C@ */ ECIPP_ALIGNMENT_UWORD 65535 Compu_IDENTITY 0 65535 PHYS_UNIT "Enable bits" /end CHARACTERISTIC
/begin CHARACTERISTIC FPsw_APD3_max "FPrm_switches(183)" VALUE 0x001C7148 /* @ECU_Address@FPrm_switches@0x021B916E@ */ ECIPP_ALIGNMENT_UWORD 65535 Compu_IDENTITY 0 65535 PHYS_UNIT "Enable bits" /end CHARACTERISTIC
/begin CHARACTERISTIC FPsw_APD3_min "FPrm_switches(184)" VALUE 0x001C714A /* @ECU_Address@FPrm_switches@0x021B9170@ */ ECIPP_ALIGNMENT_UWORD 65535 Compu_IDENTITY 0 65535 PHYS_UNIT "Enable bits" /end CHARACTERISTIC
/begin CHARACTERISTIC FPsw_APS1_max "FPrm_switches(362)" VALUE 0x001C72AE /* @ECU_Address@FPrm_switches@0x021B92D4@ */ ECIPP_ALIGNMENT_UWORD 65535 Compu_IDENTITY 0 65535 PHYS_UNIT "Enable bits" /end CHARACTERISTIC
/begin CHARACTERISTIC FPsw_APS1_min "FPrm_switches(363)" VALUE 0x001C72B0 /* @ECU_Address@FPrm_switches@0x021B92D6@ */ ECIPP_ALIGNMENT_UWORD 65535 Compu_IDENTITY 0 65535 PHYS_UNIT "Enable bits" /end CHARACTERISTIC
/begin CHARACTERISTIC FPsw_APS12_OOR "FPrm_switches(370)" VALUE 0x001C72BE /* @ECU_Address@FPrm_switches@0x021B92E4@ */ ECIPP_ALIGNMENT_UWORD 65535 Compu_IDENTITY 0 65535 PHYS_UNIT "Enable bits" /end CHARACTERISTIC
/begin CHARACTERISTIC FPsw_APS12pct_hi "FPrm_switches(366)" VALUE 0x001C72B6 /* @ECU_Address@FPrm_switches@0x021B92DC@ */ ECIPP_ALIGNMENT_UWORD 65535 Compu_IDENTITY 0 65535 PHYS_UNIT "Enable bits" /end CHARACTERISTIC
/begin CHARACTERISTIC FPsw_APS12pct_lo "FPrm_switches(367)" VALUE 0x001C72B8 /* @ECU_Address@FPrm_switches@0x021B92DE@ */ ECIPP_ALIGNMENT_UWORD 65535 Compu_IDENTITY 0 65535 PHYS_UNIT "Enable bits" /end CHARACTERISTIC
/begin CHARACTERISTIC FPsw_APS2_max "FPrm_switches(364)" VALUE 0x001C72B2 /* @ECU_Address@FPrm_switches@0x021B92D8@ */ ECIPP_ALIGNMENT_UWORD 65535 Compu_IDENTITY 0 65535 PHYS_UNIT "Enable bits" /end CHARACTERISTIC
/begin CHARACTERISTIC FPsw_APS2_min "FPrm_switches(365)" VALUE 0x001C72B4 /* @ECU_Address@FPrm_switches@0x021B92DA@ */ ECIPP_ALIGNMENT_UWORD 65535 Compu_IDENTITY 0 65535 PHYS_UNIT "Enable bits" /end CHARACTERISTIC
/begin CHARACTERISTIC FPsw_APSerr_neg "FPrm_switches(369)" VALUE 0x001C72BC /* @ECU_Address@FPrm_switches@0x021B92E2@ */ ECIPP_ALIGNMENT_UWORD 65535 Compu_IDENTITY 0 65535 PHYS_UNIT "Enable bits" /end CHARACTERISTIC
/begin CHARACTERISTIC FPsw_APSerr_pos "FPrm_switches(368)" VALUE 0x001C72BA /* @ECU_Address@FPrm_switches@0x021B92E0@ */ ECIPP_ALIGNMENT_UWORD 65535 Compu_IDENTITY 0 65535 PHYS_UNIT "Enable bits" /end CHARACTERISTIC
/begin CHARACTERISTIC FPsw_APU1_max "FPrm_switches(77)" VALUE 0x001C7074 /* @ECU_Address@FPrm_switches@0x021B909A@ */ ECIPP_ALIGNMENT_UWORD 65535 Compu_IDENTITY 0 65535 PHYS_UNIT "Enable bits" /end CHARACTERISTIC
/begin CHARACTERISTIC FPsw_APU1_min "FPrm_switches(78)" VALUE 0x001C7076 /* @ECU_Address@FPrm_switches@0x021B909C@ */ ECIPP_ALIGNMENT_UWORD 65535 Compu_IDENTITY 0 65535 PHYS_UNIT "Enable bits" /end CHARACTERISTIC
/begin CHARACTERISTIC FPsw_APU2_max "FPrm_switches(79)" VALUE 0x001C7078 /* @ECU_Address@FPrm_switches@0x021B909E@ */ ECIPP_ALIGNMENT_UWORD 65535 Compu_IDENTITY 0 65535 PHYS_UNIT "Enable bits" /end CHARACTERISTIC
/begin CHARACTERISTIC FPsw_APU2_min "FPrm_switches(80)" VALUE 0x001C707A /* @ECU_Address@FPrm_switches@0x021B90A0@ */ ECIPP_ALIGNMENT_UWORD 65535 Compu_IDENTITY 0 65535 PHYS_UNIT "Enable bits" /end CHARACTERISTIC
/begin CHARACTERISTIC FPsw_APU3_max "FPrm_switches(157)" VALUE 0x001C7114 /* @ECU_Address@FPrm_switches@0x021B913A@ */ ECIPP_ALIGNMENT_UWORD 65535 Compu_IDENTITY 0 65535 PHYS_UNIT "Enable bits" /end CHARACTERISTIC
/begin CHARACTERISTIC FPsw_APU3_min "FPrm_switches(158)" VALUE 0x001C7116 /* @ECU_Address@FPrm_switches@0x021B913C@ */ ECIPP_ALIGNMENT_UWORD 65535 Compu_IDENTITY 0 65535 PHYS_UNIT "Enable bits" /end CHARACTERISTIC
/begin CHARACTERISTIC FPsw_APUD1_max "FPrm_switches(159)" VALUE 0x001C7118 /* @ECU_Address@FPrm_switches@0x021B913E@ */ ECIPP_ALIGNMENT_UWORD 65535 Compu_IDENTITY 0 65535 PHYS_UNIT "Enable bits" /end CHARACTERISTIC
/begin CHARACTERISTIC FPsw_APUD1_min "FPrm_switches(160)" VALUE 0x001C711A /* @ECU_Address@FPrm_switches@0x021B9140@ */ ECIPP_ALIGNMENT_UWORD 65535 Compu_IDENTITY 0 65535 PHYS_UNIT "Enable bits" /end CHARACTERISTIC
/begin CHARACTERISTIC FPsw_APUD10_max "FPrm_switches(270)" VALUE 0x001C71F6 /* @ECU_Address@FPrm_switches@0x021B921C@ */ ECIPP_ALIGNMENT_UWORD 65535 Compu_IDENTITY 0 65535 PHYS_UNIT "Enable bits" /end CHARACTERISTIC
/begin CHARACTERISTIC FPsw_APUD10_min "FPrm_switches(271)" VALUE 0x001C71F8 /* @ECU_Address@FPrm_switches@0x021B921E@ */ ECIPP_ALIGNMENT_UWORD 65535 Compu_IDENTITY 0 65535 PHYS_UNIT "Enable bits" /end CHARACTERISTIC
/begin CHARACTERISTIC FPsw_APUD11_max "FPrm_switches(272)" VALUE 0x001C71FA /* @ECU_Address@FPrm_switches@0x021B9220@ */ ECIPP_ALIGNMENT_UWORD 65535 Compu_IDENTITY 0 65535 PHYS_UNIT "Enable bits" /end CHARACTERISTIC
/begin CHARACTERISTIC FPsw_APUD11_min "FPrm_switches(273)" VALUE 0x001C71FC /* @ECU_Address@FPrm_switches@0x021B9222@ */ ECIPP_ALIGNMENT_UWORD 65535 Compu_IDENTITY 0 65535 PHYS_UNIT "Enable bits" /end CHARACTERISTIC
/begin CHARACTERISTIC FPsw_APUD12_max "FPrm_switches(274)" VALUE 0x001C71FE /* @ECU_Address@FPrm_switches@0x021B9224@ */ ECIPP_ALIGNMENT_UWORD 65535 Compu_IDENTITY 0 65535 PHYS_UNIT "Enable bits" /end CHARACTERISTIC
/begin CHARACTERISTIC FPsw_APUD12_min "FPrm_switches(275)" VALUE 0x001C7200 /* @ECU_Address@FPrm_switches@0x021B9226@ */ ECIPP_ALIGNMENT_UWORD 65535 Compu_IDENTITY 0 65535 PHYS_UNIT "Enable bits" /end CHARACTERISTIC
/begin CHARACTERISTIC FPsw_APUD13_max "FPrm_switches(276)" VALUE 0x001C7202 /* @ECU_Address@FPrm_switches@0x021B9228@ */ ECIPP_ALIGNMENT_UWORD 65535 Compu_IDENTITY 0 65535 PHYS_UNIT "Enable bits" /end CHARACTERISTIC
/begin CHARACTERISTIC FPsw_APUD13_min "FPrm_switches(277)" VALUE 0x001C7204 /* @ECU_Address@FPrm_switches@0x021B922A@ */ ECIPP_ALIGNMENT_UWORD 65535 Compu_IDENTITY 0 65535 PHYS_UNIT "Enable bits" /end CHARACTERISTIC
/begin CHARACTERISTIC FPsw_APUD14_max "FPrm_switches(278)" VALUE 0x001C7206 /* @ECU_Address@FPrm_switches@0x021B922C@ */ ECIPP_ALIGNMENT_UWORD 65535 Compu_IDENTITY 0 65535 PHYS_UNIT "Enable bits" /end CHARACTERISTIC
/begin CHARACTERISTIC FPsw_APUD14_min "FPrm_switches(279)" VALUE 0x001C7208 /* @ECU_Address@FPrm_switches@0x021B922E@ */ ECIPP_ALIGNMENT_UWORD 65535 Compu_IDENTITY 0 65535 PHYS_UNIT "Enable bits" /end CHARACTERISTIC
/begin CHARACTERISTIC FPsw_APUD15_max "FPrm_switches(280)" VALUE 0x001C720A /* @ECU_Address@FPrm_switches@0x021B9230@ */ ECIPP_ALIGNMENT_UWORD 65535 Compu_IDENTITY 0 65535 PHYS_UNIT "Enable bits" /end CHARACTERISTIC
/begin CHARACTERISTIC FPsw_APUD15_min "FPrm_switches(281)" VALUE 0x001C720C /* @ECU_Address@FPrm_switches@0x021B9232@ */ ECIPP_ALIGNMENT_UWORD 65535 Compu_IDENTITY 0 65535 PHYS_UNIT "Enable bits" /end CHARACTERISTIC
/begin CHARACTERISTIC FPsw_APUD16_max "FPrm_switches(282)" VALUE 0x001C720E /* @ECU_Address@FPrm_switches@0x021B9234@ */ ECIPP_ALIGNMENT_UWORD 65535 Compu_IDENTITY 0 65535 PHYS_UNIT "Enable bits" /end CHARACTERISTIC
/begin CHARACTERISTIC FPsw_APUD16_min "FPrm_switches(283)" VALUE 0x001C7210 /* @ECU_Address@FPrm_switches@0x021B9236@ */ ECIPP_ALIGNMENT_UWORD 65535 Compu_IDENTITY 0 65535 PHYS_UNIT "Enable bits" /end CHARACTERISTIC
/begin CHARACTERISTIC FPsw_APUD17_max "FPrm_switches(284)" VALUE 0x001C7212 /* @ECU_Address@FPrm_switches@0x021B9238@ */ ECIPP_ALIGNMENT_UWORD 65535 Compu_IDENTITY 0 65535 PHYS_UNIT "Enable bits" /end CHARACTERISTIC
/begin CHARACTERISTIC FPsw_APUD17_min "FPrm_switches(285)" VALUE 0x001C7214 /* @ECU_Address@FPrm_switches@0x021B923A@ */ ECIPP_ALIGNMENT_UWORD 65535 Compu_IDENTITY 0 65535 PHYS_UNIT "Enable bits" /end CHARACTERISTIC
/begin CHARACTERISTIC FPsw_APUD18_max "FPrm_switches(286)" VALUE 0x001C7216 /* @ECU_Address@FPrm_switches@0x021B923C@ */ ECIPP_ALIGNMENT_UWORD 65535 Compu_IDENTITY 0 65535 PHYS_UNIT "Enable bits" /end CHARACTERISTIC
/begin CHARACTERISTIC FPsw_APUD18_min "FPrm_switches(287)" VALUE 0x001C7218 /* @ECU_Address@FPrm_switches@0x021B923E@ */ ECIPP_ALIGNMENT_UWORD 65535 Compu_IDENTITY 0 65535 PHYS_UNIT "Enable bits" /end CHARACTERISTIC
/begin CHARACTERISTIC FPsw_APUD19_max "FPrm_switches(288)" VALUE 0x001C721A /* @ECU_Address@FPrm_switches@0x021B9240@ */ ECIPP_ALIGNMENT_UWORD 65535 Compu_IDENTITY 0 65535 PHYS_UNIT "Enable bits" /end CHARACTERISTIC
/begin CHARACTERISTIC FPsw_APUD19_min "FPrm_switches(289)" VALUE 0x001C721C /* @ECU_Address@FPrm_switches@0x021B9242@ */ ECIPP_ALIGNMENT_UWORD 65535 Compu_IDENTITY 0 65535 PHYS_UNIT "Enable bits" /end CHARACTERISTIC
/begin CHARACTERISTIC FPsw_ext1_ADIG22_min "FPrm_switches_ext1(443)" VALUE 0x001C78F4 /* @ECU_Address@FPrm_switches_ext1@0x023A5376@ */ ECIPP_ALIGNMENT_UWORD 65535 Compu_IDENTITY 0 65535 PHYS_UNIT "Enable bits" /end CHARACTERISTIC
/begin CHARACTERISTIC FPsw_ext1_ADIG23_max "FPrm_switches_ext1(444)" VALUE 0x001C78F6 /* @ECU_Address@FPrm_switches_ext1@0x023A5378@ */ ECIPP_ALIGNMENT_UWORD 65535 Compu_IDENTITY 0 65535 PHYS_UNIT "Enable bits" /end CHARACTERISTIC
/begin CHARACTERISTIC FPsw_ext1_ADIG23_min "FPrm_switches_ext1(445)" VALUE 0x001C78F8 /* @ECU_Address@FPrm_switches_ext1@0x023A537A@ */ ECIPP_ALIGNMENT_UWORD 65535 Compu_IDENTITY 0 65535 PHYS_UNIT "Enable bits" /end CHARACTERISTIC
/begin CHARACTERISTIC FPsw_ext1_ADIG24_max "FPrm_switches_ext1(446)" VALUE 0x001C78FA /* @ECU_Address@FPrm_switches_ext1@0x023A537C@ */ ECIPP_ALIGNMENT_UWORD 65535 Compu_IDENTITY 0 65535 PHYS_UNIT "Enable bits" /end CHARACTERISTIC
/begin CHARACTERISTIC FPsw_ext1_ADIG24_min "FPrm_switches_ext1(447)" VALUE 0x001C78FC /* @ECU_Address@FPrm_switches_ext1@0x023A537E@ */ ECIPP_ALIGNMENT_UWORD 65535 Compu_IDENTITY 0 65535 PHYS_UNIT "Enable bits" /end CHARACTERISTIC
/begin CHARACTERISTIC FPsw_ext1_ADIG25_max "FPrm_switches_ext1(448)" VALUE 0x001C78FE /* @ECU_Address@FPrm_switches_ext1@0x023A5380@ */ ECIPP_ALIGNMENT_UWORD 65535 Compu_IDENTITY 0 65535 PHYS_UNIT "Enable bits" /end CHARACTERISTIC
/begin CHARACTERISTIC FPsw_ext1_ADIG25_min "FPrm_switches_ext1(449)" VALUE 0x001C7900 /* @ECU_Address@FPrm_switches_ext1@0x023A5382@ */ ECIPP_ALIGNMENT_UWORD 65535 Compu_IDENTITY 0 65535 PHYS_UNIT "Enable bits" /end CHARACTERISTIC
/begin CHARACTERISTIC FPsw_ext1_ADIG3_max "FPrm_switches_ext1(169)" VALUE 0x001C76D0 /* @ECU_Address@FPrm_switches_ext1@0x023A5152@ */ ECIPP_ALIGNMENT_UWORD 65535 Compu_IDENTITY 0 65535 PHYS_UNIT "Enable bits" /end CHARACTERISTIC
/begin CHARACTERISTIC FPsw_ext1_ADIG3_min "FPrm_switches_ext1(170)" VALUE 0x001C76D2 /* @ECU_Address@FPrm_switches_ext1@0x023A5154@ */ ECIPP_ALIGNMENT_UWORD 65535 Compu_IDENTITY 0 65535 PHYS_UNIT "Enable bits" /end CHARACTERISTIC
/begin CHARACTERISTIC FPsw_ext1_ADIG4_max "FPrm_switches_ext1(246)" VALUE 0x001C776A /* @ECU_Address@FPrm_switches_ext1@0x023A51EC@ */ ECIPP_ALIGNMENT_UWORD 65535 Compu_IDENTITY 0 65535 PHYS_UNIT "Enable bits" /end CHARACTERISTIC
/begin CHARACTERISTIC FPsw_ext1_ADIG4_min "FPrm_switches_ext1(247)" VALUE 0x001C776C /* @ECU_Address@FPrm_switches_ext1@0x023A51EE@ */ ECIPP_ALIGNMENT_UWORD 65535 Compu_IDENTITY 0 65535 PHYS_UNIT "Enable bits" /end CHARACTERISTIC
/begin CHARACTERISTIC FPsw_ext1_ADIG5_max "FPrm_switches_ext1(248)" VALUE 0x001C776E /* @ECU_Address@FPrm_switches_ext1@0x023A51F0@ */ ECIPP_ALIGNMENT_UWORD 65535 Compu_IDENTITY 0 65535 PHYS_UNIT "Enable bits" /end CHARACTERISTIC
/begin CHARACTERISTIC FPsw_ext1_ADIG5_min "FPrm_switches_ext1(249)" VALUE 0x001C7770 /* @ECU_Address@FPrm_switches_ext1@0x023A51F2@ */ ECIPP_ALIGNMENT_UWORD 65535 Compu_IDENTITY 0 65535 PHYS_UNIT "Enable bits" /end CHARACTERISTIC
/begin CHARACTERISTIC FPsw_ext1_ADIG6_max "FPrm_switches_ext1(250)" VALUE 0x001C7772 /* @ECU_Address@FPrm_switches_ext1@0x023A51F4@ */ ECIPP_ALIGNMENT_UWORD 65535 Compu_IDENTITY 0 65535 PHYS_UNIT "Enable bits" /end CHARACTERISTIC
/begin CHARACTERISTIC FPsw_ext1_ADIG6_min "FPrm_switches_ext1(251)" VALUE 0x001C7774 /* @ECU_Address@FPrm_switches_ext1@0x023A51F6@ */ ECIPP_ALIGNMENT_UWORD 65535 Compu_IDENTITY 0 65535 PHYS_UNIT "Enable bits" /end CHARACTERISTIC
/begin CHARACTERISTIC FPsw_ext1_ADIG7_max "FPrm_switches_ext1(252)" VALUE 0x001C7776 /* @ECU_Address@FPrm_switches_ext1@0x023A51F8@ */ ECIPP_ALIGNMENT_UWORD 65535 Compu_IDENTITY 0 65535 PHYS_UNIT "Enable bits" /end CHARACTERISTIC
/begin CHARACTERISTIC FPsw_ext1_ADIG7_min "FPrm_switches_ext1(253)" VALUE 0x001C7778 /* @ECU_Address@FPrm_switches_ext1@0x023A51FA@ */ ECIPP_ALIGNMENT_UWORD 65535 Compu_IDENTITY 0 65535 PHYS_UNIT "Enable bits" /end CHARACTERISTIC
/begin CHARACTERISTIC FPsw_ext1_ADIG8_max "FPrm_switches_ext1(254)" VALUE 0x001C777A /* @ECU_Address@FPrm_switches_ext1@0x023A51FC@ */ ECIPP_ALIGNMENT_UWORD 65535 Compu_IDENTITY 0 65535 PHYS_UNIT "Enable bits" /end CHARACTERISTIC
/begin CHARACTERISTIC FPsw_ext1_ADIG8_min "FPrm_switches_ext1(255)" VALUE 0x001C777C /* @ECU_Address@FPrm_switches_ext1@0x023A51FE@ */ ECIPP_ALIGNMENT_UWORD 65535 Compu_IDENTITY 0 65535 PHYS_UNIT "Enable bits" /end CHARACTERISTIC
/begin CHARACTERISTIC FPsw_ext1_ADIG9_max "FPrm_switches_ext1(256)" VALUE 0x001C777E /* @ECU_Address@FPrm_switches_ext1@0x023A5200@ */ ECIPP_ALIGNMENT_UWORD 65535 Compu_IDENTITY 0 65535 PHYS_UNIT "Enable bits" /end CHARACTERISTIC
/begin CHARACTERISTIC FPsw_ext1_ADIG9_min "FPrm_switches_ext1(257)" VALUE 0x001C7780 /* @ECU_Address@FPrm_switches_ext1@0x023A5202@ */ ECIPP_ALIGNMENT_UWORD 65535 Compu_IDENTITY 0 65535 PHYS_UNIT "Enable bits" /end CHARACTERISTIC
/begin CHARACTERISTIC FPsw_ext1_ADloss "FPrm_switches_ext1(67)" VALUE 0x001C7604 /* @ECU_Address@FPrm_switches_ext1@0x023A5086@ */ ECIPP_ALIGNMENT_UWORD 65535 Compu_IDENTITY 0 65535 PHYS_UNIT "Enable bits" /end CHARACTERISTIC
/begin CHARACTERISTIC FPsw_ext1_AFILT_dP_high "FPrm_switches_ext1(562)" VALUE 0x001C79E2 /* @ECU_Address@FPrm_switches_ext1@0x023A5464@ */ ECIPP_ALIGNMENT_UWORD 65535 Compu_IDENTITY 0 65535 PHYS_UNIT "Enable bits" /end CHARACTERISTIC
/begin CHARACTERISTIC FPsw_ext1_AL_hi "FPrm_switches_ext1(41)" VALUE 0x001C75D0 /* @ECU_Address@FPrm_switches_ext1@0x023A5052@ */ ECIPP_ALIGNMENT_UWORD 65535 Compu_IDENTITY 0 65535 PHYS_UNIT "Enable bits" /end CHARACTERISTIC
/begin CHARACTERISTIC FPsw_ext1_AL_lo "FPrm_switches_ext1(42)" VALUE 0x001C75D2 /* @ECU_Address@FPrm_switches_ext1@0x023A5054@ */ ECIPP_ALIGNMENT_UWORD 65535 Compu_IDENTITY 0 65535 PHYS_UNIT "Enable bits" /end CHARACTERISTIC
/begin CHARACTERISTIC FPsw_ext1_ALLP_hi "FPrm_switches_ext1(43)" VALUE 0x001C75D4 /* @ECU_Address@FPrm_switches_ext1@0x023A5056@ */ ECIPP_ALIGNMENT_UWORD 65535 Compu_IDENTITY 0 65535 PHYS_UNIT "Enable bits" /end CHARACTERISTIC
/begin CHARACTERISTIC FPsw_ext1_ALLP_lo "FPrm_switches_ext1(44)" VALUE 0x001C75D6 /* @ECU_Address@FPrm_switches_ext1@0x023A5058@ */ ECIPP_ALIGNMENT_UWORD 65535 Compu_IDENTITY 0 65535 PHYS_UNIT "Enable bits" /end CHARACTERISTIC
/begin CHARACTERISTIC FPsw_ext1_ALNG_hi "FPrm_switches_ext1(45)" VALUE 0x001C75D8 /* @ECU_Address@FPrm_switches_ext1@0x023A505A@ */ ECIPP_ALIGNMENT_UWORD 65535 Compu_IDENTITY 0 65535 PHYS_UNIT "Enable bits" /end CHARACTERISTIC
/begin CHARACTERISTIC FPsw_ext1_ALNG_lo "FPrm_switches_ext1(46)" VALUE 0x001C75DA /* @ECU_Address@FPrm_switches_ext1@0x023A505C@ */ ECIPP_ALIGNMENT_UWORD 65535 Compu_IDENTITY 0 65535 PHYS_UNIT "Enable bits" /end CHARACTERISTIC
/begin CHARACTERISTIC FPsw_ext1_APD1_max "FPrm_switches_ext1(75)" VALUE 0x001C7614 /* @ECU_Address@FPrm_switches_ext1@0x023A5096@ */ ECIPP_ALIGNMENT_UWORD 65535 Compu_IDENTITY 0 65535 PHYS_UNIT "Enable bits" /end CHARACTERISTIC
/begin CHARACTERISTIC FPsw_ext1_APD1_min "FPrm_switches_ext1(76)" VALUE 0x001C7616 /* @ECU_Address@FPrm_switches_ext1@0x023A5098@ */ ECIPP_ALIGNMENT_UWORD 65535 Compu_IDENTITY 0 65535 PHYS_UNIT "Enable bits" /end CHARACTERISTIC
/begin CHARACTERISTIC FPsw_ext1_APD2_max "FPrm_switches_ext1(181)" VALUE 0x001C76E8 /* @ECU_Address@FPrm_switches_ext1@0x023A516A@ */ ECIPP_ALIGNMENT_UWORD 65535 Compu_IDENTITY 0 65535 PHYS_UNIT "Enable bits" /end CHARACTERISTIC
/begin CHARACTERISTIC FPsw_ext1_APD2_min "FPrm_switches_ext1(182)" VALUE 0x001C76EA /* @ECU_Address@FPrm_switches_ext1@0x023A516C@ */ ECIPP_ALIGNMENT_UWORD 65535 Compu_IDENTITY 0 65535 PHYS_UNIT "Enable bits" /end CHARACTERISTIC
/begin CHARACTERISTIC FPsw_ext1_APD3_max "FPrm_switches_ext1(183)" VALUE 0x001C76EC /* @ECU_Address@FPrm_switches_ext1@0x023A516E@ */ ECIPP_ALIGNMENT_UWORD 65535 Compu_IDENTITY 0 65535 PHYS_UNIT "Enable bits" /end CHARACTERISTIC
/begin CHARACTERISTIC FPsw_ext1_APD3_min "FPrm_switches_ext1(184)" VALUE 0x001C76EE /* @ECU_Address@FPrm_switches_ext1@0x023A5170@ */ ECIPP_ALIGNMENT_UWORD 65535 Compu_IDENTITY 0 65535 PHYS_UNIT "Enable bits" /end CHARACTERISTIC
/begin CHARACTERISTIC FPsw_ext1_APS1_max "FPrm_switches_ext1(362)" VALUE 0x001C7852 /* @ECU_Address@FPrm_switches_ext1@0x023A52D4@ */ ECIPP_ALIGNMENT_UWORD 65535 Compu_IDENTITY 0 65535 PHYS_UNIT "Enable bits" /end CHARACTERISTIC
/begin CHARACTERISTIC FPsw_ext1_APS1_min "FPrm_switches_ext1(363)" VALUE 0x001C7854 /* @ECU_Address@FPrm_switches_ext1@0x023A52D6@ */ ECIPP_ALIGNMENT_UWORD 65535 Compu_IDENTITY 0 65535 PHYS_UNIT "Enable bits" /end CHARACTERISTIC
/begin CHARACTERISTIC FPsw_ext1_APS12_OOR "FPrm_switches_ext1(370)" VALUE 0x001C7862 /* @ECU_Address@FPrm_switches_ext1@0x023A52E4@ */ ECIPP_ALIGNMENT_UWORD 65535 Compu_IDENTITY 0 65535 PHYS_UNIT "Enable bits" /end CHARACTERISTIC
/begin CHARACTERISTIC FPsw_ext1_APS12pct_hi "FPrm_switches_ext1(366)" VALUE 0x001C785A /* @ECU_Address@FPrm_switches_ext1@0x023A52DC@ */ ECIPP_ALIGNMENT_UWORD 65535 Compu_IDENTITY 0 65535 PHYS_UNIT "Enable bits" /end CHARACTERISTIC
/begin CHARACTERISTIC FPsw_ext1_APS12pct_lo "FPrm_switches_ext1(367)" VALUE 0x001C785C /* @ECU_Address@FPrm_switches_ext1@0x023A52DE@ */ ECIPP_ALIGNMENT_UWORD 65535 Compu_IDENTITY 0 65535 PHYS_UNIT "Enable bits" /end CHARACTERISTIC
/begin CHARACTERISTIC FPsw_ext1_APS2_max "FPrm_switches_ext1(364)" VALUE 0x001C7856 /* @ECU_Address@FPrm_switches_ext1@0x023A52D8@ */ ECIPP_ALIGNMENT_UWORD 65535 Compu_IDENTITY 0 65535 PHYS_UNIT "Enable bits" /end CHARACTERISTIC
/begin CHARACTERISTIC FPsw_ext1_APS2_min "FPrm_switches_ext1(365)" VALUE 0x001C7858 /* @ECU_Address@FPrm_switches_ext1@0x023A52DA@ */ ECIPP_ALIGNMENT_UWORD 65535 Compu_IDENTITY 0 65535 PHYS_UNIT "Enable bits" /end CHARACTERISTIC
/begin CHARACTERISTIC FPsw_ext1_APSerr_neg "FPrm_switches_ext1(369)" VALUE 0x001C7860 /* @ECU_Address@FPrm_switches_ext1@0x023A52E2@ */ ECIPP_ALIGNMENT_UWORD 65535 Compu_IDENTITY 0 65535 PHYS_UNIT "Enable bits" /end CHARACTERISTIC
/begin CHARACTERISTIC FPsw_ext1_APSerr_pos "FPrm_switches_ext1(368)" VALUE 0x001C785E /* @ECU_Address@FPrm_switches_ext1@0x023A52E0@ */ ECIPP_ALIGNMENT_UWORD 65535 Compu_IDENTITY 0 65535 PHYS_UNIT "Enable bits" /end CHARACTERISTIC
/begin CHARACTERISTIC FPsw_ext1_APU1_max "FPrm_switches_ext1(77)" VALUE 0x001C7618 /* @ECU_Address@FPrm_switches_ext1@0x023A509A@ */ ECIPP_ALIGNMENT_UWORD 65535 Compu_IDENTITY 0 65535 PHYS_UNIT "Enable bits" /end CHARACTERISTIC
/begin CHARACTERISTIC FPsw_ext1_APU1_min "FPrm_switches_ext1(78)" VALUE 0x001C761A /* @ECU_Address@FPrm_switches_ext1@0x023A509C@ */ ECIPP_ALIGNMENT_UWORD 65535 Compu_IDENTITY 0 65535 PHYS_UNIT "Enable bits" /end CHARACTERISTIC
/begin CHARACTERISTIC FPsw_ext1_APU2_max "FPrm_switches_ext1(79)" VALUE 0x001C761C /* @ECU_Address@FPrm_switches_ext1@0x023A509E@ */ ECIPP_ALIGNMENT_UWORD 65535 Compu_IDENTITY 0 65535 PHYS_UNIT "Enable bits" /end CHARACTERISTIC
/begin CHARACTERISTIC FPsw_ext1_APU2_min "FPrm_switches_ext1(80)" VALUE 0x001C761E /* @ECU_Address@FPrm_switches_ext1@0x023A50A0@ */ ECIPP_ALIGNMENT_UWORD 65535 Compu_IDENTITY 0 65535 PHYS_UNIT "Enable bits" /end CHARACTERISTIC
/begin CHARACTERISTIC FPsw_ext1_APU3_max "FPrm_switches_ext1(157)" VALUE 0x001C76B8 /* @ECU_Address@FPrm_switches_ext1@0x023A513A@ */ ECIPP_ALIGNMENT_UWORD 65535 Compu_IDENTITY 0 65535 PHYS_UNIT "Enable bits" /end CHARACTERISTIC
/begin CHARACTERISTIC FPsw_ext1_APU3_min "FPrm_switches_ext1(158)" VALUE 0x001C76BA /* @ECU_Address@FPrm_switches_ext1@0x023A513C@ */ ECIPP_ALIGNMENT_UWORD 65535 Compu_IDENTITY 0 65535 PHYS_UNIT "Enable bits" /end CHARACTERISTIC
/begin CHARACTERISTIC FPsw_ext1_APUD1_max "FPrm_switches_ext1(159)" VALUE 0x001C76BC /* @ECU_Address@FPrm_switches_ext1@0x023A513E@ */ ECIPP_ALIGNMENT_UWORD 65535 Compu_IDENTITY 0 65535 PHYS_UNIT "Enable bits" /end CHARACTERISTIC
/begin CHARACTERISTIC FPsw_ext1_APUD1_min "FPrm_switches_ext1(160)" VALUE 0x001C76BE /* @ECU_Address@FPrm_switches_ext1@0x023A5140@ */ ECIPP_ALIGNMENT_UWORD 65535 Compu_IDENTITY 0 65535 PHYS_UNIT "Enable bits" /end CHARACTERISTIC
/begin CHARACTERISTIC FPsw_ext1_APUD10_max "FPrm_switches_ext1(270)" VALUE 0x001C779A /* @ECU_Address@FPrm_switches_ext1@0x023A521C@ */ ECIPP_ALIGNMENT_UWORD 65535 Compu_IDENTITY 0 65535 PHYS_UNIT "Enable bits" /end CHARACTERISTIC
/begin CHARACTERISTIC FPsw_ext1_APUD10_min "FPrm_switches_ext1(271)" VALUE 0x001C779C /* @ECU_Address@FPrm_switches_ext1@0x023A521E@ */ ECIPP_ALIGNMENT_UWORD 65535 Compu_IDENTITY 0 65535 PHYS_UNIT "Enable bits" /end CHARACTERISTIC
/begin CHARACTERISTIC FPsw_ext1_APUD11_max "FPrm_switches_ext1(272)" VALUE 0x001C779E /* @ECU_Address@FPrm_switches_ext1@0x023A5220@ */ ECIPP_ALIGNMENT_UWORD 65535 Compu_IDENTITY 0 65535 PHYS_UNIT "Enable bits" /end CHARACTERISTIC
/begin CHARACTERISTIC FPsw_ext1_APUD11_min "FPrm_switches_ext1(273)" VALUE 0x001C77A0 /* @ECU_Address@FPrm_switches_ext1@0x023A5222@ */ ECIPP_ALIGNMENT_UWORD 65535 Compu_IDENTITY 0 65535 PHYS_UNIT "Enable bits" /end CHARACTERISTIC
/begin CHARACTERISTIC FPsw_ext1_APUD12_max "FPrm_switches_ext1(274)" VALUE 0x001C77A2 /* @ECU_Address@FPrm_switches_ext1@0x023A5224@ */ ECIPP_ALIGNMENT_UWORD 65535 Compu_IDENTITY 0 65535 PHYS_UNIT "Enable bits" /end CHARACTERISTIC
/begin CHARACTERISTIC FPsw_ext1_APUD12_min "FPrm_switches_ext1(275)" VALUE 0x001C77A4 /* @ECU_Address@FPrm_switches_ext1@0x023A5226@ */ ECIPP_ALIGNMENT_UWORD 65535 Compu_IDENTITY 0 65535 PHYS_UNIT "Enable bits" /end CHARACTERISTIC
/begin CHARACTERISTIC FPsw_ext1_APUD13_max "FPrm_switches_ext1(276)" VALUE 0x001C77A6 /* @ECU_Address@FPrm_switches_ext1@0x023A5228@ */ ECIPP_ALIGNMENT_UWORD 65535 Compu_IDENTITY 0 65535 PHYS_UNIT "Enable bits" /end CHARACTERISTIC
/begin CHARACTERISTIC FPsw_ext1_APUD13_min "FPrm_switches_ext1(277)" VALUE 0x001C77A8 /* @ECU_Address@FPrm_switches_ext1@0x023A522A@ */ ECIPP_ALIGNMENT_UWORD 65535 Compu_IDENTITY 0 65535 PHYS_UNIT "Enable bits" /end CHARACTERISTIC
/begin CHARACTERISTIC FPsw_ext1_APUD14_max "FPrm_switches_ext1(278)" VALUE 0x001C77AA /* @ECU_Address@FPrm_switches_ext1@0x023A522C@ */ ECIPP_ALIGNMENT_UWORD 65535 Compu_IDENTITY 0 65535 PHYS_UNIT "Enable bits" /end CHARACTERISTIC
/begin CHARACTERISTIC FPsw_ext1_APUD14_min "FPrm_switches_ext1(279)" VALUE 0x001C77AC /* @ECU_Address@FPrm_switches_ext1@0x023A522E@ */ ECIPP_ALIGNMENT_UWORD 65535 Compu_IDENTITY 0 65535 PHYS_UNIT "Enable bits" /end CHARACTERISTIC
/begin CHARACTERISTIC FPsw_ext1_APUD15_max "FPrm_switches_ext1(280)" VALUE 0x001C77AE /* @ECU_Address@FPrm_switches_ext1@0x023A5230@ */ ECIPP_ALIGNMENT_UWORD 65535 Compu_IDENTITY 0 65535 PHYS_UNIT "Enable bits" /end CHARACTERISTIC
/begin CHARACTERISTIC FPsw_ext1_APUD15_min "FPrm_switches_ext1(281)" VALUE 0x001C77B0 /* @ECU_Address@FPrm_switches_ext1@0x023A5232@ */ ECIPP_ALIGNMENT_UWORD 65535 Compu_IDENTITY 0 65535 PHYS_UNIT "Enable bits" /end CHARACTERISTIC
/begin CHARACTERISTIC FPsw_ext1_APUD16_max "FPrm_switches_ext1(282)" VALUE 0x001C77B2 /* @ECU_Address@FPrm_switches_ext1@0x023A5234@ */ ECIPP_ALIGNMENT_UWORD 65535 Compu_IDENTITY 0 65535 PHYS_UNIT "Enable bits" /end CHARACTERISTIC
/begin CHARACTERISTIC FPsw_ext1_APUD16_min "FPrm_switches_ext1(283)" VALUE 0x001C77B4 /* @ECU_Address@FPrm_switches_ext1@0x023A5236@ */ ECIPP_ALIGNMENT_UWORD 65535 Compu_IDENTITY 0 65535 PHYS_UNIT "Enable bits" /end CHARACTERISTIC
/begin CHARACTERISTIC FPsw_ext1_APUD17_max "FPrm_switches_ext1(284)" VALUE 0x001C77B6 /* @ECU_Address@FPrm_switches_ext1@0x023A5238@ */ ECIPP_ALIGNMENT_UWORD 65535 Compu_IDENTITY 0 65535 PHYS_UNIT "Enable bits" /end CHARACTERISTIC
/begin CHARACTERISTIC FPsw_ext1_APUD17_min "FPrm_switches_ext1(285)" VALUE 0x001C77B8 /* @ECU_Address@FPrm_switches_ext1@0x023A523A@ */ ECIPP_ALIGNMENT_UWORD 65535 Compu_IDENTITY 0 65535 PHYS_UNIT "Enable bits" /end CHARACTERISTIC
/begin CHARACTERISTIC FPsw_ext1_APUD18_max "FPrm_switches_ext1(286)" VALUE 0x001C77BA /* @ECU_Address@FPrm_switches_ext1@0x023A523C@ */ ECIPP_ALIGNMENT_UWORD 65535 Compu_IDENTITY 0 65535 PHYS_UNIT "Enable bits" /end CHARACTERISTIC
/begin CHARACTERISTIC FPsw_ext1_APUD18_min "FPrm_switches_ext1(287)" VALUE 0x001C77BC /* @ECU_Address@FPrm_switches_ext1@0x023A523E@ */ ECIPP_ALIGNMENT_UWORD 65535 Compu_IDENTITY 0 65535 PHYS_UNIT "Enable bits" /end CHARACTERISTIC
/begin CHARACTERISTIC FPsw_ext1_APUD19_max "FPrm_switches_ext1(288)" VALUE 0x001C77BE /* @ECU_Address@FPrm_switches_ext1@0x023A5240@ */ ECIPP_ALIGNMENT_UWORD 65535 Compu_IDENTITY 0 65535 PHYS_UNIT "Enable bits" /end CHARACTERISTIC
/begin CHARACTERISTIC FPsw_ext1_APUD19_min "FPrm_switches_ext1(289)" VALUE 0x001C77C0 /* @ECU_Address@FPrm_switches_ext1@0x023A5242@ */ ECIPP_ALIGNMENT_UWORD 65535 Compu_IDENTITY 0 65535 PHYS_UNIT "Enable bits" /end CHARACTERISTIC
/begin CHARACTERISTIC FCdtc_ADIG22_min "FCtl_DTC(589)" VALUE 0x001E3D04 /* @ECU_Address@FCtl_DTC@0x021B549A@ */ ECIPP_ALIGNMENT_UWORD 65535 Compu_IDENTITY 0 65535 PHYS_UNIT "DTC" /end CHARACTERISTIC
/begin CHARACTERISTIC FCdtc_ADIG23_max "FCtl_DTC(590)" VALUE 0x001E3D06 /* @ECU_Address@FCtl_DTC@0x021B549C@ */ ECIPP_ALIGNMENT_UWORD 65535 Compu_IDENTITY 0 65535 PHYS_UNIT "DTC" /end CHARACTERISTIC
/begin CHARACTERISTIC FCdtc_ADIG23_min "FCtl_DTC(591)" VALUE 0x001E3D08 /* @ECU_Address@FCtl_DTC@0x021B549E@ */ ECIPP_ALIGNMENT_UWORD 65535 Compu_IDENTITY 0 65535 PHYS_UNIT "DTC" /end CHARACTERISTIC
/begin CHARACTERISTIC FCdtc_ADIG24_max "FCtl_DTC(592)" VALUE 0x001E3D0A /* @ECU_Address@FCtl_DTC@0x021B54A0@ */ ECIPP_ALIGNMENT_UWORD 65535 Compu_IDENTITY 0 65535 PHYS_UNIT "DTC" /end CHARACTERISTIC
/begin CHARACTERISTIC FCdtc_ADIG24_min "FCtl_DTC(593)" VALUE 0x001E3D0C /* @ECU_Address@FCtl_DTC@0x021B54A2@ */ ECIPP_ALIGNMENT_UWORD 65535 Compu_IDENTITY 0 65535 PHYS_UNIT "DTC" /end CHARACTERISTIC
/begin CHARACTERISTIC FCdtc_ADIG25_max "FCtl_DTC(594)" VALUE 0x001E3D0E /* @ECU_Address@FCtl_DTC@0x021B54A4@ */ ECIPP_ALIGNMENT_UWORD 65535 Compu_IDENTITY 0 65535 PHYS_UNIT "DTC" /end CHARACTERISTIC
/begin CHARACTERISTIC FCdtc_ADIG25_min "FCtl_DTC(595)" VALUE 0x001E3D10 /* @ECU_Address@FCtl_DTC@0x021B54A6@ */ ECIPP_ALIGNMENT_UWORD 65535 Compu_IDENTITY 0 65535 PHYS_UNIT "DTC" /end CHARACTERISTIC
/begin CHARACTERISTIC FCdtc_ADIG3_max "FCtl_DTC(213)" VALUE 0x001E3A14 /* @ECU_Address@FCtl_DTC@0x021B51AA@ */ ECIPP_ALIGNMENT_UWORD 65535 Compu_IDENTITY 0 65535 PHYS_UNIT "DTC" /end CHARACTERISTIC
/begin CHARACTERISTIC FCdtc_ADIG3_min "FCtl_DTC(214)" VALUE 0x001E3A16 /* @ECU_Address@FCtl_DTC@0x021B51AC@ */ ECIPP_ALIGNMENT_UWORD 65535 Compu_IDENTITY 0 65535 PHYS_UNIT "DTC" /end CHARACTERISTIC
/begin CHARACTERISTIC FCdtc_ADIG4_max "FCtl_DTC(337)" VALUE 0x001E3B0C /* @ECU_Address@FCtl_DTC@0x021B52A2@ */ ECIPP_ALIGNMENT_UWORD 65535 Compu_IDENTITY 0 65535 PHYS_UNIT "DTC" /end CHARACTERISTIC
/begin CHARACTERISTIC FCdtc_ADIG4_min "FCtl_DTC(338)" VALUE 0x001E3B0E /* @ECU_Address@FCtl_DTC@0x021B52A4@ */ ECIPP_ALIGNMENT_UWORD 65535 Compu_IDENTITY 0 65535 PHYS_UNIT "DTC" /end CHARACTERISTIC
/begin CHARACTERISTIC FCdtc_ADIG5_max "FCtl_DTC(339)" VALUE 0x001E3B10 /* @ECU_Address@FCtl_DTC@0x021B52A6@ */ ECIPP_ALIGNMENT_UWORD 65535 Compu_IDENTITY 0 65535 PHYS_UNIT "DTC" /end CHARACTERISTIC
/begin CHARACTERISTIC FCdtc_ADIG5_min "FCtl_DTC(340)" VALUE 0x001E3B12 /* @ECU_Address@FCtl_DTC@0x021B52A8@ */ ECIPP_ALIGNMENT_UWORD 65535 Compu_IDENTITY 0 65535 PHYS_UNIT "DTC" /end CHARACTERISTIC
/begin CHARACTERISTIC FCdtc_ADIG6_max "FCtl_DTC(341)" VALUE 0x001E3B14 /* @ECU_Address@FCtl_DTC@0x021B52AA@ */ ECIPP_ALIGNMENT_UWORD 65535 Compu_IDENTITY 0 65535 PHYS_UNIT "DTC" /end CHARACTERISTIC
/begin CHARACTERISTIC FCdtc_ADIG6_min "FCtl_DTC(342)" VALUE 0x001E3B16 /* @ECU_Address@FCtl_DTC@0x021B52AC@ */ ECIPP_ALIGNMENT_UWORD 65535 Compu_IDENTITY 0 65535 PHYS_UNIT "DTC" /end CHARACTERISTIC
/begin CHARACTERISTIC FCdtc_ADIG7_max "FCtl_DTC(343)" VALUE 0x001E3B18 /* @ECU_Address@FCtl_DTC@0x021B52AE@ */ ECIPP_ALIGNMENT_UWORD 65535 Compu_IDENTITY 0 65535 PHYS_UNIT "DTC" /end CHARACTERISTIC
/begin CHARACTERISTIC FCdtc_ADIG7_min "FCtl_DTC(344)" VALUE 0x001E3B1A /* @ECU_Address@FCtl_DTC@0x021B52B0@ */ ECIPP_ALIGNMENT_UWORD 65535 Compu_IDENTITY 0 65535 PHYS_UNIT "DTC" /end CHARACTERISTIC
/begin CHARACTERISTIC FCdtc_ADIG8_max "FCtl_DTC(345)" VALUE 0x001E3B1C /* @ECU_Address@FCtl_DTC@0x021B52B2@ */ ECIPP_ALIGNMENT_UWORD 65535 Compu_IDENTITY 0 65535 PHYS_UNIT "DTC" /end CHARACTERISTIC
/begin CHARACTERISTIC FCdtc_ADIG8_min "FCtl_DTC(346)" VALUE 0x001E3B1E /* @ECU_Address@FCtl_DTC@0x021B52B4@ */ ECIPP_ALIGNMENT_UWORD 65535 Compu_IDENTITY 0 65535 PHYS_UNIT "DTC" /end CHARACTERISTIC
/begin CHARACTERISTIC FCdtc_ADIG9_max "FCtl_DTC(347)" VALUE 0x001E3B20 /* @ECU_Address@FCtl_DTC@0x021B52B6@ */ ECIPP_ALIGNMENT_UWORD 65535 Compu_IDENTITY 0 65535 PHYS_UNIT "DTC" /end CHARACTERISTIC
/begin CHARACTERISTIC FCdtc_ADIG9_min "FCtl_DTC(348)" VALUE 0x001E3B22 /* @ECU_Address@FCtl_DTC@0x021B52B8@ */ ECIPP_ALIGNMENT_UWORD 65535 Compu_IDENTITY 0 65535 PHYS_UNIT "DTC" /end CHARACTERISTIC
/begin CHARACTERISTIC FCdtc_ADloss "FCtl_DTC(103)" VALUE 0x001E3938 /* @ECU_Address@FCtl_DTC@0x021B50CE@ */ ECIPP_ALIGNMENT_UWORD 65535 Compu_IDENTITY 0 65535 PHYS_UNIT "DTC" /end CHARACTERISTIC
/begin CHARACTERISTIC FCdtc_AFILT_dP_high "FCtl_DTC(732)" VALUE 0x001E3E22 /* @ECU_Address@FCtl_DTC@0x021B55B8@ */ ECIPP_ALIGNMENT_UWORD 65535 Compu_IDENTITY 0 65535 PHYS_UNIT "DTC" /end CHARACTERISTIC
/begin CHARACTERISTIC FCdtc_AL_hi "FCtl_DTC(30)" VALUE 0x001E38A6 /* @ECU_Address@FCtl_DTC@0x021B503C@ */ ECIPP_ALIGNMENT_UWORD 65535 Compu_IDENTITY 0 65535 PHYS_UNIT "DTC" /end CHARACTERISTIC
/begin CHARACTERISTIC FCdtc_AL_lo "FCtl_DTC(31)" VALUE 0x001E38A8 /* @ECU_Address@FCtl_DTC@0x021B503E@ */ ECIPP_ALIGNMENT_UWORD 65535 Compu_IDENTITY 0 65535 PHYS_UNIT "DTC" /end CHARACTERISTIC
/begin CHARACTERISTIC FCdtc_ALLP_hi "FCtl_DTC(42)" VALUE 0x001E38BE /* @ECU_Address@FCtl_DTC@0x021B5054@ */ ECIPP_ALIGNMENT_UWORD 65535 Compu_IDENTITY 0 65535 PHYS_UNIT "DTC" /end CHARACTERISTIC
/begin CHARACTERISTIC FCdtc_ALLP_lo "FCtl_DTC(43)" VALUE 0x001E38C0 /* @ECU_Address@FCtl_DTC@0x021B5056@ */ ECIPP_ALIGNMENT_UWORD 65535 Compu_IDENTITY 0 65535 PHYS_UNIT "DTC" /end CHARACTERISTIC
/begin CHARACTERISTIC FCdtc_ALNG_hi "FCtl_DTC(44)" VALUE 0x001E38C2 /* @ECU_Address@FCtl_DTC@0x021B5058@ */ ECIPP_ALIGNMENT_UWORD 65535 Compu_IDENTITY 0 65535 PHYS_UNIT "DTC" /end CHARACTERISTIC
/begin CHARACTERISTIC FCdtc_ALNG_lo "FCtl_DTC(45)" VALUE 0x001E38C4 /* @ECU_Address@FCtl_DTC@0x021B505A@ */ ECIPP_ALIGNMENT_UWORD 65535 Compu_IDENTITY 0 65535 PHYS_UNIT "DTC" /end CHARACTERISTIC
/begin CHARACTERISTIC FCdtc_APD1_max "FCtl_DTC(116)" VALUE 0x001E3952 /* @ECU_Address@FCtl_DTC@0x021B50E8@ */ ECIPP_ALIGNMENT_UWORD 65535 Compu_IDENTITY 0 65535 PHYS_UNIT "DTC" /end CHARACTERISTIC
/begin CHARACTERISTIC FCdtc_APD1_min "FCtl_DTC(117)" VALUE 0x001E3954 /* @ECU_Address@FCtl_DTC@0x021B50EA@ */ ECIPP_ALIGNMENT_UWORD 65535 Compu_IDENTITY 0 65535 PHYS_UNIT "DTC" /end CHARACTERISTIC
/begin CHARACTERISTIC FCdtc_APD2_max "FCtl_DTC(229)" VALUE 0x001E3A34 /* @ECU_Address@FCtl_DTC@0x021B51CA@ */ ECIPP_ALIGNMENT_UWORD 65535 Compu_IDENTITY 0 65535 PHYS_UNIT "DTC" /end CHARACTERISTIC
/begin CHARACTERISTIC FCdtc_APD2_min "FCtl_DTC(230)" VALUE 0x001E3A36 /* @ECU_Address@FCtl_DTC@0x021B51CC@ */ ECIPP_ALIGNMENT_UWORD 65535 Compu_IDENTITY 0 65535 PHYS_UNIT "DTC" /end CHARACTERISTIC
/begin CHARACTERISTIC FCdtc_APD3_max "FCtl_DTC(231)" VALUE 0x001E3A38 /* @ECU_Address@FCtl_DTC@0x021B51CE@ */ ECIPP_ALIGNMENT_UWORD 65535 Compu_IDENTITY 0 65535 PHYS_UNIT "DTC" /end CHARACTERISTIC
/begin CHARACTERISTIC FCdtc_APD3_min "FCtl_DTC(232)" VALUE 0x001E3A3A /* @ECU_Address@FCtl_DTC@0x021B51D0@ */ ECIPP_ALIGNMENT_UWORD 65535 Compu_IDENTITY 0 65535 PHYS_UNIT "DTC" /end CHARACTERISTIC
/begin CHARACTERISTIC FCdtc_APS1_max "FCtl_DTC(465)" VALUE 0x001E3C0C /* @ECU_Address@FCtl_DTC@0x021B53A2@ */ ECIPP_ALIGNMENT_UWORD 65535 Compu_IDENTITY 0 65535 PHYS_UNIT "DTC" /end CHARACTERISTIC
/begin CHARACTERISTIC FCdtc_APS1_min "FCtl_DTC(466)" VALUE 0x001E3C0E /* @ECU_Address@FCtl_DTC@0x021B53A4@ */ ECIPP_ALIGNMENT_UWORD 65535 Compu_IDENTITY 0 65535 PHYS_UNIT "DTC" /end CHARACTERISTIC
/begin CHARACTERISTIC FCdtc_APS12_OOR "FCtl_DTC(473)" VALUE 0x001E3C1C /* @ECU_Address@FCtl_DTC@0x021B53B2@ */ ECIPP_ALIGNMENT_UWORD 65535 Compu_IDENTITY 0 65535 PHYS_UNIT "DTC" /end CHARACTERISTIC
/begin CHARACTERISTIC FCdtc_APS12pct_hi "FCtl_DTC(469)" VALUE 0x001E3C14 /* @ECU_Address@FCtl_DTC@0x021B53AA@ */ ECIPP_ALIGNMENT_UWORD 65535 Compu_IDENTITY 0 65535 PHYS_UNIT "DTC" /end CHARACTERISTIC
/begin CHARACTERISTIC FCdtc_APS12pct_lo "FCtl_DTC(470)" VALUE 0x001E3C16 /* @ECU_Address@FCtl_DTC@0x021B53AC@ */ ECIPP_ALIGNMENT_UWORD 65535 Compu_IDENTITY 0 65535 PHYS_UNIT "DTC" /end CHARACTERISTIC
/begin CHARACTERISTIC FCdtc_APS2_max "FCtl_DTC(467)" VALUE 0x001E3C10 /* @ECU_Address@FCtl_DTC@0x021B53A6@ */ ECIPP_ALIGNMENT_UWORD 65535 Compu_IDENTITY 0 65535 PHYS_UNIT "DTC" /end CHARACTERISTIC
/begin CHARACTERISTIC FCdtc_APS2_min "FCtl_DTC(468)" VALUE 0x001E3C12 /* @ECU_Address@FCtl_DTC@0x021B53A8@ */ ECIPP_ALIGNMENT_UWORD 65535 Compu_IDENTITY 0 65535 PHYS_UNIT "DTC" /end CHARACTERISTIC
/begin CHARACTERISTIC FCdtc_APSerr_neg "FCtl_DTC(472)" VALUE 0x001E3C1A /* @ECU_Address@FCtl_DTC@0x021B53B0@ */ ECIPP_ALIGNMENT_UWORD 65535 Compu_IDENTITY 0 65535 PHYS_UNIT "DTC" /end CHARACTERISTIC
/begin CHARACTERISTIC FCdtc_APSerr_pos "FCtl_DTC(471)" VALUE 0x001E3C18 /* @ECU_Address@FCtl_DTC@0x021B53AE@ */ ECIPP_ALIGNMENT_UWORD 65535 Compu_IDENTITY 0 65535 PHYS_UNIT "DTC" /end CHARACTERISTIC
/begin CHARACTERISTIC FCdtc_APU1_max "FCtl_DTC(118)" VALUE 0x001E3956 /* @ECU_Address@FCtl_DTC@0x021B50EC@ */ ECIPP_ALIGNMENT_UWORD 65535 Compu_IDENTITY 0 65535 PHYS_UNIT "DTC" /end CHARACTERISTIC
/begin CHARACTERISTIC FCdtc_APU1_min "FCtl_DTC(119)" VALUE 0x001E3958 /* @ECU_Address@FCtl_DTC@0x021B50EE@ */ ECIPP_ALIGNMENT_UWORD 65535 Compu_IDENTITY 0 65535 PHYS_UNIT "DTC" /end CHARACTERISTIC
/begin CHARACTERISTIC FCdtc_APU2_max "FCtl_DTC(120)" VALUE 0x001E395A /* @ECU_Address@FCtl_DTC@0x021B50F0@ */ ECIPP_ALIGNMENT_UWORD 65535 Compu_IDENTITY 0 65535 PHYS_UNIT "DTC" /end CHARACTERISTIC
/begin CHARACTERISTIC FCdtc_APU2_min "FCtl_DTC(121)" VALUE 0x001E395C /* @ECU_Address@FCtl_DTC@0x021B50F2@ */ ECIPP_ALIGNMENT_UWORD 65535 Compu_IDENTITY 0 65535 PHYS_UNIT "DTC" /end CHARACTERISTIC
/begin CHARACTERISTIC FCdtc_APU3_max "FCtl_DTC(201)" VALUE 0x001E39FC /* @ECU_Address@FCtl_DTC@0x021B5192@ */ ECIPP_ALIGNMENT_UWORD 65535 Compu_IDENTITY 0 65535 PHYS_UNIT "DTC" /end CHARACTERISTIC
/begin CHARACTERISTIC FCdtc_APU3_min "FCtl_DTC(202)" VALUE 0x001E39FE /* @ECU_Address@FCtl_DTC@0x021B5194@ */ ECIPP_ALIGNMENT_UWORD 65535 Compu_IDENTITY 0 65535 PHYS_UNIT "DTC" /end CHARACTERISTIC
/begin CHARACTERISTIC FCdtc_APUD1_max "FCtl_DTC(203)" VALUE 0x001E3A00 /* @ECU_Address@FCtl_DTC@0x021B5196@ */ ECIPP_ALIGNMENT_UWORD 65535 Compu_IDENTITY 0 65535 PHYS_UNIT "DTC" /end CHARACTERISTIC
/begin CHARACTERISTIC FCdtc_APUD1_min "FCtl_DTC(204)" VALUE 0x001E3A02 /* @ECU_Address@FCtl_DTC@0x021B5198@ */ ECIPP_ALIGNMENT_UWORD 65535 Compu_IDENTITY 0 65535 PHYS_UNIT "DTC" /end CHARACTERISTIC
/begin CHARACTERISTIC FCdtc_APUD10_max "FCtl_DTC(361)" VALUE 0x001E3B3C /* @ECU_Address@FCtl_DTC@0x021B52D2@ */ ECIPP_ALIGNMENT_UWORD 65535 Compu_IDENTITY 0 65535 PHYS_UNIT "DTC" /end CHARACTERISTIC
/begin CHARACTERISTIC FCdtc_APUD10_min "FCtl_DTC(362)" VALUE 0x001E3B3E /* @ECU_Address@FCtl_DTC@0x021B52D4@ */ ECIPP_ALIGNMENT_UWORD 65535 Compu_IDENTITY 0 65535 PHYS_UNIT "DTC" /end CHARACTERISTIC
/begin CHARACTERISTIC FCdtc_APUD11_max "FCtl_DTC(363)" VALUE 0x001E3B40 /* @ECU_Address@FCtl_DTC@0x021B52D6@ */ ECIPP_ALIGNMENT_UWORD 65535 Compu_IDENTITY 0 65535 PHYS_UNIT "DTC" /end CHARACTERISTIC
/begin CHARACTERISTIC FCdtc_APUD11_min "FCtl_DTC(364)" VALUE 0x001E3B42 /* @ECU_Address@FCtl_DTC@0x021B52D8@ */ ECIPP_ALIGNMENT_UWORD 65535 Compu_IDENTITY 0 65535 PHYS_UNIT "DTC" /end CHARACTERISTIC
/begin CHARACTERISTIC FCdtc_APUD12_max "FCtl_DTC(365)" VALUE 0x001E3B44 /* @ECU_Address@FCtl_DTC@0x021B52DA@ */ ECIPP_ALIGNMENT_UWORD 65535 Compu_IDENTITY 0 65535 PHYS_UNIT "DTC" /end CHARACTERISTIC
/begin CHARACTERISTIC FCdtc_APUD12_min "FCtl_DTC(366)" VALUE 0x001E3B46 /* @ECU_Address@FCtl_DTC@0x021B52DC@ */ ECIPP_ALIGNMENT_UWORD 65535 Compu_IDENTITY 0 65535 PHYS_UNIT "DTC" /end CHARACTERISTIC
/begin CHARACTERISTIC FCdtc_APUD13_max "FCtl_DTC(367)" VALUE 0x001E3B48 /* @ECU_Address@FCtl_DTC@0x021B52DE@ */ ECIPP_ALIGNMENT_UWORD 65535 Compu_IDENTITY 0 65535 PHYS_UNIT "DTC" /end CHARACTERISTIC
/begin CHARACTERISTIC FCdtc_APUD13_min "FCtl_DTC(368)" VALUE 0x001E3B4A /* @ECU_Address@FCtl_DTC@0x021B52E0@ */ ECIPP_ALIGNMENT_UWORD 65535 Compu_IDENTITY 0 65535 PHYS_UNIT "DTC" /end CHARACTERISTIC
/begin CHARACTERISTIC FCdtc_APUD14_max "FCtl_DTC(369)" VALUE 0x001E3B4C /* @ECU_Address@FCtl_DTC@0x021B52E2@ */ ECIPP_ALIGNMENT_UWORD 65535 Compu_IDENTITY 0 65535 PHYS_UNIT "DTC" /end CHARACTERISTIC
/begin CHARACTERISTIC FCdtc_APUD14_min "FCtl_DTC(370)" VALUE 0x001E3B4E /* @ECU_Address@FCtl_DTC@0x021B52E4@ */ ECIPP_ALIGNMENT_UWORD 65535 Compu_IDENTITY 0 65535 PHYS_UNIT "DTC" /end CHARACTERISTIC
/begin CHARACTERISTIC FCdtc_APUD15_max "FCtl_DTC(371)" VALUE 0x001E3B50 /* @ECU_Address@FCtl_DTC@0x021B52E6@ */ ECIPP_ALIGNMENT_UWORD 65535 Compu_IDENTITY 0 65535 PHYS_UNIT "DTC" /end CHARACTERISTIC
/begin CHARACTERISTIC FCdtc_APUD15_min "FCtl_DTC(372)" VALUE 0x001E3B52 /* @ECU_Address@FCtl_DTC@0x021B52E8@ */ ECIPP_ALIGNMENT_UWORD 65535 Compu_IDENTITY 0 65535 PHYS_UNIT "DTC" /end CHARACTERISTIC
/begin CHARACTERISTIC FCdtc_APUD16_max "FCtl_DTC(373)" VALUE 0x001E3B54 /* @ECU_Address@FCtl_DTC@0x021B52EA@ */ ECIPP_ALIGNMENT_UWORD 65535 Compu_IDENTITY 0 65535 PHYS_UNIT "DTC" /end CHARACTERISTIC
/begin CHARACTERISTIC FCdtc_APUD16_min "FCtl_DTC(374)" VALUE 0x001E3B56 /* @ECU_Address@FCtl_DTC@0x021B52EC@ */ ECIPP_ALIGNMENT_UWORD 65535 Compu_IDENTITY 0 65535 PHYS_UNIT "DTC" /end CHARACTERISTIC
/begin CHARACTERISTIC FCdtc_APUD17_max "FCtl_DTC(375)" VALUE 0x001E3B58 /* @ECU_Address@FCtl_DTC@0x021B52EE@ */ ECIPP_ALIGNMENT_UWORD 65535 Compu_IDENTITY 0 65535 PHYS_UNIT "DTC" /end CHARACTERISTIC
/begin CHARACTERISTIC FCdtc_APUD17_min "FCtl_DTC(376)" VALUE 0x001E3B5A /* @ECU_Address@FCtl_DTC@0x021B52F0@ */ ECIPP_ALIGNMENT_UWORD 65535 Compu_IDENTITY 0 65535 PHYS_UNIT "DTC" /end CHARACTERISTIC
/begin CHARACTERISTIC FCdtc_APUD18_max "FCtl_DTC(377)" VALUE 0x001E3B5C /* @ECU_Address@FCtl_DTC@0x021B52F2@ */ ECIPP_ALIGNMENT_UWORD 65535 Compu_IDENTITY 0 65535 PHYS_UNIT "DTC" /end CHARACTERISTIC
/begin CHARACTERISTIC FCdtc_APUD18_min "FCtl_DTC(378)" VALUE 0x001E3B5E /* @ECU_Address@FCtl_DTC@0x021B52F4@ */ ECIPP_ALIGNMENT_UWORD 65535 Compu_IDENTITY 0 65535 PHYS_UNIT "DTC" /end CHARACTERISTIC
/begin CHARACTERISTIC FCdtc_APUD19_max "FCtl_DTC(379)" VALUE 0x001E3B60 /* @ECU_Address@FCtl_DTC@0x021B52F6@ */ ECIPP_ALIGNMENT_UWORD 65535 Compu_IDENTITY 0 65535 PHYS_UNIT "DTC" /end CHARACTERISTIC
/begin CHARACTERISTIC FCdtc_APUD19_min "FCtl_DTC(380)" VALUE 0x001E3B62 /* @ECU_Address@FCtl_DTC@0x021B52F8@ */ ECIPP_ALIGNMENT_UWORD 65535 Compu_IDENTITY 0 65535 PHYS_UNIT "DTC" /end CHARACTERISTIC
/begin CHARACTERISTIC FCfmi_ADIG22_min "FCtl_FMI(589)" VALUE 0x001E5B4E /* @ECU_Address@FCtl_FMI@0x021B724D@ */ ECIPP_ALIGNMENT_UBYTE 255 Compu_IDENTITY 0 255 PHYS_UNIT "FMI" /end CHARACTERISTIC
/begin CHARACTERISTIC FCfmi_ADIG23_max "FCtl_FMI(590)" VALUE 0x001E5B4F /* @ECU_Address@FCtl_FMI@0x021B724E@ */ ECIPP_ALIGNMENT_UBYTE 255 Compu_IDENTITY 0 255 PHYS_UNIT "FMI" /end CHARACTERISTIC
/begin CHARACTERISTIC FCfmi_ADIG23_min "FCtl_FMI(591)" VALUE 0x001E5B50 /* @ECU_Address@FCtl_FMI@0x021B724F@ */ ECIPP_ALIGNMENT_UBYTE 255 Compu_IDENTITY 0 255 PHYS_UNIT "FMI" /end CHARACTERISTIC
/begin CHARACTERISTIC FCfmi_ADIG24_max "FCtl_FMI(592)" VALUE 0x001E5B51 /* @ECU_Address@FCtl_FMI@0x021B7250@ */ ECIPP_ALIGNMENT_UBYTE 255 Compu_IDENTITY 0 255 PHYS_UNIT "FMI" /end CHARACTERISTIC
/begin CHARACTERISTIC FCfmi_ADIG24_min "FCtl_FMI(593)" VALUE 0x001E5B52 /* @ECU_Address@FCtl_FMI@0x021B7251@ */ ECIPP_ALIGNMENT_UBYTE 255 Compu_IDENTITY 0 255 PHYS_UNIT "FMI" /end CHARACTERISTIC
/begin CHARACTERISTIC FCfmi_ADIG25_max "FCtl_FMI(594)" VALUE 0x001E5B53 /* @ECU_Address@FCtl_FMI@0x021B7252@ */ ECIPP_ALIGNMENT_UBYTE 255 Compu_IDENTITY 0 255 PHYS_UNIT "FMI" /end CHARACTERISTIC
/begin CHARACTERISTIC FCfmi_ADIG25_min "FCtl_FMI(595)" VALUE 0x001E5B54 /* @ECU_Address@FCtl_FMI@0x021B7253@ */ ECIPP_ALIGNMENT_UBYTE 255 Compu_IDENTITY 0 255 PHYS_UNIT "FMI" /end CHARACTERISTIC
/begin CHARACTERISTIC FCfmi_ADIG3_max "FCtl_FMI(213)" VALUE 0x001E59D6 /* @ECU_Address@FCtl_FMI@0x021B70D5@ */ ECIPP_ALIGNMENT_UBYTE 255 Compu_IDENTITY 0 255 PHYS_UNIT "FMI" /end CHARACTERISTIC
/begin CHARACTERISTIC FCfmi_ADIG3_min "FCtl_FMI(214)" VALUE 0x001E59D7 /* @ECU_Address@FCtl_FMI@0x021B70D6@ */ ECIPP_ALIGNMENT_UBYTE 255 Compu_IDENTITY 0 255 PHYS_UNIT "FMI" /end CHARACTERISTIC
/begin CHARACTERISTIC FCfmi_ADIG4_max "FCtl_FMI(337)" VALUE 0x001E5A52 /* @ECU_Address@FCtl_FMI@0x021B7151@ */ ECIPP_ALIGNMENT_UBYTE 255 Compu_IDENTITY 0 255 PHYS_UNIT "FMI" /end CHARACTERISTIC
/begin CHARACTERISTIC FCfmi_ADIG4_min "FCtl_FMI(338)" VALUE 0x001E5A53 /* @ECU_Address@FCtl_FMI@0x021B7152@ */ ECIPP_ALIGNMENT_UBYTE 255 Compu_IDENTITY 0 255 PHYS_UNIT "FMI" /end CHARACTERISTIC
/begin CHARACTERISTIC FCfmi_ADIG5_max "FCtl_FMI(339)" VALUE 0x001E5A54 /* @ECU_Address@FCtl_FMI@0x021B7153@ */ ECIPP_ALIGNMENT_UBYTE 255 Compu_IDENTITY 0 255 PHYS_UNIT "FMI" /end CHARACTERISTIC
/begin CHARACTERISTIC FCfmi_ADIG5_min "FCtl_FMI(340)" VALUE 0x001E5A55 /* @ECU_Address@FCtl_FMI@0x021B7154@ */ ECIPP_ALIGNMENT_UBYTE 255 Compu_IDENTITY 0 255 PHYS_UNIT "FMI" /end CHARACTERISTIC
/begin CHARACTERISTIC FCfmi_ADIG6_max "FCtl_FMI(341)" VALUE 0x001E5A56 /* @ECU_Address@FCtl_FMI@0x021B7155@ */ ECIPP_ALIGNMENT_UBYTE 255 Compu_IDENTITY 0 255 PHYS_UNIT "FMI" /end CHARACTERISTIC
/begin CHARACTERISTIC FCfmi_ADIG6_min "FCtl_FMI(342)" VALUE 0x001E5A57 /* @ECU_Address@FCtl_FMI@0x021B7156@ */ ECIPP_ALIGNMENT_UBYTE 255 Compu_IDENTITY 0 255 PHYS_UNIT "FMI" /end CHARACTERISTIC
/begin CHARACTERISTIC FCfmi_ADIG7_max "FCtl_FMI(343)" VALUE 0x001E5A58 /* @ECU_Address@FCtl_FMI@0x021B7157@ */ ECIPP_ALIGNMENT_UBYTE 255 Compu_IDENTITY 0 255 PHYS_UNIT "FMI" /end CHARACTERISTIC
/begin CHARACTERISTIC FCfmi_ADIG7_min "FCtl_FMI(344)" VALUE 0x001E5A59 /* @ECU_Address@FCtl_FMI@0x021B7158@ */ ECIPP_ALIGNMENT_UBYTE 255 Compu_IDENTITY 0 255 PHYS_UNIT "FMI" /end CHARACTERISTIC
/begin CHARACTERISTIC FCfmi_ADIG8_max "FCtl_FMI(345)" VALUE 0x001E5A5A /* @ECU_Address@FCtl_FMI@0x021B7159@ */ ECIPP_ALIGNMENT_UBYTE 255 Compu_IDENTITY 0 255 PHYS_UNIT "FMI" /end CHARACTERISTIC
/begin CHARACTERISTIC FCfmi_ADIG8_min "FCtl_FMI(346)" VALUE 0x001E5A5B /* @ECU_Address@FCtl_FMI@0x021B715A@ */ ECIPP_ALIGNMENT_UBYTE 255 Compu_IDENTITY 0 255 PHYS_UNIT "FMI" /end CHARACTERISTIC
/begin CHARACTERISTIC FCfmi_ADIG9_max "FCtl_FMI(347)" VALUE 0x001E5A5C /* @ECU_Address@FCtl_FMI@0x021B715B@ */ ECIPP_ALIGNMENT_UBYTE 255 Compu_IDENTITY 0 255 PHYS_UNIT "FMI" /end CHARACTERISTIC
/begin CHARACTERISTIC FCfmi_ADIG9_min "FCtl_FMI(348)" VALUE 0x001E5A5D /* @ECU_Address@FCtl_FMI@0x021B715C@ */ ECIPP_ALIGNMENT_UBYTE 255 Compu_IDENTITY 0 255 PHYS_UNIT "FMI" /end CHARACTERISTIC
/begin CHARACTERISTIC FCfmi_ADloss "FCtl_FMI(103)" VALUE 0x001E5968 /* @ECU_Address@FCtl_FMI@0x021B7067@ */ ECIPP_ALIGNMENT_UBYTE 255 Compu_IDENTITY 0 255 PHYS_UNIT "FMI" /end CHARACTERISTIC
/begin CHARACTERISTIC FCfmi_AFILT_dP_high "FCtl_FMI(732)" VALUE 0x001E5BDD /* @ECU_Address@FCtl_FMI@0x021B72DC@ */ ECIPP_ALIGNMENT_UBYTE 255 Compu_IDENTITY 0 255 PHYS_UNIT "FMI" /end CHARACTERISTIC
/begin CHARACTERISTIC FCfmi_AL_hi "FCtl_FMI(30)" VALUE 0x001E591F /* @ECU_Address@FCtl_FMI@0x021B701E@ */ ECIPP_ALIGNMENT_UBYTE 255 Compu_IDENTITY 0 255 PHYS_UNIT "FMI" /end CHARACTERISTIC
/begin CHARACTERISTIC FCfmi_AL_lo "FCtl_FMI(31)" VALUE 0x001E5920 /* @ECU_Address@FCtl_FMI@0x021B701F@ */ ECIPP_ALIGNMENT_UBYTE 255 Compu_IDENTITY 0 255 PHYS_UNIT "FMI" /end CHARACTERISTIC
/begin CHARACTERISTIC FCfmi_ALLP_hi "FCtl_FMI(42)" VALUE 0x001E592B /* @ECU_Address@FCtl_FMI@0x021B702A@ */ ECIPP_ALIGNMENT_UBYTE 255 Compu_IDENTITY 0 255 PHYS_UNIT "FMI" /end CHARACTERISTIC
/begin CHARACTERISTIC FCfmi_ALLP_lo "FCtl_FMI(43)" VALUE 0x001E592C /* @ECU_Address@FCtl_FMI@0x021B702B@ */ ECIPP_ALIGNMENT_UBYTE 255 Compu_IDENTITY 0 255 PHYS_UNIT "FMI" /end CHARACTERISTIC
/begin CHARACTERISTIC FCfmi_ALNG_hi "FCtl_FMI(44)" VALUE 0x001E592D /* @ECU_Address@FCtl_FMI@0x021B702C@ */ ECIPP_ALIGNMENT_UBYTE 255 Compu_IDENTITY 0 255 PHYS_UNIT "FMI" /end CHARACTERISTIC
/begin CHARACTERISTIC FCfmi_ALNG_lo "FCtl_FMI(45)" VALUE 0x001E592E /* @ECU_Address@FCtl_FMI@0x021B702D@ */ ECIPP_ALIGNMENT_UBYTE 255 Compu_IDENTITY 0 255 PHYS_UNIT "FMI" /end CHARACTERISTIC
/begin CHARACTERISTIC FCfmi_APD1_max "FCtl_FMI(116)" VALUE 0x001E5975 /* @ECU_Address@FCtl_FMI@0x021B7074@ */ ECIPP_ALIGNMENT_UBYTE 255 Compu_IDENTITY 0 255 PHYS_UNIT "FMI" /end CHARACTERISTIC
/begin CHARACTERISTIC FCfmi_APD1_min "FCtl_FMI(117)" VALUE 0x001E5976 /* @ECU_Address@FCtl_FMI@0x021B7075@ */ ECIPP_ALIGNMENT_UBYTE 255 Compu_IDENTITY 0 255 PHYS_UNIT "FMI" /end CHARACTERISTIC
/begin CHARACTERISTIC FCfmi_APD2_max "FCtl_FMI(229)" VALUE 0x001E59E6 /* @ECU_Address@FCtl_FMI@0x021B70E5@ */ ECIPP_ALIGNMENT_UBYTE 255 Compu_IDENTITY 0 255 PHYS_UNIT "FMI" /end CHARACTERISTIC
/begin CHARACTERISTIC FCfmi_APD2_min "FCtl_FMI(230)" VALUE 0x001E59E7 /* @ECU_Address@FCtl_FMI@0x021B70E6@ */ ECIPP_ALIGNMENT_UBYTE 255 Compu_IDENTITY 0 255 PHYS_UNIT "FMI" /end CHARACTERISTIC
/begin CHARACTERISTIC FCfmi_APD3_max "FCtl_FMI(231)" VALUE 0x001E59E8 /* @ECU_Address@FCtl_FMI@0x021B70E7@ */ ECIPP_ALIGNMENT_UBYTE 255 Compu_IDENTITY 0 255 PHYS_UNIT "FMI" /end CHARACTERISTIC
/begin CHARACTERISTIC FCfmi_APD3_min "FCtl_FMI(232)" VALUE 0x001E59E9 /* @ECU_Address@FCtl_FMI@0x021B70E8@ */ ECIPP_ALIGNMENT_UBYTE 255 Compu_IDENTITY 0 255 PHYS_UNIT "FMI" /end CHARACTERISTIC
/begin CHARACTERISTIC FCfmi_APS1_max "FCtl_FMI(465)" VALUE 0x001E5AD2 /* @ECU_Address@FCtl_FMI@0x021B71D1@ */ ECIPP_ALIGNMENT_UBYTE 255 Compu_IDENTITY 0 255 PHYS_UNIT "FMI" /end CHARACTERISTIC
/begin CHARACTERISTIC FCfmi_APS1_min "FCtl_FMI(466)" VALUE 0x001E5AD3 /* @ECU_Address@FCtl_FMI@0x021B71D2@ */ ECIPP_ALIGNMENT_UBYTE 255 Compu_IDENTITY 0 255 PHYS_UNIT "FMI" /end CHARACTERISTIC
/begin CHARACTERISTIC FCfmi_APS12_OOR "FCtl_FMI(473)" VALUE 0x001E5ADA /* @ECU_Address@FCtl_FMI@0x021B71D9@ */ ECIPP_ALIGNMENT_UBYTE 255 Compu_IDENTITY 0 255 PHYS_UNIT "FMI" /end CHARACTERISTIC
/begin CHARACTERISTIC FCfmi_APS12pct_hi "FCtl_FMI(469)" VALUE 0x001E5AD6 /* @ECU_Address@FCtl_FMI@0x021B71D5@ */ ECIPP_ALIGNMENT_UBYTE 255 Compu_IDENTITY 0 255 PHYS_UNIT "FMI" /end CHARACTERISTIC
/begin CHARACTERISTIC FCfmi_APS12pct_lo "FCtl_FMI(470)" VALUE 0x001E5AD7 /* @ECU_Address@FCtl_FMI@0x021B71D6@ */ ECIPP_ALIGNMENT_UBYTE 255 Compu_IDENTITY 0 255 PHYS_UNIT "FMI" /end CHARACTERISTIC
/begin CHARACTERISTIC FCfmi_APS2_max "FCtl_FMI(467)" VALUE 0x001E5AD4 /* @ECU_Address@FCtl_FMI@0x021B71D3@ */ ECIPP_ALIGNMENT_UBYTE 255 Compu_IDENTITY 0 255 PHYS_UNIT "FMI" /end CHARACTERISTIC
/begin CHARACTERISTIC FCfmi_APS2_min "FCtl_FMI(468)" VALUE 0x001E5AD5 /* @ECU_Address@FCtl_FMI@0x021B71D4@ */ ECIPP_ALIGNMENT_UBYTE 255 Compu_IDENTITY 0 255 PHYS_UNIT "FMI" /end CHARACTERISTIC
/begin CHARACTERISTIC FCfmi_APSerr_neg "FCtl_FMI(472)" VALUE 0x001E5AD9 /* @ECU_Address@FCtl_FMI@0x021B71D8@ */ ECIPP_ALIGNMENT_UBYTE 255 Compu_IDENTITY 0 255 PHYS_UNIT "FMI" /end CHARACTERISTIC
/begin CHARACTERISTIC FCfmi_APSerr_pos "FCtl_FMI(471)" VALUE 0x001E5AD8 /* @ECU_Address@FCtl_FMI@0x021B71D7@ */ ECIPP_ALIGNMENT_UBYTE 255 Compu_IDENTITY 0 255 PHYS_UNIT "FMI" /end CHARACTERISTIC
/begin CHARACTERISTIC FCfmi_APU1_max "FCtl_FMI(118)" VALUE 0x001E5977 /* @ECU_Address@FCtl_FMI@0x021B7076@ */ ECIPP_ALIGNMENT_UBYTE 255 Compu_IDENTITY 0 255 PHYS_UNIT "FMI" /end CHARACTERISTIC
/begin CHARACTERISTIC FCfmi_APU1_min "FCtl_FMI(119)" VALUE 0x001E5978 /* @ECU_Address@FCtl_FMI@0x021B7077@ */ ECIPP_ALIGNMENT_UBYTE 255 Compu_IDENTITY 0 255 PHYS_UNIT "FMI" /end CHARACTERISTIC
/begin CHARACTERISTIC FCfmi_APU2_max "FCtl_FMI(120)" VALUE 0x001E5979 /* @ECU_Address@FCtl_FMI@0x021B7078@ */ ECIPP_ALIGNMENT_UBYTE 255 Compu_IDENTITY 0 255 PHYS_UNIT "FMI" /end CHARACTERISTIC
/begin CHARACTERISTIC FCfmi_APU2_min "FCtl_FMI(121)" VALUE 0x001E597A /* @ECU_Address@FCtl_FMI@0x021B7079@ */ ECIPP_ALIGNMENT_UBYTE 255 Compu_IDENTITY 0 255 PHYS_UNIT "FMI" /end CHARACTERISTIC
/begin CHARACTERISTIC FCfmi_APU3_max "FCtl_FMI(201)" VALUE 0x001E59CA /* @ECU_Address@FCtl_FMI@0x021B70C9@ */ ECIPP_ALIGNMENT_UBYTE 255 Compu_IDENTITY 0 255 PHYS_UNIT "FMI" /end CHARACTERISTIC
/begin CHARACTERISTIC FCfmi_APU3_min "FCtl_FMI(202)" VALUE 0x001E59CB /* @ECU_Address@FCtl_FMI@0x021B70CA@ */ ECIPP_ALIGNMENT_UBYTE 255 Compu_IDENTITY 0 255 PHYS_UNIT "FMI" /end CHARACTERISTIC
/begin CHARACTERISTIC FCfmi_APUD1_max "FCtl_FMI(203)" VALUE 0x001E59CC /* @ECU_Address@FCtl_FMI@0x021B70CB@ */ ECIPP_ALIGNMENT_UBYTE 255 Compu_IDENTITY 0 255 PHYS_UNIT "FMI" /end CHARACTERISTIC
/begin CHARACTERISTIC FCfmi_APUD1_min "FCtl_FMI(204)" VALUE 0x001E59CD /* @ECU_Address@FCtl_FMI@0x021B70CC@ */ ECIPP_ALIGNMENT_UBYTE 255 Compu_IDENTITY 0 255 PHYS_UNIT "FMI" /end CHARACTERISTIC
/begin CHARACTERISTIC FCfmi_APUD10_max "FCtl_FMI(361)" VALUE 0x001E5A6A /* @ECU_Address@FCtl_FMI@0x021B7169@ */ ECIPP_ALIGNMENT_UBYTE 255 Compu_IDENTITY 0 255 PHYS_UNIT "FMI" /end CHARACTERISTIC
/begin CHARACTERISTIC FCfmi_APUD10_min "FCtl_FMI(362)" VALUE 0x001E5A6B /* @ECU_Address@FCtl_FMI@0x021B716A@ */ ECIPP_ALIGNMENT_UBYTE 255 Compu_IDENTITY 0 255 PHYS_UNIT "FMI" /end CHARACTERISTIC
/begin CHARACTERISTIC FCfmi_APUD11_max "FCtl_FMI(363)" VALUE 0x001E5A6C /* @ECU_Address@FCtl_FMI@0x021B716B@ */ ECIPP_ALIGNMENT_UBYTE 255 Compu_IDENTITY 0 255 PHYS_UNIT "FMI" /end CHARACTERISTIC
/begin CHARACTERISTIC FCfmi_APUD11_min "FCtl_FMI(364)" VALUE 0x001E5A6D /* @ECU_Address@FCtl_FMI@0x021B716C@ */ ECIPP_ALIGNMENT_UBYTE 255 Compu_IDENTITY 0 255 PHYS_UNIT "FMI" /end CHARACTERISTIC
/begin CHARACTERISTIC FCfmi_APUD12_max "FCtl_FMI(365)" VALUE 0x001E5A6E /* @ECU_Address@FCtl_FMI@0x021B716D@ */ ECIPP_ALIGNMENT_UBYTE 255 Compu_IDENTITY 0 255 PHYS_UNIT "FMI" /end CHARACTERISTIC
/begin CHARACTERISTIC FCfmi_APUD12_min "FCtl_FMI(366)" VALUE 0x001E5A6F /* @ECU_Address@FCtl_FMI@0x021B716E@ */ ECIPP_ALIGNMENT_UBYTE 255 Compu_IDENTITY 0 255 PHYS_UNIT "FMI" /end CHARACTERISTIC
/begin CHARACTERISTIC FCfmi_APUD13_max "FCtl_FMI(367)" VALUE 0x001E5A70 /* @ECU_Address@FCtl_FMI@0x021B716F@ */ ECIPP_ALIGNMENT_UBYTE 255 Compu_IDENTITY 0 255 PHYS_UNIT "FMI" /end CHARACTERISTIC
/begin CHARACTERISTIC FCfmi_APUD13_min "FCtl_FMI(368)" VALUE 0x001E5A71 /* @ECU_Address@FCtl_FMI@0x021B7170@ */ ECIPP_ALIGNMENT_UBYTE 255 Compu_IDENTITY 0 255 PHYS_UNIT "FMI" /end CHARACTERISTIC
/begin CHARACTERISTIC FCfmi_APUD14_max "FCtl_FMI(369)" VALUE 0x001E5A72 /* @ECU_Address@FCtl_FMI@0x021B7171@ */ ECIPP_ALIGNMENT_UBYTE 255 Compu_IDENTITY 0 255 PHYS_UNIT "FMI" /end CHARACTERISTIC
/begin CHARACTERISTIC FCfmi_APUD14_min "FCtl_FMI(370)" VALUE 0x001E5A73 /* @ECU_Address@FCtl_FMI@0x021B7172@ */ ECIPP_ALIGNMENT_UBYTE 255 Compu_IDENTITY 0 255 PHYS_UNIT "FMI" /end CHARACTERISTIC
/begin CHARACTERISTIC FCfmi_APUD15_max "FCtl_FMI(371)" VALUE 0x001E5A74 /* @ECU_Address@FCtl_FMI@0x021B7173@ */ ECIPP_ALIGNMENT_UBYTE 255 Compu_IDENTITY 0 255 PHYS_UNIT "FMI" /end CHARACTERISTIC
/begin CHARACTERISTIC FCfmi_APUD15_min "FCtl_FMI(372)" VALUE 0x001E5A75 /* @ECU_Address@FCtl_FMI@0x021B7174@ */ ECIPP_ALIGNMENT_UBYTE 255 Compu_IDENTITY 0 255 PHYS_UNIT "FMI" /end CHARACTERISTIC
/begin CHARACTERISTIC FCfmi_APUD16_max "FCtl_FMI(373)" VALUE 0x001E5A76 /* @ECU_Address@FCtl_FMI@0x021B7175@ */ ECIPP_ALIGNMENT_UBYTE 255 Compu_IDENTITY 0 255 PHYS_UNIT "FMI" /end CHARACTERISTIC
/begin CHARACTERISTIC FCfmi_APUD16_min "FCtl_FMI(374)" VALUE 0x001E5A77 /* @ECU_Address@FCtl_FMI@0x021B7176@ */ ECIPP_ALIGNMENT_UBYTE 255 Compu_IDENTITY 0 255 PHYS_UNIT "FMI" /end CHARACTERISTIC
/begin CHARACTERISTIC FCfmi_APUD17_max "FCtl_FMI(375)" VALUE 0x001E5A78 /* @ECU_Address@FCtl_FMI@0x021B7177@ */ ECIPP_ALIGNMENT_UBYTE 255 Compu_IDENTITY 0 255 PHYS_UNIT "FMI" /end CHARACTERISTIC
/begin CHARACTERISTIC FCfmi_APUD17_min "FCtl_FMI(376)" VALUE 0x001E5A79 /* @ECU_Address@FCtl_FMI@0x021B7178@ */ ECIPP_ALIGNMENT_UBYTE 255 Compu_IDENTITY 0 255 PHYS_UNIT "FMI" /end CHARACTERISTIC
/begin CHARACTERISTIC FCfmi_APUD18_max "FCtl_FMI(377)" VALUE 0x001E5A7A /* @ECU_Address@FCtl_FMI@0x021B7179@ */ ECIPP_ALIGNMENT_UBYTE 255 Compu_IDENTITY 0 255 PHYS_UNIT "FMI" /end CHARACTERISTIC
/begin CHARACTERISTIC FCfmi_APUD18_min "FCtl_FMI(378)" VALUE 0x001E5A7B /* @ECU_Address@FCtl_FMI@0x021B717A@ */ ECIPP_ALIGNMENT_UBYTE 255 Compu_IDENTITY 0 255 PHYS_UNIT "FMI" /end CHARACTERISTIC
/begin CHARACTERISTIC FCfmi_APUD19_max "FCtl_FMI(379)" VALUE 0x001E5A7C /* @ECU_Address@FCtl_FMI@0x021B717B@ */ ECIPP_ALIGNMENT_UBYTE 255 Compu_IDENTITY 0 255 PHYS_UNIT "FMI" /end CHARACTERISTIC
/begin CHARACTERISTIC FCfmi_APUD19_min "FCtl_FMI(380)" VALUE 0x001E5A7D /* @ECU_Address@FCtl_FMI@0x021B717C@ */ ECIPP_ALIGNMENT_UBYTE 255 Compu_IDENTITY 0 255 PHYS_UNIT "FMI" /end CHARACTERISTIC
/begin CHARACTERISTIC FCftb_ADIG22_min "FCtl_FTB_0x04(589)" VALUE 0x001E5F64 /* @ECU_Address@FCtl_FTB_0x04@0x024C524D@ */ ECIPP_ALIGNMENT_UBYTE 255 Compu_IDENTITY 0 255 PHYS_UNIT "FTB" /end CHARACTERISTIC
/begin CHARACTERISTIC FCftb_ADIG23_max "FCtl_FTB_0x04(590)" VALUE 0x001E5F65 /* @ECU_Address@FCtl_FTB_0x04@0x024C524E@ */ ECIPP_ALIGNMENT_UBYTE 255 Compu_IDENTITY 0 255 PHYS_UNIT "FTB" /end CHARACTERISTIC
/begin CHARACTERISTIC FCftb_ADIG23_min "FCtl_FTB_0x04(591)" VALUE 0x001E5F66 /* @ECU_Address@FCtl_FTB_0x04@0x024C524F@ */ ECIPP_ALIGNMENT_UBYTE 255 Compu_IDENTITY 0 255 PHYS_UNIT "FTB" /end CHARACTERISTIC
/begin CHARACTERISTIC FCftb_ADIG24_max "FCtl_FTB_0x04(592)" VALUE 0x001E5F67 /* @ECU_Address@FCtl_FTB_0x04@0x024C5250@ */ ECIPP_ALIGNMENT_UBYTE 255 Compu_IDENTITY 0 255 PHYS_UNIT "FTB" /end CHARACTERISTIC
/begin CHARACTERISTIC FCftb_ADIG24_min "FCtl_FTB_0x04(593)" VALUE 0x001E5F68 /* @ECU_Address@FCtl_FTB_0x04@0x024C5251@ */ ECIPP_ALIGNMENT_UBYTE 255 Compu_IDENTITY 0 255 PHYS_UNIT "FTB" /end CHARACTERISTIC
/begin CHARACTERISTIC FCftb_ADIG25_max "FCtl_FTB_0x04(594)" VALUE 0x001E5F69 /* @ECU_Address@FCtl_FTB_0x04@0x024C5252@ */ ECIPP_ALIGNMENT_UBYTE 255 Compu_IDENTITY 0 255 PHYS_UNIT "FTB" /end CHARACTERISTIC
/begin CHARACTERISTIC FCftb_ADIG25_min "FCtl_FTB_0x04(595)" VALUE 0x001E5F6A /* @ECU_Address@FCtl_FTB_0x04@0x024C5253@ */ ECIPP_ALIGNMENT_UBYTE 255 Compu_IDENTITY 0 255 PHYS_UNIT "FTB" /end CHARACTERISTIC
/begin CHARACTERISTIC FCftb_ADIG3_max "FCtl_FTB_0x04(213)" VALUE 0x001E5DEC /* @ECU_Address@FCtl_FTB_0x04@0x024C50D5@ */ ECIPP_ALIGNMENT_UBYTE 255 Compu_IDENTITY 0 255 PHYS_UNIT "FTB" /end CHARACTERISTIC
/begin CHARACTERISTIC FCftb_ADIG3_min "FCtl_FTB_0x04(214)" VALUE 0x001E5DED /* @ECU_Address@FCtl_FTB_0x04@0x024C50D6@ */ ECIPP_ALIGNMENT_UBYTE 255 Compu_IDENTITY 0 255 PHYS_UNIT "FTB" /end CHARACTERISTIC
/begin CHARACTERISTIC FCftb_ADIG4_max "FCtl_FTB_0x04(337)" VALUE 0x001E5E68 /* @ECU_Address@FCtl_FTB_0x04@0x024C5151@ */ ECIPP_ALIGNMENT_UBYTE 255 Compu_IDENTITY 0 255 PHYS_UNIT "FTB" /end CHARACTERISTIC
/begin CHARACTERISTIC FCftb_ADIG4_min "FCtl_FTB_0x04(338)" VALUE 0x001E5E69 /* @ECU_Address@FCtl_FTB_0x04@0x024C5152@ */ ECIPP_ALIGNMENT_UBYTE 255 Compu_IDENTITY 0 255 PHYS_UNIT "FTB" /end CHARACTERISTIC
/begin CHARACTERISTIC FCftb_ADIG5_max "FCtl_FTB_0x04(339)" VALUE 0x001E5E6A /* @ECU_Address@FCtl_FTB_0x04@0x024C5153@ */ ECIPP_ALIGNMENT_UBYTE 255 Compu_IDENTITY 0 255 PHYS_UNIT "FTB" /end CHARACTERISTIC
/begin CHARACTERISTIC FCftb_ADIG5_min "FCtl_FTB_0x04(340)" VALUE 0x001E5E6B /* @ECU_Address@FCtl_FTB_0x04@0x024C5154@ */ ECIPP_ALIGNMENT_UBYTE 255 Compu_IDENTITY 0 255 PHYS_UNIT "FTB" /end CHARACTERISTIC
/begin CHARACTERISTIC FCftb_ADIG6_max "FCtl_FTB_0x04(341)" VALUE 0x001E5E6C /* @ECU_Address@FCtl_FTB_0x04@0x024C5155@ */ ECIPP_ALIGNMENT_UBYTE 255 Compu_IDENTITY 0 255 PHYS_UNIT "FTB" /end CHARACTERISTIC
/begin CHARACTERISTIC FCftb_ADIG6_min "FCtl_FTB_0x04(342)" VALUE 0x001E5E6D /* @ECU_Address@FCtl_FTB_0x04@0x024C5156@ */ ECIPP_ALIGNMENT_UBYTE 255 Compu_IDENTITY 0 255 PHYS_UNIT "FTB" /end CHARACTERISTIC
/begin CHARACTERISTIC FCftb_ADIG7_max "FCtl_FTB_0x04(343)" VALUE 0x001E5E6E /* @ECU_Address@FCtl_FTB_0x04@0x024C5157@ */ ECIPP_ALIGNMENT_UBYTE 255 Compu_IDENTITY 0 255 PHYS_UNIT "FTB" /end CHARACTERISTIC
/begin CHARACTERISTIC FCftb_ADIG7_min "FCtl_FTB_0x04(344)" VALUE 0x001E5E6F /* @ECU_Address@FCtl_FTB_0x04@0x024C5158@ */ ECIPP_ALIGNMENT_UBYTE 255 Compu_IDENTITY 0 255 PHYS_UNIT "FTB" /end CHARACTERISTIC
/begin CHARACTERISTIC FCftb_ADIG8_max "FCtl_FTB_0x04(345)" VALUE 0x001E5E70 /* @ECU_Address@FCtl_FTB_0x04@0x024C5159@ */ ECIPP_ALIGNMENT_UBYTE 255 Compu_IDENTITY 0 255 PHYS_UNIT "FTB" /end CHARACTERISTIC
/begin CHARACTERISTIC FCftb_ADIG8_min "FCtl_FTB_0x04(346)" VALUE 0x001E5E71 /* @ECU_Address@FCtl_FTB_0x04@0x024C515A@ */ ECIPP_ALIGNMENT_UBYTE 255 Compu_IDENTITY 0 255 PHYS_UNIT "FTB" /end CHARACTERISTIC
/begin CHARACTERISTIC FCftb_ADIG9_max "FCtl_FTB_0x04(347)" VALUE 0x001E5E72 /* @ECU_Address@FCtl_FTB_0x04@0x024C515B@ */ ECIPP_ALIGNMENT_UBYTE 255 Compu_IDENTITY 0 255 PHYS_UNIT "FTB" /end CHARACTERISTIC
/begin CHARACTERISTIC FCftb_ADIG9_min "FCtl_FTB_0x04(348)" VALUE 0x001E5E73 /* @ECU_Address@FCtl_FTB_0x04@0x024C515C@ */ ECIPP_ALIGNMENT_UBYTE 255 Compu_IDENTITY 0 255 PHYS_UNIT "FTB" /end CHARACTERISTIC
/begin CHARACTERISTIC FCftb_ADloss "FCtl_FTB_0x04(103)" VALUE 0x001E5D7E /* @ECU_Address@FCtl_FTB_0x04@0x024C5067@ */ ECIPP_ALIGNMENT_UBYTE 255 Compu_IDENTITY 0 255 PHYS_UNIT "FTB" /end CHARACTERISTIC
/begin CHARACTERISTIC FCftb_AFILT_dP_high "FCtl_FTB_0x04(732)" VALUE 0x001E5FF3 /* @ECU_Address@FCtl_FTB_0x04@0x024C52DC@ */ ECIPP_ALIGNMENT_UBYTE 255 Compu_IDENTITY 0 255 PHYS_UNIT "FTB" /end CHARACTERISTIC
/begin CHARACTERISTIC FCftb_AL_hi "FCtl_FTB_0x04(30)" VALUE 0x001E5D35 /* @ECU_Address@FCtl_FTB_0x04@0x024C501E@ */ ECIPP_ALIGNMENT_UBYTE 255 Compu_IDENTITY 0 255 PHYS_UNIT "FTB" /end CHARACTERISTIC
/begin CHARACTERISTIC FCftb_AL_lo "FCtl_FTB_0x04(31)" VALUE 0x001E5D36 /* @ECU_Address@FCtl_FTB_0x04@0x024C501F@ */ ECIPP_ALIGNMENT_UBYTE 255 Compu_IDENTITY 0 255 PHYS_UNIT "FTB" /end CHARACTERISTIC
/begin CHARACTERISTIC FCftb_ALLP_hi "FCtl_FTB_0x04(42)" VALUE 0x001E5D41 /* @ECU_Address@FCtl_FTB_0x04@0x024C502A@ */ ECIPP_ALIGNMENT_UBYTE 255 Compu_IDENTITY 0 255 PHYS_UNIT "FTB" /end CHARACTERISTIC
/begin CHARACTERISTIC FCftb_ALLP_lo "FCtl_FTB_0x04(43)" VALUE 0x001E5D42 /* @ECU_Address@FCtl_FTB_0x04@0x024C502B@ */ ECIPP_ALIGNMENT_UBYTE 255 Compu_IDENTITY 0 255 PHYS_UNIT "FTB" /end CHARACTERISTIC
/begin CHARACTERISTIC FCftb_ALNG_hi "FCtl_FTB_0x04(44)" VALUE 0x001E5D43 /* @ECU_Address@FCtl_FTB_0x04@0x024C502C@ */ ECIPP_ALIGNMENT_UBYTE 255 Compu_IDENTITY 0 255 PHYS_UNIT "FTB" /end CHARACTERISTIC
/begin CHARACTERISTIC FCftb_ALNG_lo "FCtl_FTB_0x04(45)" VALUE 0x001E5D44 /* @ECU_Address@FCtl_FTB_0x04@0x024C502D@ */ ECIPP_ALIGNMENT_UBYTE 255 Compu_IDENTITY 0 255 PHYS_UNIT "FTB" /end CHARACTERISTIC
/begin CHARACTERISTIC FCftb_APD1_max "FCtl_FTB_0x04(116)" VALUE 0x001E5D8B /* @ECU_Address@FCtl_FTB_0x04@0x024C5074@ */ ECIPP_ALIGNMENT_UBYTE 255 Compu_IDENTITY 0 255 PHYS_UNIT "FTB" /end CHARACTERISTIC
/begin CHARACTERISTIC FCftb_APD1_min "FCtl_FTB_0x04(117)" VALUE 0x001E5D8C /* @ECU_Address@FCtl_FTB_0x04@0x024C5075@ */ ECIPP_ALIGNMENT_UBYTE 255 Compu_IDENTITY 0 255 PHYS_UNIT "FTB" /end CHARACTERISTIC
/begin CHARACTERISTIC FCftb_APD2_max "FCtl_FTB_0x04(229)" VALUE 0x001E5DFC /* @ECU_Address@FCtl_FTB_0x04@0x024C50E5@ */ ECIPP_ALIGNMENT_UBYTE 255 Compu_IDENTITY 0 255 PHYS_UNIT "FTB" /end CHARACTERISTIC
/begin CHARACTERISTIC FCftb_APD2_min "FCtl_FTB_0x04(230)" VALUE 0x001E5DFD /* @ECU_Address@FCtl_FTB_0x04@0x024C50E6@ */ ECIPP_ALIGNMENT_UBYTE 255 Compu_IDENTITY 0 255 PHYS_UNIT "FTB" /end CHARACTERISTIC
/begin CHARACTERISTIC FCftb_APD3_max "FCtl_FTB_0x04(231)" VALUE 0x001E5DFE /* @ECU_Address@FCtl_FTB_0x04@0x024C50E7@ */ ECIPP_ALIGNMENT_UBYTE 255 Compu_IDENTITY 0 255 PHYS_UNIT "FTB" /end CHARACTERISTIC
/begin CHARACTERISTIC FCftb_APD3_min "FCtl_FTB_0x04(232)" VALUE 0x001E5DFF /* @ECU_Address@FCtl_FTB_0x04@0x024C50E8@ */ ECIPP_ALIGNMENT_UBYTE 255 Compu_IDENTITY 0 255 PHYS_UNIT "FTB" /end CHARACTERISTIC
/begin CHARACTERISTIC FCftb_APS1_max "FCtl_FTB_0x04(465)" VALUE 0x001E5EE8 /* @ECU_Address@FCtl_FTB_0x04@0x024C51D1@ */ ECIPP_ALIGNMENT_UBYTE 255 Compu_IDENTITY 0 255 PHYS_UNIT "FTB" /end CHARACTERISTIC
/begin CHARACTERISTIC FCftb_APS1_min "FCtl_FTB_0x04(466)" VALUE 0x001E5EE9 /* @ECU_Address@FCtl_FTB_0x04@0x024C51D2@ */ ECIPP_ALIGNMENT_UBYTE 255 Compu_IDENTITY 0 255 PHYS_UNIT "FTB" /end CHARACTERISTIC
/begin CHARACTERISTIC FCftb_APS12_OOR "FCtl_FTB_0x04(473)" VALUE 0x001E5EF0 /* @ECU_Address@FCtl_FTB_0x04@0x024C51D9@ */ ECIPP_ALIGNMENT_UBYTE 255 Compu_IDENTITY 0 255 PHYS_UNIT "FTB" /end CHARACTERISTIC
/begin CHARACTERISTIC FCftb_APS12pct_hi "FCtl_FTB_0x04(469)" VALUE 0x001E5EEC /* @ECU_Address@FCtl_FTB_0x04@0x024C51D5@ */ ECIPP_ALIGNMENT_UBYTE 255 Compu_IDENTITY 0 255 PHYS_UNIT "FTB" /end CHARACTERISTIC
/begin CHARACTERISTIC FCftb_APS12pct_lo "FCtl_FTB_0x04(470)" VALUE 0x001E5EED /* @ECU_Address@FCtl_FTB_0x04@0x024C51D6@ */ ECIPP_ALIGNMENT_UBYTE 255 Compu_IDENTITY 0 255 PHYS_UNIT "FTB" /end CHARACTERISTIC
/begin CHARACTERISTIC FCftb_APS2_max "FCtl_FTB_0x04(467)" VALUE 0x001E5EEA /* @ECU_Address@FCtl_FTB_0x04@0x024C51D3@ */ ECIPP_ALIGNMENT_UBYTE 255 Compu_IDENTITY 0 255 PHYS_UNIT "FTB" /end CHARACTERISTIC
/begin CHARACTERISTIC FCftb_APS2_min "FCtl_FTB_0x04(468)" VALUE 0x001E5EEB /* @ECU_Address@FCtl_FTB_0x04@0x024C51D4@ */ ECIPP_ALIGNMENT_UBYTE 255 Compu_IDENTITY 0 255 PHYS_UNIT "FTB" /end CHARACTERISTIC
/begin CHARACTERISTIC FCftb_APSerr_neg "FCtl_FTB_0x04(472)" VALUE 0x001E5EEF /* @ECU_Address@FCtl_FTB_0x04@0x024C51D8@ */ ECIPP_ALIGNMENT_UBYTE 255 Compu_IDENTITY 0 255 PHYS_UNIT "FTB" /end CHARACTERISTIC
/begin CHARACTERISTIC FCftb_APSerr_pos "FCtl_FTB_0x04(471)" VALUE 0x001E5EEE /* @ECU_Address@FCtl_FTB_0x04@0x024C51D7@ */ ECIPP_ALIGNMENT_UBYTE 255 Compu_IDENTITY 0 255 PHYS_UNIT "FTB" /end CHARACTERISTIC
/begin CHARACTERISTIC FCftb_APU1_max "FCtl_FTB_0x04(118)" VALUE 0x001E5D8D /* @ECU_Address@FCtl_FTB_0x04@0x024C5076@ */ ECIPP_ALIGNMENT_UBYTE 255 Compu_IDENTITY 0 255 PHYS_UNIT "FTB" /end CHARACTERISTIC
/begin CHARACTERISTIC FCftb_APU1_min "FCtl_FTB_0x04(119)" VALUE 0x001E5D8E /* @ECU_Address@FCtl_FTB_0x04@0x024C5077@ */ ECIPP_ALIGNMENT_UBYTE 255 Compu_IDENTITY 0 255 PHYS_UNIT "FTB" /end CHARACTERISTIC
/begin CHARACTERISTIC FCftb_APU2_max "FCtl_FTB_0x04(120)" VALUE 0x001E5D8F /* @ECU_Address@FCtl_FTB_0x04@0x024C5078@ */ ECIPP_ALIGNMENT_UBYTE 255 Compu_IDENTITY 0 255 PHYS_UNIT "FTB" /end CHARACTERISTIC
/begin CHARACTERISTIC FCftb_APU2_min "FCtl_FTB_0x04(121)" VALUE 0x001E5D90 /* @ECU_Address@FCtl_FTB_0x04@0x024C5079@ */ ECIPP_ALIGNMENT_UBYTE 255 Compu_IDENTITY 0 255 PHYS_UNIT "FTB" /end CHARACTERISTIC
/begin CHARACTERISTIC FCftb_APU3_max "FCtl_FTB_0x04(201)" VALUE 0x001E5DE0 /* @ECU_Address@FCtl_FTB_0x04@0x024C50C9@ */ ECIPP_ALIGNMENT_UBYTE 255 Compu_IDENTITY 0 255 PHYS_UNIT "FTB" /end CHARACTERISTIC
/begin CHARACTERISTIC FCftb_APU3_min "FCtl_FTB_0x04(202)" VALUE 0x001E5DE1 /* @ECU_Address@FCtl_FTB_0x04@0x024C50CA@ */ ECIPP_ALIGNMENT_UBYTE 255 Compu_IDENTITY 0 255 PHYS_UNIT "FTB" /end CHARACTERISTIC
/begin CHARACTERISTIC FCftb_APUD1_max "FCtl_FTB_0x04(203)" VALUE 0x001E5DE2 /* @ECU_Address@FCtl_FTB_0x04@0x024C50CB@ */ ECIPP_ALIGNMENT_UBYTE 255 Compu_IDENTITY 0 255 PHYS_UNIT "FTB" /end CHARACTERISTIC
/begin CHARACTERISTIC FCftb_APUD1_min "FCtl_FTB_0x04(204)" VALUE 0x001E5DE3 /* @ECU_Address@FCtl_FTB_0x04@0x024C50CC@ */ ECIPP_ALIGNMENT_UBYTE 255 Compu_IDENTITY 0 255 PHYS_UNIT "FTB" /end CHARACTERISTIC
/begin CHARACTERISTIC FCftb_APUD10_max "FCtl_FTB_0x04(361)" VALUE 0x001E5E80 /* @ECU_Address@FCtl_FTB_0x04@0x024C5169@ */ ECIPP_ALIGNMENT_UBYTE 255 Compu_IDENTITY 0 255 PHYS_UNIT "FTB" /end CHARACTERISTIC
/begin CHARACTERISTIC FCftb_APUD10_min "FCtl_FTB_0x04(362)" VALUE 0x001E5E81 /* @ECU_Address@FCtl_FTB_0x04@0x024C516A@ */ ECIPP_ALIGNMENT_UBYTE 255 Compu_IDENTITY 0 255 PHYS_UNIT "FTB" /end CHARACTERISTIC
/begin CHARACTERISTIC FCftb_APUD11_max "FCtl_FTB_0x04(363)" VALUE 0x001E5E82 /* @ECU_Address@FCtl_FTB_0x04@0x024C516B@ */ ECIPP_ALIGNMENT_UBYTE 255 Compu_IDENTITY 0 255 PHYS_UNIT "FTB" /end CHARACTERISTIC
/begin CHARACTERISTIC FCftb_APUD11_min "FCtl_FTB_0x04(364)" VALUE 0x001E5E83 /* @ECU_Address@FCtl_FTB_0x04@0x024C516C@ */ ECIPP_ALIGNMENT_UBYTE 255 Compu_IDENTITY 0 255 PHYS_UNIT "FTB" /end CHARACTERISTIC
/begin CHARACTERISTIC FCftb_APUD12_max "FCtl_FTB_0x04(365)" VALUE 0x001E5E84 /* @ECU_Address@FCtl_FTB_0x04@0x024C516D@ */ ECIPP_ALIGNMENT_UBYTE 255 Compu_IDENTITY 0 255 PHYS_UNIT "FTB" /end CHARACTERISTIC
/begin CHARACTERISTIC FCftb_APUD12_min "FCtl_FTB_0x04(366)" VALUE 0x001E5E85 /* @ECU_Address@FCtl_FTB_0x04@0x024C516E@ */ ECIPP_ALIGNMENT_UBYTE 255 Compu_IDENTITY 0 255 PHYS_UNIT "FTB" /end CHARACTERISTIC
/begin CHARACTERISTIC FCftb_APUD13_max "FCtl_FTB_0x04(367)" VALUE 0x001E5E86 /* @ECU_Address@FCtl_FTB_0x04@0x024C516F@ */ ECIPP_ALIGNMENT_UBYTE 255 Compu_IDENTITY 0 255 PHYS_UNIT "FTB" /end CHARACTERISTIC
/begin CHARACTERISTIC FCftb_APUD13_min "FCtl_FTB_0x04(368)" VALUE 0x001E5E87 /* @ECU_Address@FCtl_FTB_0x04@0x024C5170@ */ ECIPP_ALIGNMENT_UBYTE 255 Compu_IDENTITY 0 255 PHYS_UNIT "FTB" /end CHARACTERISTIC
/begin CHARACTERISTIC FCftb_APUD14_max "FCtl_FTB_0x04(369)" VALUE 0x001E5E88 /* @ECU_Address@FCtl_FTB_0x04@0x024C5171@ */ ECIPP_ALIGNMENT_UBYTE 255 Compu_IDENTITY 0 255 PHYS_UNIT "FTB" /end CHARACTERISTIC
/begin CHARACTERISTIC FCftb_APUD14_min "FCtl_FTB_0x04(370)" VALUE 0x001E5E89 /* @ECU_Address@FCtl_FTB_0x04@0x024C5172@ */ ECIPP_ALIGNMENT_UBYTE 255 Compu_IDENTITY 0 255 PHYS_UNIT "FTB" /end CHARACTERISTIC
/begin CHARACTERISTIC FCftb_APUD15_max "FCtl_FTB_0x04(371)" VALUE 0x001E5E8A /* @ECU_Address@FCtl_FTB_0x04@0x024C5173@ */ ECIPP_ALIGNMENT_UBYTE 255 Compu_IDENTITY 0 255 PHYS_UNIT "FTB" /end CHARACTERISTIC
/begin CHARACTERISTIC FCftb_APUD15_min "FCtl_FTB_0x04(372)" VALUE 0x001E5E8B /* @ECU_Address@FCtl_FTB_0x04@0x024C5174@ */ ECIPP_ALIGNMENT_UBYTE 255 Compu_IDENTITY 0 255 PHYS_UNIT "FTB" /end CHARACTERISTIC
/begin CHARACTERISTIC FCftb_APUD16_max "FCtl_FTB_0x04(373)" VALUE 0x001E5E8C /* @ECU_Address@FCtl_FTB_0x04@0x024C5175@ */ ECIPP_ALIGNMENT_UBYTE 255 Compu_IDENTITY 0 255 PHYS_UNIT "FTB" /end CHARACTERISTIC
/begin CHARACTERISTIC FCftb_APUD16_min "FCtl_FTB_0x04(374)" VALUE 0x001E5E8D /* @ECU_Address@FCtl_FTB_0x04@0x024C5176@ */ ECIPP_ALIGNMENT_UBYTE 255 Compu_IDENTITY 0 255 PHYS_UNIT "FTB" /end CHARACTERISTIC
/begin CHARACTERISTIC FCftb_APUD17_max "FCtl_FTB_0x04(375)" VALUE 0x001E5E8E /* @ECU_Address@FCtl_FTB_0x04@0x024C5177@ */ ECIPP_ALIGNMENT_UBYTE 255 Compu_IDENTITY 0 255 PHYS_UNIT "FTB" /end CHARACTERISTIC
/begin CHARACTERISTIC FCftb_APUD17_min "FCtl_FTB_0x04(376)" VALUE 0x001E5E8F /* @ECU_Address@FCtl_FTB_0x04@0x024C5178@ */ ECIPP_ALIGNMENT_UBYTE 255 Compu_IDENTITY 0 255 PHYS_UNIT "FTB" /end CHARACTERISTIC
/begin CHARACTERISTIC FCftb_APUD18_max "FCtl_FTB_0x04(377)" VALUE 0x001E5E90 /* @ECU_Address@FCtl_FTB_0x04@0x024C5179@ */ ECIPP_ALIGNMENT_UBYTE 255 Compu_IDENTITY 0 255 PHYS_UNIT "FTB" /end CHARACTERISTIC
/begin CHARACTERISTIC FCftb_APUD18_min "FCtl_FTB_0x04(378)" VALUE 0x001E5E91 /* @ECU_Address@FCtl_FTB_0x04@0x024C517A@ */ ECIPP_ALIGNMENT_UBYTE 255 Compu_IDENTITY 0 255 PHYS_UNIT "FTB" /end CHARACTERISTIC
/begin CHARACTERISTIC FCftb_APUD19_max "FCtl_FTB_0x04(379)" VALUE 0x001E5E92 /* @ECU_Address@FCtl_FTB_0x04@0x024C517B@ */ ECIPP_ALIGNMENT_UBYTE 255 Compu_IDENTITY 0 255 PHYS_UNIT "FTB" /end CHARACTERISTIC
/begin CHARACTERISTIC FCftb_APUD19_min "FCtl_FTB_0x04(380)" VALUE 0x001E5E93 /* @ECU_Address@FCtl_FTB_0x04@0x024C517C@ */ ECIPP_ALIGNMENT_UBYTE 255 Compu_IDENTITY 0 255 PHYS_UNIT "FTB" /end CHARACTERISTIC
/begin CHARACTERISTIC FCspn_ADIG22_min "FCtl_SPN(589)" VALUE 0x001E2698 /* @ECU_Address@FCtl_SPN@0x21B60934@ */ ECIPP_ALIGNMENT_ULONG 4294967295 Compu_IDENTITY 0 4294967295 PHYS_UNIT "SPN" /end CHARACTERISTIC
/begin CHARACTERISTIC FCspn_ADIG23_max "FCtl_SPN(590)" VALUE 0x001E269C /* @ECU_Address@FCtl_SPN@0x21B60938@ */ ECIPP_ALIGNMENT_ULONG 4294967295 Compu_IDENTITY 0 4294967295 PHYS_UNIT "SPN" /end CHARACTERISTIC
/begin CHARACTERISTIC FCspn_ADIG23_min "FCtl_SPN(591)" VALUE 0x001E26A0 /* @ECU_Address@FCtl_SPN@0x21B6093C@ */ ECIPP_ALIGNMENT_ULONG 4294967295 Compu_IDENTITY 0 4294967295 PHYS_UNIT "SPN" /end CHARACTERISTIC
/begin CHARACTERISTIC FCspn_ADIG24_max "FCtl_SPN(592)" VALUE 0x001E26A4 /* @ECU_Address@FCtl_SPN@0x21B60940@ */ ECIPP_ALIGNMENT_ULONG 4294967295 Compu_IDENTITY 0 4294967295 PHYS_UNIT "SPN" /end CHARACTERISTIC
/begin CHARACTERISTIC FCspn_ADIG24_min "FCtl_SPN(593)" VALUE 0x001E26A8 /* @ECU_Address@FCtl_SPN@0x21B60944@ */ ECIPP_ALIGNMENT_ULONG 4294967295 Compu_IDENTITY 0 4294967295 PHYS_UNIT "SPN" /end CHARACTERISTIC
/begin CHARACTERISTIC FCspn_ADIG25_max "FCtl_SPN(594)" VALUE 0x001E26AC /* @ECU_Address@FCtl_SPN@0x21B60948@ */ ECIPP_ALIGNMENT_ULONG 4294967295 Compu_IDENTITY 0 4294967295 PHYS_UNIT "SPN" /end CHARACTERISTIC
/begin CHARACTERISTIC FCspn_ADIG25_min "FCtl_SPN(595)" VALUE 0x001E26B0 /* @ECU_Address@FCtl_SPN@0x21B6094C@ */ ECIPP_ALIGNMENT_ULONG 4294967295 Compu_IDENTITY 0 4294967295 PHYS_UNIT "SPN" /end CHARACTERISTIC
/begin CHARACTERISTIC FCspn_ADIG3_max "FCtl_SPN(213)" VALUE 0x001E20B8 /* @ECU_Address@FCtl_SPN@0x21B60354@ */ ECIPP_ALIGNMENT_ULONG 4294967295 Compu_IDENTITY 0 4294967295 PHYS_UNIT "SPN" /end CHARACTERISTIC
/begin CHARACTERISTIC FCspn_ADIG3_min "FCtl_SPN(214)" VALUE 0x001E20BC /* @ECU_Address@FCtl_SPN@0x21B60358@ */ ECIPP_ALIGNMENT_ULONG 4294967295 Compu_IDENTITY 0 4294967295 PHYS_UNIT "SPN" /end CHARACTERISTIC
/begin CHARACTERISTIC FCspn_ADIG4_max "FCtl_SPN(337)" VALUE 0x001E22A8 /* @ECU_Address@FCtl_SPN@0x21B60544@ */ ECIPP_ALIGNMENT_ULONG 4294967295 Compu_IDENTITY 0 4294967295 PHYS_UNIT "SPN" /end CHARACTERISTIC
/begin CHARACTERISTIC FCspn_ADIG4_min "FCtl_SPN(338)" VALUE 0x001E22AC /* @ECU_Address@FCtl_SPN@0x21B60548@ */ ECIPP_ALIGNMENT_ULONG 4294967295 Compu_IDENTITY 0 4294967295 PHYS_UNIT "SPN" /end CHARACTERISTIC
/begin CHARACTERISTIC FCspn_ADIG5_max "FCtl_SPN(339)" VALUE 0x001E22B0 /* @ECU_Address@FCtl_SPN@0x21B6054C@ */ ECIPP_ALIGNMENT_ULONG 4294967295 Compu_IDENTITY 0 4294967295 PHYS_UNIT "SPN" /end CHARACTERISTIC
/begin CHARACTERISTIC FCspn_ADIG5_min "FCtl_SPN(340)" VALUE 0x001E22B4 /* @ECU_Address@FCtl_SPN@0x21B60550@ */ ECIPP_ALIGNMENT_ULONG 4294967295 Compu_IDENTITY 0 4294967295 PHYS_UNIT "SPN" /end CHARACTERISTIC
/begin CHARACTERISTIC FCspn_ADIG6_max "FCtl_SPN(341)" VALUE 0x001E22B8 /* @ECU_Address@FCtl_SPN@0x21B60554@ */ ECIPP_ALIGNMENT_ULONG 4294967295 Compu_IDENTITY 0 4294967295 PHYS_UNIT "SPN" /end CHARACTERISTIC
/begin CHARACTERISTIC FCspn_ADIG6_min "FCtl_SPN(342)" VALUE 0x001E22BC /* @ECU_Address@FCtl_SPN@0x21B60558@ */ ECIPP_ALIGNMENT_ULONG 4294967295 Compu_IDENTITY 0 4294967295 PHYS_UNIT "SPN" /end CHARACTERISTIC
/begin CHARACTERISTIC FCspn_ADIG7_max "FCtl_SPN(343)" VALUE 0x001E22C0 /* @ECU_Address@FCtl_SPN@0x21B6055C@ */ ECIPP_ALIGNMENT_ULONG 4294967295 Compu_IDENTITY 0 4294967295 PHYS_UNIT "SPN" /end CHARACTERISTIC
/begin CHARACTERISTIC FCspn_ADIG7_min "FCtl_SPN(344)" VALUE 0x001E22C4 /* @ECU_Address@FCtl_SPN@0x21B60560@ */ ECIPP_ALIGNMENT_ULONG 4294967295 Compu_IDENTITY 0 4294967295 PHYS_UNIT "SPN" /end CHARACTERISTIC
/begin CHARACTERISTIC FCspn_ADIG8_max "FCtl_SPN(345)" VALUE 0x001E22C8 /* @ECU_Address@FCtl_SPN@0x21B60564@ */ ECIPP_ALIGNMENT_ULONG 4294967295 Compu_IDENTITY 0 4294967295 PHYS_UNIT "SPN" /end CHARACTERISTIC
/begin CHARACTERISTIC FCspn_ADIG8_min "FCtl_SPN(346)" VALUE 0x001E22CC /* @ECU_Address@FCtl_SPN@0x21B60568@ */ ECIPP_ALIGNMENT_ULONG 4294967295 Compu_IDENTITY 0 4294967295 PHYS_UNIT "SPN" /end CHARACTERISTIC
/begin CHARACTERISTIC FCspn_ADIG9_max "FCtl_SPN(347)" VALUE 0x001E22D0 /* @ECU_Address@FCtl_SPN@0x21B6056C@ */ ECIPP_ALIGNMENT_ULONG 4294967295 Compu_IDENTITY 0 4294967295 PHYS_UNIT "SPN" /end CHARACTERISTIC
/begin CHARACTERISTIC FCspn_ADIG9_min "FCtl_SPN(348)" VALUE 0x001E22D4 /* @ECU_Address@FCtl_SPN@0x21B60570@ */ ECIPP_ALIGNMENT_ULONG 4294967295 Compu_IDENTITY 0 4294967295 PHYS_UNIT "SPN" /end CHARACTERISTIC
/begin CHARACTERISTIC FCspn_ADloss "FCtl_SPN(103)" VALUE 0x001E1F00 /* @ECU_Address@FCtl_SPN@0x21B6019C@ */ ECIPP_ALIGNMENT_ULONG 4294967295 Compu_IDENTITY 0 4294967295 PHYS_UNIT "SPN" /end CHARACTERISTIC
/begin CHARACTERISTIC FCspn_AFILT_dP_high "FCtl_SPN(732)" VALUE 0x001E28D4 /* @ECU_Address@FCtl_SPN@0x21B60B70@ */ ECIPP_ALIGNMENT_ULONG 4294967295 Compu_IDENTITY 0 4294967295 PHYS_UNIT "SPN" /end CHARACTERISTIC
/begin CHARACTERISTIC FCspn_AL_hi "FCtl_SPN(30)" VALUE 0x001E1DDC /* @ECU_Address@FCtl_SPN@0x21B60078@ */ ECIPP_ALIGNMENT_ULONG 4294967295 Compu_IDENTITY 0 4294967295 PHYS_UNIT "SPN" /end CHARACTERISTIC
/begin CHARACTERISTIC FCspn_AL_lo "FCtl_SPN(31)" VALUE 0x001E1DE0 /* @ECU_Address@FCtl_SPN@0x21B6007C@ */ ECIPP_ALIGNMENT_ULONG 4294967295 Compu_IDENTITY 0 4294967295 PHYS_UNIT "SPN" /end CHARACTERISTIC
/begin CHARACTERISTIC FCspn_ALLP_hi "FCtl_SPN(42)" VALUE 0x001E1E0C /* @ECU_Address@FCtl_SPN@0x21B600A8@ */ ECIPP_ALIGNMENT_ULONG 4294967295 Compu_IDENTITY 0 4294967295 PHYS_UNIT "SPN" /end CHARACTERISTIC
/begin CHARACTERISTIC FCspn_ALLP_lo "FCtl_SPN(43)" VALUE 0x001E1E10 /* @ECU_Address@FCtl_SPN@0x21B600AC@ */ ECIPP_ALIGNMENT_ULONG 4294967295 Compu_IDENTITY 0 4294967295 PHYS_UNIT "SPN" /end CHARACTERISTIC
/begin CHARACTERISTIC FCspn_ALNG_hi "FCtl_SPN(44)" VALUE 0x001E1E14 /* @ECU_Address@FCtl_SPN@0x21B600B0@ */ ECIPP_ALIGNMENT_ULONG 4294967295 Compu_IDENTITY 0 4294967295 PHYS_UNIT "SPN" /end CHARACTERISTIC
/begin CHARACTERISTIC FCspn_ALNG_lo "FCtl_SPN(45)" VALUE 0x001E1E18 /* @ECU_Address@FCtl_SPN@0x21B600B4@ */ ECIPP_ALIGNMENT_ULONG 4294967295 Compu_IDENTITY 0 4294967295 PHYS_UNIT "SPN" /end CHARACTERISTIC
/begin CHARACTERISTIC FCspn_APD1_max "FCtl_SPN(116)" VALUE 0x001E1F34 /* @ECU_Address@FCtl_SPN@0x21B601D0@ */ ECIPP_ALIGNMENT_ULONG 4294967295 Compu_IDENTITY 0 4294967295 PHYS_UNIT "SPN" /end CHARACTERISTIC
/begin CHARACTERISTIC FCspn_APD1_min "FCtl_SPN(117)" VALUE 0x001E1F38 /* @ECU_Address@FCtl_SPN@0x21B601D4@ */ ECIPP_ALIGNMENT_ULONG 4294967295 Compu_IDENTITY 0 4294967295 PHYS_UNIT "SPN" /end CHARACTERISTIC
/begin CHARACTERISTIC FCspn_APD2_max "FCtl_SPN(229)" VALUE 0x001E20F8 /* @ECU_Address@FCtl_SPN@0x21B60394@ */ ECIPP_ALIGNMENT_ULONG 4294967295 Compu_IDENTITY 0 4294967295 PHYS_UNIT "SPN" /end CHARACTERISTIC
/begin CHARACTERISTIC FCspn_APD2_min "FCtl_SPN(230)" VALUE 0x001E20FC /* @ECU_Address@FCtl_SPN@0x21B60398@ */ ECIPP_ALIGNMENT_ULONG 4294967295 Compu_IDENTITY 0 4294967295 PHYS_UNIT "SPN" /end CHARACTERISTIC
/begin CHARACTERISTIC FCspn_APD3_max "FCtl_SPN(231)" VALUE 0x001E2100 /* @ECU_Address@FCtl_SPN@0x21B6039C@ */ ECIPP_ALIGNMENT_ULONG 4294967295 Compu_IDENTITY 0 4294967295 PHYS_UNIT "SPN" /end CHARACTERISTIC
/begin CHARACTERISTIC FCspn_APD3_min "FCtl_SPN(232)" VALUE 0x001E2104 /* @ECU_Address@FCtl_SPN@0x21B603A0@ */ ECIPP_ALIGNMENT_ULONG 4294967295 Compu_IDENTITY 0 4294967295 PHYS_UNIT "SPN" /end CHARACTERISTIC
/begin CHARACTERISTIC FCspn_APS1_max "FCtl_SPN(465)" VALUE 0x001E24A8 /* @ECU_Address@FCtl_SPN@0x21B60744@ */ ECIPP_ALIGNMENT_ULONG 4294967295 Compu_IDENTITY 0 4294967295 PHYS_UNIT "SPN" /end CHARACTERISTIC
/begin CHARACTERISTIC FCspn_APS1_min "FCtl_SPN(466)" VALUE 0x001E24AC /* @ECU_Address@FCtl_SPN@0x21B60748@ */ ECIPP_ALIGNMENT_ULONG 4294967295 Compu_IDENTITY 0 4294967295 PHYS_UNIT "SPN" /end CHARACTERISTIC
/begin CHARACTERISTIC FCspn_APS12_OOR "FCtl_SPN(473)" VALUE 0x001E24C8 /* @ECU_Address@FCtl_SPN@0x21B60764@ */ ECIPP_ALIGNMENT_ULONG 4294967295 Compu_IDENTITY 0 4294967295 PHYS_UNIT "SPN" /end CHARACTERISTIC
/begin CHARACTERISTIC FCspn_APS12pct_hi "FCtl_SPN(469)" VALUE 0x001E24B8 /* @ECU_Address@FCtl_SPN@0x21B60754@ */ ECIPP_ALIGNMENT_ULONG 4294967295 Compu_IDENTITY 0 4294967295 PHYS_UNIT "SPN" /end CHARACTERISTIC
/begin CHARACTERISTIC FCspn_APS12pct_lo "FCtl_SPN(470)" VALUE 0x001E24BC /* @ECU_Address@FCtl_SPN@0x21B60758@ */ ECIPP_ALIGNMENT_ULONG 4294967295 Compu_IDENTITY 0 4294967295 PHYS_UNIT "SPN" /end CHARACTERISTIC
/begin CHARACTERISTIC FCspn_APS2_max "FCtl_SPN(467)" VALUE 0x001E24B0 /* @ECU_Address@FCtl_SPN@0x21B6074C@ */ ECIPP_ALIGNMENT_ULONG 4294967295 Compu_IDENTITY 0 4294967295 PHYS_UNIT "SPN" /end CHARACTERISTIC
/begin CHARACTERISTIC FCspn_APS2_min "FCtl_SPN(468)" VALUE 0x001E24B4 /* @ECU_Address@FCtl_SPN@0x21B60750@ */ ECIPP_ALIGNMENT_ULONG 4294967295 Compu_IDENTITY 0 4294967295 PHYS_UNIT "SPN" /end CHARACTERISTIC
/begin CHARACTERISTIC FCspn_APSerr_neg "FCtl_SPN(472)" VALUE 0x001E24C4 /* @ECU_Address@FCtl_SPN@0x21B60760@ */ ECIPP_ALIGNMENT_ULONG 4294967295 Compu_IDENTITY 0 4294967295 PHYS_UNIT "SPN" /end CHARACTERISTIC
/begin CHARACTERISTIC FCspn_APSerr_pos "FCtl_SPN(471)" VALUE 0x001E24C0 /* @ECU_Address@FCtl_SPN@0x21B6075C@ */ ECIPP_ALIGNMENT_ULONG 4294967295 Compu_IDENTITY 0 4294967295 PHYS_UNIT "SPN" /end CHARACTERISTIC
/begin CHARACTERISTIC FCspn_APU1_max "FCtl_SPN(118)" VALUE 0x001E1F3C /* @ECU_Address@FCtl_SPN@0x21B601D8@ */ ECIPP_ALIGNMENT_ULONG 4294967295 Compu_IDENTITY 0 4294967295 PHYS_UNIT "SPN" /end CHARACTERISTIC
/begin CHARACTERISTIC FCspn_APU1_min "FCtl_SPN(119)" VALUE 0x001E1F40 /* @ECU_Address@FCtl_SPN@0x21B601DC@ */ ECIPP_ALIGNMENT_ULONG 4294967295 Compu_IDENTITY 0 4294967295 PHYS_UNIT "SPN" /end CHARACTERISTIC
/begin CHARACTERISTIC FCspn_APU2_max "FCtl_SPN(120)" VALUE 0x001E1F44 /* @ECU_Address@FCtl_SPN@0x21B601E0@ */ ECIPP_ALIGNMENT_ULONG 4294967295 Compu_IDENTITY 0 4294967295 PHYS_UNIT "SPN" /end CHARACTERISTIC
/begin CHARACTERISTIC FCspn_APU2_min "FCtl_SPN(121)" VALUE 0x001E1F48 /* @ECU_Address@FCtl_SPN@0x21B601E4@ */ ECIPP_ALIGNMENT_ULONG 4294967295 Compu_IDENTITY 0 4294967295 PHYS_UNIT "SPN" /end CHARACTERISTIC
/begin CHARACTERISTIC FCspn_APU3_max "FCtl_SPN(201)" VALUE 0x001E2088 /* @ECU_Address@FCtl_SPN@0x21B60324@ */ ECIPP_ALIGNMENT_ULONG 4294967295 Compu_IDENTITY 0 4294967295 PHYS_UNIT "SPN" /end CHARACTERISTIC
/begin CHARACTERISTIC FCspn_APU3_min "FCtl_SPN(202)" VALUE 0x001E208C /* @ECU_Address@FCtl_SPN@0x21B60328@ */ ECIPP_ALIGNMENT_ULONG 4294967295 Compu_IDENTITY 0 4294967295 PHYS_UNIT "SPN" /end CHARACTERISTIC
/begin CHARACTERISTIC FCspn_APUD1_max "FCtl_SPN(203)" VALUE 0x001E2090 /* @ECU_Address@FCtl_SPN@0x21B6032C@ */ ECIPP_ALIGNMENT_ULONG 4294967295 Compu_IDENTITY 0 4294967295 PHYS_UNIT "SPN" /end CHARACTERISTIC
/begin CHARACTERISTIC FCspn_APUD1_min "FCtl_SPN(204)" VALUE 0x001E2094 /* @ECU_Address@FCtl_SPN@0x21B60330@ */ ECIPP_ALIGNMENT_ULONG 4294967295 Compu_IDENTITY 0 4294967295 PHYS_UNIT "SPN" /end CHARACTERISTIC
/begin CHARACTERISTIC FCspn_APUD10_max "FCtl_SPN(361)" VALUE 0x001E2308 /* @ECU_Address@FCtl_SPN@0x21B605A4@ */ ECIPP_ALIGNMENT_ULONG 4294967295 Compu_IDENTITY 0 4294967295 PHYS_UNIT "SPN" /end CHARACTERISTIC
/begin CHARACTERISTIC FCspn_APUD10_min "FCtl_SPN(362)" VALUE 0x001E230C /* @ECU_Address@FCtl_SPN@0x21B605A8@ */ ECIPP_ALIGNMENT_ULONG 4294967295 Compu_IDENTITY 0 4294967295 PHYS_UNIT "SPN" /end CHARACTERISTIC
/begin CHARACTERISTIC FCspn_APUD11_max "FCtl_SPN(363)" VALUE 0x001E2310 /* @ECU_Address@FCtl_SPN@0x21B605AC@ */ ECIPP_ALIGNMENT_ULONG 4294967295 Compu_IDENTITY 0 4294967295 PHYS_UNIT "SPN" /end CHARACTERISTIC
/begin CHARACTERISTIC FCspn_APUD11_min "FCtl_SPN(364)" VALUE 0x001E2314 /* @ECU_Address@FCtl_SPN@0x21B605B0@ */ ECIPP_ALIGNMENT_ULONG 4294967295 Compu_IDENTITY 0 4294967295 PHYS_UNIT "SPN" /end CHARACTERISTIC
/begin CHARACTERISTIC FCspn_APUD12_max "FCtl_SPN(365)" VALUE 0x001E2318 /* @ECU_Address@FCtl_SPN@0x21B605B4@ */ ECIPP_ALIGNMENT_ULONG 4294967295 Compu_IDENTITY 0 4294967295 PHYS_UNIT "SPN" /end CHARACTERISTIC
/begin CHARACTERISTIC FCspn_APUD12_min "FCtl_SPN(366)" VALUE 0x001E231C /* @ECU_Address@FCtl_SPN@0x21B605B8@ */ ECIPP_ALIGNMENT_ULONG 4294967295 Compu_IDENTITY 0 4294967295 PHYS_UNIT "SPN" /end CHARACTERISTIC
/begin CHARACTERISTIC FCspn_APUD13_max "FCtl_SPN(367)" VALUE 0x001E2320 /* @ECU_Address@FCtl_SPN@0x21B605BC@ */ ECIPP_ALIGNMENT_ULONG 4294967295 Compu_IDENTITY 0 4294967295 PHYS_UNIT "SPN" /end CHARACTERISTIC
/begin CHARACTERISTIC FCspn_APUD13_min "FCtl_SPN(368)" VALUE 0x001E2324 /* @ECU_Address@FCtl_SPN@0x21B605C0@ */ ECIPP_ALIGNMENT_ULONG 4294967295 Compu_IDENTITY 0 4294967295 PHYS_UNIT "SPN" /end CHARACTERISTIC
/begin CHARACTERISTIC FCspn_APUD14_max "FCtl_SPN(369)" VALUE 0x001E2328 /* @ECU_Address@FCtl_SPN@0x21B605C4@ */ ECIPP_ALIGNMENT_ULONG 4294967295 Compu_IDENTITY 0 4294967295 PHYS_UNIT "SPN" /end CHARACTERISTIC
/begin CHARACTERISTIC FCspn_APUD14_min "FCtl_SPN(370)" VALUE 0x001E232C /* @ECU_Address@FCtl_SPN@0x21B605C8@ */ ECIPP_ALIGNMENT_ULONG 4294967295 Compu_IDENTITY 0 4294967295 PHYS_UNIT "SPN" /end CHARACTERISTIC
/begin CHARACTERISTIC FCspn_APUD15_max "FCtl_SPN(371)" VALUE 0x001E2330 /* @ECU_Address@FCtl_SPN@0x21B605CC@ */ ECIPP_ALIGNMENT_ULONG 4294967295 Compu_IDENTITY 0 4294967295 PHYS_UNIT "SPN" /end CHARACTERISTIC
/begin CHARACTERISTIC FCspn_APUD15_min "FCtl_SPN(372)" VALUE 0x001E2334 /* @ECU_Address@FCtl_SPN@0x21B605D0@ */ ECIPP_ALIGNMENT_ULONG 4294967295 Compu_IDENTITY 0 4294967295 PHYS_UNIT "SPN" /end CHARACTERISTIC
/begin CHARACTERISTIC FCspn_APUD16_max "FCtl_SPN(373)" VALUE 0x001E2338 /* @ECU_Address@FCtl_SPN@0x21B605D4@ */ ECIPP_ALIGNMENT_ULONG 4294967295 Compu_IDENTITY 0 4294967295 PHYS_UNIT "SPN" /end CHARACTERISTIC
/begin CHARACTERISTIC FCspn_APUD16_min "FCtl_SPN(374)" VALUE 0x001E233C /* @ECU_Address@FCtl_SPN@0x21B605D8@ */ ECIPP_ALIGNMENT_ULONG 4294967295 Compu_IDENTITY 0 4294967295 PHYS_UNIT "SPN" /end CHARACTERISTIC
/begin CHARACTERISTIC FCspn_APUD17_max "FCtl_SPN(375)" VALUE 0x001E2340 /* @ECU_Address@FCtl_SPN@0x21B605DC@ */ ECIPP_ALIGNMENT_ULONG 4294967295 Compu_IDENTITY 0 4294967295 PHYS_UNIT "SPN" /end CHARACTERISTIC
/begin CHARACTERISTIC FCspn_APUD17_min "FCtl_SPN(376)" VALUE 0x001E2344 /* @ECU_Address@FCtl_SPN@0x21B605E0@ */ ECIPP_ALIGNMENT_ULONG 4294967295 Compu_IDENTITY 0 4294967295 PHYS_UNIT "SPN" /end CHARACTERISTIC
/begin CHARACTERISTIC FCspn_APUD18_max "FCtl_SPN(377)" VALUE 0x001E2348 /* @ECU_Address@FCtl_SPN@0x21B605E4@ */ ECIPP_ALIGNMENT_ULONG 4294967295 Compu_IDENTITY 0 4294967295 PHYS_UNIT "SPN" /end CHARACTERISTIC
/begin CHARACTERISTIC FCspn_APUD18_min "FCtl_SPN(378)" VALUE 0x001E234C /* @ECU_Address@FCtl_SPN@0x21B605E8@ */ ECIPP_ALIGNMENT_ULONG 4294967295 Compu_IDENTITY 0 4294967295 PHYS_UNIT "SPN" /end CHARACTERISTIC
/begin CHARACTERISTIC FCspn_APUD19_max "FCtl_SPN(379)" VALUE 0x001E2350 /* @ECU_Address@FCtl_SPN@0x21B605EC@ */ ECIPP_ALIGNMENT_ULONG 4294967295 Compu_IDENTITY 0 4294967295 PHYS_UNIT "SPN" /end CHARACTERISTIC
/begin CHARACTERISTIC FCspn_APUD19_min "FCtl_SPN(380)" VALUE 0x001E2354 /* @ECU_Address@FCtl_SPN@0x21B605F0@ */ ECIPP_ALIGNMENT_ULONG 4294967295 Compu_IDENTITY 0 4294967295 PHYS_UNIT "SPN" /end CHARACTERISTIC
/begin CHARACTERISTIC FPfl_ADIG22_min "FPrm_latch(443)" VALUE 0x001E0704 /* @ECU_Address@FPrm_latch@0x021BB6EC@ */ ECIPP_ALIGNMENT_FLOAT32_IEEE 10000000000 Compu_IDENTITY -10000000000 10000000000 PHYS_UNIT "ms" /end CHARACTERISTIC
/begin CHARACTERISTIC FPfl_ADIG23_max "FPrm_latch(444)" VALUE 0x001E0708 /* @ECU_Address@FPrm_latch@0x021BB6F0@ */ ECIPP_ALIGNMENT_FLOAT32_IEEE 10000000000 Compu_IDENTITY -10000000000 10000000000 PHYS_UNIT "ms" /end CHARACTERISTIC
/begin CHARACTERISTIC FPfl_ADIG23_min "FPrm_latch(445)" VALUE 0x001E070C /* @ECU_Address@FPrm_latch@0x021BB6F4@ */ ECIPP_ALIGNMENT_FLOAT32_IEEE 10000000000 Compu_IDENTITY -10000000000 10000000000 PHYS_UNIT "ms" /end CHARACTERISTIC
/begin CHARACTERISTIC FPfl_ADIG24_max "FPrm_latch(446)" VALUE 0x001E0710 /* @ECU_Address@FPrm_latch@0x021BB6F8@ */ ECIPP_ALIGNMENT_FLOAT32_IEEE 10000000000 Compu_IDENTITY -10000000000 10000000000 PHYS_UNIT "ms" /end CHARACTERISTIC
/begin CHARACTERISTIC FPfl_ADIG24_min "FPrm_latch(447)" VALUE 0x001E0714 /* @ECU_Address@FPrm_latch@0x021BB6FC@ */ ECIPP_ALIGNMENT_FLOAT32_IEEE 10000000000 Compu_IDENTITY -10000000000 10000000000 PHYS_UNIT "ms" /end CHARACTERISTIC
/begin CHARACTERISTIC FPfl_ADIG25_max "FPrm_latch(448)" VALUE 0x001E0718 /* @ECU_Address@FPrm_latch@0x021BB700@ */ ECIPP_ALIGNMENT_FLOAT32_IEEE 10000000000 Compu_IDENTITY -10000000000 10000000000 PHYS_UNIT "ms" /end CHARACTERISTIC
/begin CHARACTERISTIC FPfl_ADIG25_min "FPrm_latch(449)" VALUE 0x001E071C /* @ECU_Address@FPrm_latch@0x021BB704@ */ ECIPP_ALIGNMENT_FLOAT32_IEEE 10000000000 Compu_IDENTITY -10000000000 10000000000 PHYS_UNIT "ms" /end CHARACTERISTIC
/begin CHARACTERISTIC FPfl_ADIG3_max "FPrm_latch(169)" VALUE 0x001E02BC /* @ECU_Address@FPrm_latch@0x021BB2A4@ */ ECIPP_ALIGNMENT_FLOAT32_IEEE 10000000000 Compu_IDENTITY -10000000000 10000000000 PHYS_UNIT "ms" /end CHARACTERISTIC
/begin CHARACTERISTIC FPfl_ADIG3_min "FPrm_latch(170)" VALUE 0x001E02C0 /* @ECU_Address@FPrm_latch@0x021BB2A8@ */ ECIPP_ALIGNMENT_FLOAT32_IEEE 10000000000 Compu_IDENTITY -10000000000 10000000000 PHYS_UNIT "ms" /end CHARACTERISTIC
/begin CHARACTERISTIC FPfl_ADIG4_max "FPrm_latch(246)" VALUE 0x001E03F0 /* @ECU_Address@FPrm_latch@0x021BB3D8@ */ ECIPP_ALIGNMENT_FLOAT32_IEEE 10000000000 Compu_IDENTITY -10000000000 10000000000 PHYS_UNIT "ms" /end CHARACTERISTIC
/begin CHARACTERISTIC FPfl_ADIG4_min "FPrm_latch(247)" VALUE 0x001E03F4 /* @ECU_Address@FPrm_latch@0x021BB3DC@ */ ECIPP_ALIGNMENT_FLOAT32_IEEE 10000000000 Compu_IDENTITY -10000000000 10000000000 PHYS_UNIT "ms" /end CHARACTERISTIC
/begin CHARACTERISTIC FPfl_ADIG5_max "FPrm_latch(248)" VALUE 0x001E03F8 /* @ECU_Address@FPrm_latch@0x021BB3E0@ */ ECIPP_ALIGNMENT_FLOAT32_IEEE 10000000000 Compu_IDENTITY -10000000000 10000000000 PHYS_UNIT "ms" /end CHARACTERISTIC
/begin CHARACTERISTIC FPfl_ADIG5_min "FPrm_latch(249)" VALUE 0x001E03FC /* @ECU_Address@FPrm_latch@0x021BB3E4@ */ ECIPP_ALIGNMENT_FLOAT32_IEEE 10000000000 Compu_IDENTITY -10000000000 10000000000 PHYS_UNIT "ms" /end CHARACTERISTIC
/begin CHARACTERISTIC FPfl_ADIG6_max "FPrm_latch(250)" VALUE 0x001E0400 /* @ECU_Address@FPrm_latch@0x021BB3E8@ */ ECIPP_ALIGNMENT_FLOAT32_IEEE 10000000000 Compu_IDENTITY -10000000000 10000000000 PHYS_UNIT "ms" /end CHARACTERISTIC
/begin CHARACTERISTIC FPfl_ADIG6_min "FPrm_latch(251)" VALUE 0x001E0404 /* @ECU_Address@FPrm_latch@0x021BB3EC@ */ ECIPP_ALIGNMENT_FLOAT32_IEEE 10000000000 Compu_IDENTITY -10000000000 10000000000 PHYS_UNIT "ms" /end CHARACTERISTIC
/begin CHARACTERISTIC FPfl_ADIG7_max "FPrm_latch(252)" VALUE 0x001E0408 /* @ECU_Address@FPrm_latch@0x021BB3F0@ */ ECIPP_ALIGNMENT_FLOAT32_IEEE 10000000000 Compu_IDENTITY -10000000000 10000000000 PHYS_UNIT "ms" /end CHARACTERISTIC
/begin CHARACTERISTIC FPfl_ADIG7_min "FPrm_latch(253)" VALUE 0x001E040C /* @ECU_Address@FPrm_latch@0x021BB3F4@ */ ECIPP_ALIGNMENT_FLOAT32_IEEE 10000000000 Compu_IDENTITY -10000000000 10000000000 PHYS_UNIT "ms" /end CHARACTERISTIC
/begin CHARACTERISTIC FPfl_ADIG8_max "FPrm_latch(254)" VALUE 0x001E0410 /* @ECU_Address@FPrm_latch@0x021BB3F8@ */ ECIPP_ALIGNMENT_FLOAT32_IEEE 10000000000 Compu_IDENTITY -10000000000 10000000000 PHYS_UNIT "ms" /end CHARACTERISTIC
/begin CHARACTERISTIC FPfl_ADIG8_min "FPrm_latch(255)" VALUE 0x001E0414 /* @ECU_Address@FPrm_latch@0x021BB3FC@ */ ECIPP_ALIGNMENT_FLOAT32_IEEE 10000000000 Compu_IDENTITY -10000000000 10000000000 PHYS_UNIT "ms" /end CHARACTERISTIC
/begin CHARACTERISTIC FPfl_ADIG9_max "FPrm_latch(256)" VALUE 0x001E0418 /* @ECU_Address@FPrm_latch@0x021BB400@ */ ECIPP_ALIGNMENT_FLOAT32_IEEE 10000000000 Compu_IDENTITY -10000000000 10000000000 PHYS_UNIT "ms" /end CHARACTERISTIC
/begin CHARACTERISTIC FPfl_ADIG9_min "FPrm_latch(257)" VALUE 0x001E041C /* @ECU_Address@FPrm_latch@0x021BB404@ */ ECIPP_ALIGNMENT_FLOAT32_IEEE 10000000000 Compu_IDENTITY -10000000000 10000000000 PHYS_UNIT "ms" /end CHARACTERISTIC
/begin CHARACTERISTIC FPfl_ADloss "FPrm_latch(67)" VALUE 0x001E0124 /* @ECU_Address@FPrm_latch@0x021BB10C@ */ ECIPP_ALIGNMENT_FLOAT32_IEEE 10000000000 Compu_IDENTITY -10000000000 10000000000 PHYS_UNIT "ms" /end CHARACTERISTIC
/begin CHARACTERISTIC FPfl_AFILT_dP_high "FPrm_latch(562)" VALUE 0x001E08E0 /* @ECU_Address@FPrm_latch@0x021BB8C8@ */ ECIPP_ALIGNMENT_FLOAT32_IEEE 10000000000 Compu_IDENTITY -10000000000 10000000000 PHYS_UNIT "ms" /end CHARACTERISTIC
/begin CHARACTERISTIC FPfl_AL_hi "FPrm_latch(41)" VALUE 0x001E00BC /* @ECU_Address@FPrm_latch@0x021BB0A4@ */ ECIPP_ALIGNMENT_FLOAT32_IEEE 10000000000 Compu_IDENTITY -10000000000 10000000000 PHYS_UNIT "updates" /end CHARACTERISTIC
/begin CHARACTERISTIC FPfl_AL_lo "FPrm_latch(42)" VALUE 0x001E00C0 /* @ECU_Address@FPrm_latch@0x021BB0A8@ */ ECIPP_ALIGNMENT_FLOAT32_IEEE 10000000000 Compu_IDENTITY -10000000000 10000000000 PHYS_UNIT "updates" /end CHARACTERISTIC
/begin CHARACTERISTIC FPfl_ALLP_hi "FPrm_latch(43)" VALUE 0x001E00C4 /* @ECU_Address@FPrm_latch@0x021BB0AC@ */ ECIPP_ALIGNMENT_FLOAT32_IEEE 10000000000 Compu_IDENTITY -10000000000 10000000000 PHYS_UNIT "updates" /end CHARACTERISTIC
/begin CHARACTERISTIC FPfl_ALLP_lo "FPrm_latch(44)" VALUE 0x001E00C8 /* @ECU_Address@FPrm_latch@0x021BB0B0@ */ ECIPP_ALIGNMENT_FLOAT32_IEEE 10000000000 Compu_IDENTITY -10000000000 10000000000 PHYS_UNIT "updates" /end CHARACTERISTIC
/begin CHARACTERISTIC FPfl_ALNG_hi "FPrm_latch(45)" VALUE 0x001E00CC /* @ECU_Address@FPrm_latch@0x021BB0B4@ */ ECIPP_ALIGNMENT_FLOAT32_IEEE 10000000000 Compu_IDENTITY -10000000000 10000000000 PHYS_UNIT "updates" /end CHARACTERISTIC
/begin CHARACTERISTIC FPfl_ALNG_lo "FPrm_latch(46)" VALUE 0x001E00D0 /* @ECU_Address@FPrm_latch@0x021BB0B8@ */ ECIPP_ALIGNMENT_FLOAT32_IEEE 10000000000 Compu_IDENTITY -10000000000 10000000000 PHYS_UNIT "updates" /end CHARACTERISTIC
/begin CHARACTERISTIC FPfl_APD1_max "FPrm_latch(75)" VALUE 0x001E0144 /* @ECU_Address@FPrm_latch@0x021BB12C@ */ ECIPP_ALIGNMENT_FLOAT32_IEEE 10000000000 Compu_IDENTITY -10000000000 10000000000 PHYS_UNIT "ms" /end CHARACTERISTIC
/begin CHARACTERISTIC FPfl_APD1_min "FPrm_latch(76)" VALUE 0x001E0148 /* @ECU_Address@FPrm_latch@0x021BB130@ */ ECIPP_ALIGNMENT_FLOAT32_IEEE 10000000000 Compu_IDENTITY -10000000000 10000000000 PHYS_UNIT "ms" /end CHARACTERISTIC
/begin CHARACTERISTIC FPfl_APD2_max "FPrm_latch(181)" VALUE 0x001E02EC /* @ECU_Address@FPrm_latch@0x021BB2D4@ */ ECIPP_ALIGNMENT_FLOAT32_IEEE 10000000000 Compu_IDENTITY -10000000000 10000000000 PHYS_UNIT "ms" /end CHARACTERISTIC
/begin CHARACTERISTIC FPfl_APD2_min "FPrm_latch(182)" VALUE 0x001E02F0 /* @ECU_Address@FPrm_latch@0x021BB2D8@ */ ECIPP_ALIGNMENT_FLOAT32_IEEE 10000000000 Compu_IDENTITY -10000000000 10000000000 PHYS_UNIT "ms" /end CHARACTERISTIC
/begin CHARACTERISTIC FPfl_APD3_max "FPrm_latch(183)" VALUE 0x001E02F4 /* @ECU_Address@FPrm_latch@0x021BB2DC@ */ ECIPP_ALIGNMENT_FLOAT32_IEEE 10000000000 Compu_IDENTITY -10000000000 10000000000 PHYS_UNIT "ms" /end CHARACTERISTIC
/begin CHARACTERISTIC FPfl_APD3_min "FPrm_latch(184)" VALUE 0x001E02F8 /* @ECU_Address@FPrm_latch@0x021BB2E0@ */ ECIPP_ALIGNMENT_FLOAT32_IEEE 10000000000 Compu_IDENTITY -10000000000 10000000000 PHYS_UNIT "ms" /end CHARACTERISTIC
/begin CHARACTERISTIC FPfl_APS1_max "FPrm_latch(362)" VALUE 0x001E05C0 /* @ECU_Address@FPrm_latch@0x021BB5A8@ */ ECIPP_ALIGNMENT_FLOAT32_IEEE 10000000000 Compu_IDENTITY -10000000000 10000000000 PHYS_UNIT "ms" /end CHARACTERISTIC
/begin CHARACTERISTIC FPfl_APS1_min "FPrm_latch(363)" VALUE 0x001E05C4 /* @ECU_Address@FPrm_latch@0x021BB5AC@ */ ECIPP_ALIGNMENT_FLOAT32_IEEE 10000000000 Compu_IDENTITY -10000000000 10000000000 PHYS_UNIT "ms" /end CHARACTERISTIC
/begin CHARACTERISTIC FPfl_APS12_OOR "FPrm_latch(370)" VALUE 0x001E05E0 /* @ECU_Address@FPrm_latch@0x021BB5C8@ */ ECIPP_ALIGNMENT_FLOAT32_IEEE 10000000000 Compu_IDENTITY -10000000000 10000000000 PHYS_UNIT "ms" /end CHARACTERISTIC
/begin CHARACTERISTIC FPfl_APS12pct_hi "FPrm_latch(366)" VALUE 0x001E05D0 /* @ECU_Address@FPrm_latch@0x021BB5B8@ */ ECIPP_ALIGNMENT_FLOAT32_IEEE 10000000000 Compu_IDENTITY -10000000000 10000000000 PHYS_UNIT "ms" /end CHARACTERISTIC
/begin CHARACTERISTIC FPfl_APS12pct_lo "FPrm_latch(367)" VALUE 0x001E05D4 /* @ECU_Address@FPrm_latch@0x021BB5BC@ */ ECIPP_ALIGNMENT_FLOAT32_IEEE 10000000000 Compu_IDENTITY -10000000000 10000000000 PHYS_UNIT "ms" /end CHARACTERISTIC
/begin CHARACTERISTIC FPfl_APS2_max "FPrm_latch(364)" VALUE 0x001E05C8 /* @ECU_Address@FPrm_latch@0x021BB5B0@ */ ECIPP_ALIGNMENT_FLOAT32_IEEE 10000000000 Compu_IDENTITY -10000000000 10000000000 PHYS_UNIT "ms" /end CHARACTERISTIC
/begin CHARACTERISTIC FPfl_APS2_min "FPrm_latch(365)" VALUE 0x001E05CC /* @ECU_Address@FPrm_latch@0x021BB5B4@ */ ECIPP_ALIGNMENT_FLOAT32_IEEE 10000000000 Compu_IDENTITY -10000000000 10000000000 PHYS_UNIT "ms" /end CHARACTERISTIC
/begin CHARACTERISTIC FPfl_APSerr_neg "FPrm_latch(369)" VALUE 0x001E05DC /* @ECU_Address@FPrm_latch@0x021BB5C4@ */ ECIPP_ALIGNMENT_FLOAT32_IEEE 10000000000 Compu_IDENTITY -10000000000 10000000000 PHYS_UNIT "ms" /end CHARACTERISTIC
/begin CHARACTERISTIC FPfl_APSerr_pos "FPrm_latch(368)" VALUE 0x001E05D8 /* @ECU_Address@FPrm_latch@0x021BB5C0@ */ ECIPP_ALIGNMENT_FLOAT32_IEEE 10000000000 Compu_IDENTITY -10000000000 10000000000 PHYS_UNIT "ms" /end CHARACTERISTIC
/begin CHARACTERISTIC FPfl_APU1_max "FPrm_latch(77)" VALUE 0x001E014C /* @ECU_Address@FPrm_latch@0x021BB134@ */ ECIPP_ALIGNMENT_FLOAT32_IEEE 10000000000 Compu_IDENTITY -10000000000 10000000000 PHYS_UNIT "ms" /end CHARACTERISTIC
/begin CHARACTERISTIC FPfl_APU1_min "FPrm_latch(78)" VALUE 0x001E0150 /* @ECU_Address@FPrm_latch@0x021BB138@ */ ECIPP_ALIGNMENT_FLOAT32_IEEE 10000000000 Compu_IDENTITY -10000000000 10000000000 PHYS_UNIT "ms" /end CHARACTERISTIC
/begin CHARACTERISTIC FPfl_APU2_max "FPrm_latch(79)" VALUE 0x001E0154 /* @ECU_Address@FPrm_latch@0x021BB13C@ */ ECIPP_ALIGNMENT_FLOAT32_IEEE 10000000000 Compu_IDENTITY -10000000000 10000000000 PHYS_UNIT "ms" /end CHARACTERISTIC
/begin CHARACTERISTIC FPfl_APU2_min "FPrm_latch(80)" VALUE 0x001E0158 /* @ECU_Address@FPrm_latch@0x021BB140@ */ ECIPP_ALIGNMENT_FLOAT32_IEEE 10000000000 Compu_IDENTITY -10000000000 10000000000 PHYS_UNIT "ms" /end CHARACTERISTIC
/begin CHARACTERISTIC FPfl_APU3_max "FPrm_latch(157)" VALUE 0x001E028C /* @ECU_Address@FPrm_latch@0x021BB274@ */ ECIPP_ALIGNMENT_FLOAT32_IEEE 10000000000 Compu_IDENTITY -10000000000 10000000000 PHYS_UNIT "ms" /end CHARACTERISTIC
/begin CHARACTERISTIC FPfl_APU3_min "FPrm_latch(158)" VALUE 0x001E0290 /* @ECU_Address@FPrm_latch@0x021BB278@ */ ECIPP_ALIGNMENT_FLOAT32_IEEE 10000000000 Compu_IDENTITY -10000000000 10000000000 PHYS_UNIT "ms" /end CHARACTERISTIC
/begin CHARACTERISTIC FPfl_APUD1_max "FPrm_latch(159)" VALUE 0x001E0294 /* @ECU_Address@FPrm_latch@0x021BB27C@ */ ECIPP_ALIGNMENT_FLOAT32_IEEE 10000000000 Compu_IDENTITY -10000000000 10000000000 PHYS_UNIT "ms" /end CHARACTERISTIC
/begin CHARACTERISTIC FPfl_APUD1_min "FPrm_latch(160)" VALUE 0x001E0298 /* @ECU_Address@FPrm_latch@0x021BB280@ */ ECIPP_ALIGNMENT_FLOAT32_IEEE 10000000000 Compu_IDENTITY -10000000000 10000000000 PHYS_UNIT "ms" /end CHARACTERISTIC
/begin CHARACTERISTIC FPfl_APUD10_max "FPrm_latch(270)" VALUE 0x001E0450 /* @ECU_Address@FPrm_latch@0x021BB438@ */ ECIPP_ALIGNMENT_FLOAT32_IEEE 10000000000 Compu_IDENTITY -10000000000 10000000000 PHYS_UNIT "ms" /end CHARACTERISTIC
/begin CHARACTERISTIC FPfl_APUD10_min "FPrm_latch(271)" VALUE 0x001E0454 /* @ECU_Address@FPrm_latch@0x021BB43C@ */ ECIPP_ALIGNMENT_FLOAT32_IEEE 10000000000 Compu_IDENTITY -10000000000 10000000000 PHYS_UNIT "ms" /end CHARACTERISTIC
/begin CHARACTERISTIC FPfl_APUD11_max "FPrm_latch(272)" VALUE 0x001E0458 /* @ECU_Address@FPrm_latch@0x021BB440@ */ ECIPP_ALIGNMENT_FLOAT32_IEEE 10000000000 Compu_IDENTITY -10000000000 10000000000 PHYS_UNIT "ms" /end CHARACTERISTIC
/begin CHARACTERISTIC FPfl_APUD11_min "FPrm_latch(273)" VALUE 0x001E045C /* @ECU_Address@FPrm_latch@0x021BB444@ */ ECIPP_ALIGNMENT_FLOAT32_IEEE 10000000000 Compu_IDENTITY -10000000000 10000000000 PHYS_UNIT "ms" /end CHARACTERISTIC
/begin CHARACTERISTIC FPfl_APUD12_max "FPrm_latch(274)" VALUE 0x001E0460 /* @ECU_Address@FPrm_latch@0x021BB448@ */ ECIPP_ALIGNMENT_FLOAT32_IEEE 10000000000 Compu_IDENTITY -10000000000 10000000000 PHYS_UNIT "ms" /end CHARACTERISTIC
/begin CHARACTERISTIC FPfl_APUD12_min "FPrm_latch(275)" VALUE 0x001E0464 /* @ECU_Address@FPrm_latch@0x021BB44C@ */ ECIPP_ALIGNMENT_FLOAT32_IEEE 10000000000 Compu_IDENTITY -10000000000 10000000000 PHYS_UNIT "ms" /end CHARACTERISTIC
/begin CHARACTERISTIC FPfl_APUD13_max "FPrm_latch(276)" VALUE 0x001E0468 /* @ECU_Address@FPrm_latch@0x021BB450@ */ ECIPP_ALIGNMENT_FLOAT32_IEEE 10000000000 Compu_IDENTITY -10000000000 10000000000 PHYS_UNIT "ms" /end CHARACTERISTIC
/begin CHARACTERISTIC FPfl_APUD13_min "FPrm_latch(277)" VALUE 0x001E046C /* @ECU_Address@FPrm_latch@0x021BB454@ */ ECIPP_ALIGNMENT_FLOAT32_IEEE 10000000000 Compu_IDENTITY -10000000000 10000000000 PHYS_UNIT "ms" /end CHARACTERISTIC
/begin CHARACTERISTIC FPfl_APUD14_max "FPrm_latch(278)" VALUE 0x001E0470 /* @ECU_Address@FPrm_latch@0x021BB458@ */ ECIPP_ALIGNMENT_FLOAT32_IEEE 10000000000 Compu_IDENTITY -10000000000 10000000000 PHYS_UNIT "ms" /end CHARACTERISTIC
/begin CHARACTERISTIC FPfl_APUD14_min "FPrm_latch(279)" VALUE 0x001E0474 /* @ECU_Address@FPrm_latch@0x021BB45C@ */ ECIPP_ALIGNMENT_FLOAT32_IEEE 10000000000 Compu_IDENTITY -10000000000 10000000000 PHYS_UNIT "ms" /end CHARACTERISTIC
/begin CHARACTERISTIC FPfl_APUD15_max "FPrm_latch(280)" VALUE 0x001E0478 /* @ECU_Address@FPrm_latch@0x021BB460@ */ ECIPP_ALIGNMENT_FLOAT32_IEEE 10000000000 Compu_IDENTITY -10000000000 10000000000 PHYS_UNIT "ms" /end CHARACTERISTIC
/begin CHARACTERISTIC FPfl_APUD15_min "FPrm_latch(281)" VALUE 0x001E047C /* @ECU_Address@FPrm_latch@0x021BB464@ */ ECIPP_ALIGNMENT_FLOAT32_IEEE 10000000000 Compu_IDENTITY -10000000000 10000000000 PHYS_UNIT "ms" /end CHARACTERISTIC
/begin CHARACTERISTIC FPfl_APUD16_max "FPrm_latch(282)" VALUE 0x001E0480 /* @ECU_Address@FPrm_latch@0x021BB468@ */ ECIPP_ALIGNMENT_FLOAT32_IEEE 10000000000 Compu_IDENTITY -10000000000 10000000000 PHYS_UNIT "ms" /end CHARACTERISTIC
/begin CHARACTERISTIC FPfl_APUD16_min "FPrm_latch(283)" VALUE 0x001E0484 /* @ECU_Address@FPrm_latch@0x021BB46C@ */ ECIPP_ALIGNMENT_FLOAT32_IEEE 10000000000 Compu_IDENTITY -10000000000 10000000000 PHYS_UNIT "ms" /end CHARACTERISTIC
/begin CHARACTERISTIC FPfl_APUD17_max "FPrm_latch(284)" VALUE 0x001E0488 /* @ECU_Address@FPrm_latch@0x021BB470@ */ ECIPP_ALIGNMENT_FLOAT32_IEEE 10000000000 Compu_IDENTITY -10000000000 10000000000 PHYS_UNIT "ms" /end CHARACTERISTIC
/begin CHARACTERISTIC FPfl_APUD17_min "FPrm_latch(285)" VALUE 0x001E048C /* @ECU_Address@FPrm_latch@0x021BB474@ */ ECIPP_ALIGNMENT_FLOAT32_IEEE 10000000000 Compu_IDENTITY -10000000000 10000000000 PHYS_UNIT "ms" /end CHARACTERISTIC
/begin CHARACTERISTIC FPfl_APUD18_max "FPrm_latch(286)" VALUE 0x001E0490 /* @ECU_Address@FPrm_latch@0x021BB478@ */ ECIPP_ALIGNMENT_FLOAT32_IEEE 10000000000 Compu_IDENTITY -10000000000 10000000000 PHYS_UNIT "ms" /end CHARACTERISTIC
/begin CHARACTERISTIC FPfl_APUD18_min "FPrm_latch(287)" VALUE 0x001E0494 /* @ECU_Address@FPrm_latch@0x021BB47C@ */ ECIPP_ALIGNMENT_FLOAT32_IEEE 10000000000 Compu_IDENTITY -10000000000 10000000000 PHYS_UNIT "ms" /end CHARACTERISTIC
/begin CHARACTERISTIC FPfl_APUD19_max "FPrm_latch(288)" VALUE 0x001E0498 /* @ECU_Address@FPrm_latch@0x021BB480@ */ ECIPP_ALIGNMENT_FLOAT32_IEEE 10000000000 Compu_IDENTITY -10000000000 10000000000 PHYS_UNIT "ms" /end CHARACTERISTIC
/begin CHARACTERISTIC FPfl_APUD19_min "FPrm_latch(289)" VALUE 0x001E049C /* @ECU_Address@FPrm_latch@0x021BB484@ */ ECIPP_ALIGNMENT_FLOAT32_IEEE 10000000000 Compu_IDENTITY -10000000000 10000000000 PHYS_UNIT "ms" /end CHARACTERISTIC
/begin CHARACTERISTIC FPfu_ADIG22_min "FPrm_unlatch(443)" VALUE 0x001E124C /* @ECU_Address@FPrm_unlatch@0x021BD6EC@ */ ECIPP_ALIGNMENT_FLOAT32_IEEE 10000000000 Compu_IDENTITY -10000000000 10000000000 PHYS_UNIT "ms" /end CHARACTERISTIC
/begin CHARACTERISTIC FPfu_ADIG23_max "FPrm_unlatch(444)" VALUE 0x001E1250 /* @ECU_Address@FPrm_unlatch@0x021BD6F0@ */ ECIPP_ALIGNMENT_FLOAT32_IEEE 10000000000 Compu_IDENTITY -10000000000 10000000000 PHYS_UNIT "ms" /end CHARACTERISTIC
/begin CHARACTERISTIC FPfu_ADIG23_min "FPrm_unlatch(445)" VALUE 0x001E1254 /* @ECU_Address@FPrm_unlatch@0x021BD6F4@ */ ECIPP_ALIGNMENT_FLOAT32_IEEE 10000000000 Compu_IDENTITY -10000000000 10000000000 PHYS_UNIT "ms" /end CHARACTERISTIC
/begin CHARACTERISTIC FPfu_ADIG24_max "FPrm_unlatch(446)" VALUE 0x001E1258 /* @ECU_Address@FPrm_unlatch@0x021BD6F8@ */ ECIPP_ALIGNMENT_FLOAT32_IEEE 10000000000 Compu_IDENTITY -10000000000 10000000000 PHYS_UNIT "ms" /end CHARACTERISTIC
/begin CHARACTERISTIC FPfu_ADIG24_min "FPrm_unlatch(447)" VALUE 0x001E125C /* @ECU_Address@FPrm_unlatch@0x021BD6FC@ */ ECIPP_ALIGNMENT_FLOAT32_IEEE 10000000000 Compu_IDENTITY -10000000000 10000000000 PHYS_UNIT "ms" /end CHARACTERISTIC
/begin CHARACTERISTIC FPfu_ADIG25_max "FPrm_unlatch(448)" VALUE 0x001E1260 /* @ECU_Address@FPrm_unlatch@0x021BD700@ */ ECIPP_ALIGNMENT_FLOAT32_IEEE 10000000000 Compu_IDENTITY -10000000000 10000000000 PHYS_UNIT "ms" /end CHARACTERISTIC
/begin CHARACTERISTIC FPfu_ADIG25_min "FPrm_unlatch(449)" VALUE 0x001E1264 /* @ECU_Address@FPrm_unlatch@0x021BD704@ */ ECIPP_ALIGNMENT_FLOAT32_IEEE 10000000000 Compu_IDENTITY -10000000000 10000000000 PHYS_UNIT "ms" /end CHARACTERISTIC
/begin CHARACTERISTIC FPfu_ADIG3_max "FPrm_unlatch(169)" VALUE 0x001E0E04 /* @ECU_Address@FPrm_unlatch@0x021BD2A4@ */ ECIPP_ALIGNMENT_FLOAT32_IEEE 10000000000 Compu_IDENTITY -10000000000 10000000000 PHYS_UNIT "ms" /end CHARACTERISTIC
/begin CHARACTERISTIC FPfu_ADIG3_min "FPrm_unlatch(170)" VALUE 0x001E0E08 /* @ECU_Address@FPrm_unlatch@0x021BD2A8@ */ ECIPP_ALIGNMENT_FLOAT32_IEEE 10000000000 Compu_IDENTITY -10000000000 10000000000 PHYS_UNIT "ms" /end CHARACTERISTIC
/begin CHARACTERISTIC FPfu_ADIG4_max "FPrm_unlatch(246)" VALUE 0x001E0F38 /* @ECU_Address@FPrm_unlatch@0x021BD3D8@ */ ECIPP_ALIGNMENT_FLOAT32_IEEE 10000000000 Compu_IDENTITY -10000000000 10000000000 PHYS_UNIT "ms" /end CHARACTERISTIC
/begin CHARACTERISTIC FPfu_ADIG4_min "FPrm_unlatch(247)" VALUE 0x001E0F3C /* @ECU_Address@FPrm_unlatch@0x021BD3DC@ */ ECIPP_ALIGNMENT_FLOAT32_IEEE 10000000000 Compu_IDENTITY -10000000000 10000000000 PHYS_UNIT "ms" /end CHARACTERISTIC
/begin CHARACTERISTIC FPfu_ADIG5_max "FPrm_unlatch(248)" VALUE 0x001E0F40 /* @ECU_Address@FPrm_unlatch@0x021BD3E0@ */ ECIPP_ALIGNMENT_FLOAT32_IEEE 10000000000 Compu_IDENTITY -10000000000 10000000000 PHYS_UNIT "ms" /end CHARACTERISTIC
/begin CHARACTERISTIC FPfu_ADIG5_min "FPrm_unlatch(249)" VALUE 0x001E0F44 /* @ECU_Address@FPrm_unlatch@0x021BD3E4@ */ ECIPP_ALIGNMENT_FLOAT32_IEEE 10000000000 Compu_IDENTITY -10000000000 10000000000 PHYS_UNIT "ms" /end CHARACTERISTIC
/begin CHARACTERISTIC FPfu_ADIG6_max "FPrm_unlatch(250)" VALUE 0x001E0F48 /* @ECU_Address@FPrm_unlatch@0x021BD3E8@ */ ECIPP_ALIGNMENT_FLOAT32_IEEE 10000000000 Compu_IDENTITY -10000000000 10000000000 PHYS_UNIT "ms" /end CHARACTERISTIC
/begin CHARACTERISTIC FPfu_ADIG6_min "FPrm_unlatch(251)" VALUE 0x001E0F4C /* @ECU_Address@FPrm_unlatch@0x021BD3EC@ */ ECIPP_ALIGNMENT_FLOAT32_IEEE 10000000000 Compu_IDENTITY -10000000000 10000000000 PHYS_UNIT "ms" /end CHARACTERISTIC
/begin CHARACTERISTIC FPfu_ADIG7_max "FPrm_unlatch(252)" VALUE 0x001E0F50 /* @ECU_Address@FPrm_unlatch@0x021BD3F0@ */ ECIPP_ALIGNMENT_FLOAT32_IEEE 10000000000 Compu_IDENTITY -10000000000 10000000000 PHYS_UNIT "ms" /end CHARACTERISTIC
/begin CHARACTERISTIC FPfu_ADIG7_min "FPrm_unlatch(253)" VALUE 0x001E0F54 /* @ECU_Address@FPrm_unlatch@0x021BD3F4@ */ ECIPP_ALIGNMENT_FLOAT32_IEEE 10000000000 Compu_IDENTITY -10000000000 10000000000 PHYS_UNIT "ms" /end CHARACTERISTIC
/begin CHARACTERISTIC FPfu_ADIG8_max "FPrm_unlatch(254)" VALUE 0x001E0F58 /* @ECU_Address@FPrm_unlatch@0x021BD3F8@ */ ECIPP_ALIGNMENT_FLOAT32_IEEE 10000000000 Compu_IDENTITY -10000000000 10000000000 PHYS_UNIT "ms" /end CHARACTERISTIC
/begin CHARACTERISTIC FPfu_ADIG8_min "FPrm_unlatch(255)" VALUE 0x001E0F5C /* @ECU_Address@FPrm_unlatch@0x021BD3FC@ */ ECIPP_ALIGNMENT_FLOAT32_IEEE 10000000000 Compu_IDENTITY -10000000000 10000000000 PHYS_UNIT "ms" /end CHARACTERISTIC
/begin CHARACTERISTIC FPfu_ADIG9_max "FPrm_unlatch(256)" VALUE 0x001E0F60 /* @ECU_Address@FPrm_unlatch@0x021BD400@ */ ECIPP_ALIGNMENT_FLOAT32_IEEE 10000000000 Compu_IDENTITY -10000000000 10000000000 PHYS_UNIT "ms" /end CHARACTERISTIC
/begin CHARACTERISTIC FPfu_ADIG9_min "FPrm_unlatch(257)" VALUE 0x001E0F64 /* @ECU_Address@FPrm_unlatch@0x021BD404@ */ ECIPP_ALIGNMENT_FLOAT32_IEEE 10000000000 Compu_IDENTITY -10000000000 10000000000 PHYS_UNIT "ms" /end CHARACTERISTIC
/begin CHARACTERISTIC FPfu_ADloss "FPrm_unlatch(67)" VALUE 0x001E0C6C /* @ECU_Address@FPrm_unlatch@0x021BD10C@ */ ECIPP_ALIGNMENT_FLOAT32_IEEE 10000000000 Compu_IDENTITY -10000000000 10000000000 PHYS_UNIT "ms" /end CHARACTERISTIC
/begin CHARACTERISTIC FPfu_AFILT_dP_high "FPrm_unlatch(562)" VALUE 0x001E1428 /* @ECU_Address@FPrm_unlatch@0x021BD8C8@ */ ECIPP_ALIGNMENT_FLOAT32_IEEE 10000000000 Compu_IDENTITY -10000000000 10000000000 PHYS_UNIT "ms" /end CHARACTERISTIC
/begin CHARACTERISTIC FPfu_AL_hi "FPrm_unlatch(41)" VALUE 0x001E0C04 /* @ECU_Address@FPrm_unlatch@0x021BD0A4@ */ ECIPP_ALIGNMENT_FLOAT32_IEEE 10000000000 Compu_IDENTITY -10000000000 10000000000 PHYS_UNIT "updates" /end CHARACTERISTIC
/begin CHARACTERISTIC FPfu_AL_lo "FPrm_unlatch(42)" VALUE 0x001E0C08 /* @ECU_Address@FPrm_unlatch@0x021BD0A8@ */ ECIPP_ALIGNMENT_FLOAT32_IEEE 10000000000 Compu_IDENTITY -10000000000 10000000000 PHYS_UNIT "updates" /end CHARACTERISTIC
/begin CHARACTERISTIC FPfu_ALLP_hi "FPrm_unlatch(43)" VALUE 0x001E0C0C /* @ECU_Address@FPrm_unlatch@0x021BD0AC@ */ ECIPP_ALIGNMENT_FLOAT32_IEEE 10000000000 Compu_IDENTITY -10000000000 10000000000 PHYS_UNIT "updates" /end CHARACTERISTIC
/begin CHARACTERISTIC FPfu_ALLP_lo "FPrm_unlatch(44)" VALUE 0x001E0C10 /* @ECU_Address@FPrm_unlatch@0x021BD0B0@ */ ECIPP_ALIGNMENT_FLOAT32_IEEE 10000000000 Compu_IDENTITY -10000000000 10000000000 PHYS_UNIT "updates" /end CHARACTERISTIC
/begin CHARACTERISTIC FPfu_ALNG_hi "FPrm_unlatch(45)" VALUE 0x001E0C14 /* @ECU_Address@FPrm_unlatch@0x021BD0B4@ */ ECIPP_ALIGNMENT_FLOAT32_IEEE 10000000000 Compu_IDENTITY -10000000000 10000000000 PHYS_UNIT "updates" /end CHARACTERISTIC
/begin CHARACTERISTIC FPfu_ALNG_lo "FPrm_unlatch(46)" VALUE 0x001E0C18 /* @ECU_Address@FPrm_unlatch@0x021BD0B8@ */ ECIPP_ALIGNMENT_FLOAT32_IEEE 10000000000 Compu_IDENTITY -10000000000 10000000000 PHYS_UNIT "updates" /end CHARACTERISTIC
/begin CHARACTERISTIC FPfu_APD1_max "FPrm_unlatch(75)" VALUE 0x001E0C8C /* @ECU_Address@FPrm_unlatch@0x021BD12C@ */ ECIPP_ALIGNMENT_FLOAT32_IEEE 10000000000 Compu_IDENTITY -10000000000 10000000000 PHYS_UNIT "ms" /end CHARACTERISTIC
/begin CHARACTERISTIC FPfu_APD1_min "FPrm_unlatch(76)" VALUE 0x001E0C90 /* @ECU_Address@FPrm_unlatch@0x021BD130@ */ ECIPP_ALIGNMENT_FLOAT32_IEEE 10000000000 Compu_IDENTITY -10000000000 10000000000 PHYS_UNIT "ms" /end CHARACTERISTIC
/begin CHARACTERISTIC FPfu_APD2_max "FPrm_unlatch(181)" VALUE 0x001E0E34 /* @ECU_Address@FPrm_unlatch@0x021BD2D4@ */ ECIPP_ALIGNMENT_FLOAT32_IEEE 10000000000 Compu_IDENTITY -10000000000 10000000000 PHYS_UNIT "ms" /end CHARACTERISTIC
/begin CHARACTERISTIC FPfu_APD2_min "FPrm_unlatch(182)" VALUE 0x001E0E38 /* @ECU_Address@FPrm_unlatch@0x021BD2D8@ */ ECIPP_ALIGNMENT_FLOAT32_IEEE 10000000000 Compu_IDENTITY -10000000000 10000000000 PHYS_UNIT "ms" /end CHARACTERISTIC
/begin CHARACTERISTIC FPfu_APD3_max "FPrm_unlatch(183)" VALUE 0x001E0E3C /* @ECU_Address@FPrm_unlatch@0x021BD2DC@ */ ECIPP_ALIGNMENT_FLOAT32_IEEE 10000000000 Compu_IDENTITY -10000000000 10000000000 PHYS_UNIT "ms" /end CHARACTERISTIC
/begin CHARACTERISTIC FPfu_APD3_min "FPrm_unlatch(184)" VALUE 0x001E0E40 /* @ECU_Address@FPrm_unlatch@0x021BD2E0@ */ ECIPP_ALIGNMENT_FLOAT32_IEEE 10000000000 Compu_IDENTITY -10000000000 10000000000 PHYS_UNIT "ms" /end CHARACTERISTIC
/begin CHARACTERISTIC FPfu_APS1_max "FPrm_unlatch(362)" VALUE 0x001E1108 /* @ECU_Address@FPrm_unlatch@0x021BD5A8@ */ ECIPP_ALIGNMENT_FLOAT32_IEEE 10000000000 Compu_IDENTITY -10000000000 10000000000 PHYS_UNIT "ms" /end CHARACTERISTIC
/begin CHARACTERISTIC FPfu_APS1_min "FPrm_unlatch(363)" VALUE 0x001E110C /* @ECU_Address@FPrm_unlatch@0x021BD5AC@ */ ECIPP_ALIGNMENT_FLOAT32_IEEE 10000000000 Compu_IDENTITY -10000000000 10000000000 PHYS_UNIT "ms" /end CHARACTERISTIC
/begin CHARACTERISTIC FPfu_APS12_OOR "FPrm_unlatch(370)" VALUE 0x001E1128 /* @ECU_Address@FPrm_unlatch@0x021BD5C8@ */ ECIPP_ALIGNMENT_FLOAT32_IEEE 10000000000 Compu_IDENTITY -10000000000 10000000000 PHYS_UNIT "ms" /end CHARACTERISTIC
/begin CHARACTERISTIC FPfu_APS12pct_hi "FPrm_unlatch(366)" VALUE 0x001E1118 /* @ECU_Address@FPrm_unlatch@0x021BD5B8@ */ ECIPP_ALIGNMENT_FLOAT32_IEEE 10000000000 Compu_IDENTITY -10000000000 10000000000 PHYS_UNIT "ms" /end CHARACTERISTIC
/begin CHARACTERISTIC FPfu_APS12pct_lo "FPrm_unlatch(367)" VALUE 0x001E111C /* @ECU_Address@FPrm_unlatch@0x021BD5BC@ */ ECIPP_ALIGNMENT_FLOAT32_IEEE 10000000000 Compu_IDENTITY -10000000000 10000000000 PHYS_UNIT "ms" /end CHARACTERISTIC
/begin CHARACTERISTIC FPfu_APS2_max "FPrm_unlatch(364)" VALUE 0x001E1110 /* @ECU_Address@FPrm_unlatch@0x021BD5B0@ */ ECIPP_ALIGNMENT_FLOAT32_IEEE 10000000000 Compu_IDENTITY -10000000000 10000000000 PHYS_UNIT "ms" /end CHARACTERISTIC
/begin CHARACTERISTIC FPfu_APS2_min "FPrm_unlatch(365)" VALUE 0x001E1114 /* @ECU_Address@FPrm_unlatch@0x021BD5B4@ */ ECIPP_ALIGNMENT_FLOAT32_IEEE 10000000000 Compu_IDENTITY -10000000000 10000000000 PHYS_UNIT "ms" /end CHARACTERISTIC
/begin CHARACTERISTIC FPfu_APSerr_neg "FPrm_unlatch(369)" VALUE 0x001E1124 /* @ECU_Address@FPrm_unlatch@0x021BD5C4@ */ ECIPP_ALIGNMENT_FLOAT32_IEEE 10000000000 Compu_IDENTITY -10000000000 10000000000 PHYS_UNIT "ms" /end CHARACTERISTIC
/begin CHARACTERISTIC FPfu_APSerr_pos "FPrm_unlatch(368)" VALUE 0x001E1120 /* @ECU_Address@FPrm_unlatch@0x021BD5C0@ */ ECIPP_ALIGNMENT_FLOAT32_IEEE 10000000000 Compu_IDENTITY -10000000000 10000000000 PHYS_UNIT "ms" /end CHARACTERISTIC
/begin CHARACTERISTIC FPfu_APU1_max "FPrm_unlatch(77)" VALUE 0x001E0C94 /* @ECU_Address@FPrm_unlatch@0x021BD134@ */ ECIPP_ALIGNMENT_FLOAT32_IEEE 10000000000 Compu_IDENTITY -10000000000 10000000000 PHYS_UNIT "ms" /end CHARACTERISTIC
/begin CHARACTERISTIC FPfu_APU1_min "FPrm_unlatch(78)" VALUE 0x001E0C98 /* @ECU_Address@FPrm_unlatch@0x021BD138@ */ ECIPP_ALIGNMENT_FLOAT32_IEEE 10000000000 Compu_IDENTITY -10000000000 10000000000 PHYS_UNIT "ms" /end CHARACTERISTIC
/begin CHARACTERISTIC FPfu_APU2_max "FPrm_unlatch(79)" VALUE 0x001E0C9C /* @ECU_Address@FPrm_unlatch@0x021BD13C@ */ ECIPP_ALIGNMENT_FLOAT32_IEEE 10000000000 Compu_IDENTITY -10000000000 10000000000 PHYS_UNIT "ms" /end CHARACTERISTIC
/begin CHARACTERISTIC FPfu_APU2_min "FPrm_unlatch(80)" VALUE 0x001E0CA0 /* @ECU_Address@FPrm_unlatch@0x021BD140@ */ ECIPP_ALIGNMENT_FLOAT32_IEEE 10000000000 Compu_IDENTITY -10000000000 10000000000 PHYS_UNIT "ms" /end CHARACTERISTIC
/begin CHARACTERISTIC FPfu_APU3_max "FPrm_unlatch(157)" VALUE 0x001E0DD4 /* @ECU_Address@FPrm_unlatch@0x021BD274@ */ ECIPP_ALIGNMENT_FLOAT32_IEEE 10000000000 Compu_IDENTITY -10000000000 10000000000 PHYS_UNIT "ms" /end CHARACTERISTIC
/begin CHARACTERISTIC FPfu_APU3_min "FPrm_unlatch(158)" VALUE 0x001E0DD8 /* @ECU_Address@FPrm_unlatch@0x021BD278@ */ ECIPP_ALIGNMENT_FLOAT32_IEEE 10000000000 Compu_IDENTITY -10000000000 10000000000 PHYS_UNIT "ms" /end CHARACTERISTIC
/begin CHARACTERISTIC FPfu_APUD1_max "FPrm_unlatch(159)" VALUE 0x001E0DDC /* @ECU_Address@FPrm_unlatch@0x021BD27C@ */ ECIPP_ALIGNMENT_FLOAT32_IEEE 10000000000 Compu_IDENTITY -10000000000 10000000000 PHYS_UNIT "ms" /end CHARACTERISTIC
/begin CHARACTERISTIC FPfu_APUD1_min "FPrm_unlatch(160)" VALUE 0x001E0DE0 /* @ECU_Address@FPrm_unlatch@0x021BD280@ */ ECIPP_ALIGNMENT_FLOAT32_IEEE 10000000000 Compu_IDENTITY -10000000000 10000000000 PHYS_UNIT "ms" /end CHARACTERISTIC
/begin CHARACTERISTIC FPfu_APUD10_max "FPrm_unlatch(270)" VALUE 0x001E0F98 /* @ECU_Address@FPrm_unlatch@0x021BD438@ */ ECIPP_ALIGNMENT_FLOAT32_IEEE 10000000000 Compu_IDENTITY -10000000000 10000000000 PHYS_UNIT "ms" /end CHARACTERISTIC
/begin CHARACTERISTIC FPfu_APUD10_min "FPrm_unlatch(271)" VALUE 0x001E0F9C /* @ECU_Address@FPrm_unlatch@0x021BD43C@ */ ECIPP_ALIGNMENT_FLOAT32_IEEE 10000000000 Compu_IDENTITY -10000000000 10000000000 PHYS_UNIT "ms" /end CHARACTERISTIC
/begin CHARACTERISTIC FPfu_APUD11_max "FPrm_unlatch(272)" VALUE 0x001E0FA0 /* @ECU_Address@FPrm_unlatch@0x021BD440@ */ ECIPP_ALIGNMENT_FLOAT32_IEEE 10000000000 Compu_IDENTITY -10000000000 10000000000 PHYS_UNIT "ms" /end CHARACTERISTIC
/begin CHARACTERISTIC FPfu_APUD11_min "FPrm_unlatch(273)" VALUE 0x001E0FA4 /* @ECU_Address@FPrm_unlatch@0x021BD444@ */ ECIPP_ALIGNMENT_FLOAT32_IEEE 10000000000 Compu_IDENTITY -10000000000 10000000000 PHYS_UNIT "ms" /end CHARACTERISTIC
/begin CHARACTERISTIC FPfu_APUD12_max "FPrm_unlatch(274)" VALUE 0x001E0FA8 /* @ECU_Address@FPrm_unlatch@0x021BD448@ */ ECIPP_ALIGNMENT_FLOAT32_IEEE 10000000000 Compu_IDENTITY -10000000000 10000000000 PHYS_UNIT "ms" /end CHARACTERISTIC
/begin CHARACTERISTIC FPfu_APUD12_min "FPrm_unlatch(275)" VALUE 0x001E0FAC /* @ECU_Address@FPrm_unlatch@0x021BD44C@ */ ECIPP_ALIGNMENT_FLOAT32_IEEE 10000000000 Compu_IDENTITY -10000000000 10000000000 PHYS_UNIT "ms" /end CHARACTERISTIC
/begin CHARACTERISTIC FPfu_APUD13_max "FPrm_unlatch(276)" VALUE 0x001E0FB0 /* @ECU_Address@FPrm_unlatch@0x021BD450@ */ ECIPP_ALIGNMENT_FLOAT32_IEEE 10000000000 Compu_IDENTITY -10000000000 10000000000 PHYS_UNIT "ms" /end CHARACTERISTIC
/begin CHARACTERISTIC FPfu_APUD13_min "FPrm_unlatch(277)" VALUE 0x001E0FB4 /* @ECU_Address@FPrm_unlatch@0x021BD454@ */ ECIPP_ALIGNMENT_FLOAT32_IEEE 10000000000 Compu_IDENTITY -10000000000 10000000000 PHYS_UNIT "ms" /end CHARACTERISTIC
/begin CHARACTERISTIC FPfu_APUD14_max "FPrm_unlatch(278)" VALUE 0x001E0FB8 /* @ECU_Address@FPrm_unlatch@0x021BD458@ */ ECIPP_ALIGNMENT_FLOAT32_IEEE 10000000000 Compu_IDENTITY -10000000000 10000000000 PHYS_UNIT "ms" /end CHARACTERISTIC
/begin CHARACTERISTIC FPfu_APUD14_min "FPrm_unlatch(279)" VALUE 0x001E0FBC /* @ECU_Address@FPrm_unlatch@0x021BD45C@ */ ECIPP_ALIGNMENT_FLOAT32_IEEE 10000000000 Compu_IDENTITY -10000000000 10000000000 PHYS_UNIT "ms" /end CHARACTERISTIC
/begin CHARACTERISTIC FPfu_APUD15_max "FPrm_unlatch(280)" VALUE 0x001E0FC0 /* @ECU_Address@FPrm_unlatch@0x021BD460@ */ ECIPP_ALIGNMENT_FLOAT32_IEEE 10000000000 Compu_IDENTITY -10000000000 10000000000 PHYS_UNIT "ms" /end CHARACTERISTIC
/begin CHARACTERISTIC FPfu_APUD15_min "FPrm_unlatch(281)" VALUE 0x001E0FC4 /* @ECU_Address@FPrm_unlatch@0x021BD464@ */ ECIPP_ALIGNMENT_FLOAT32_IEEE 10000000000 Compu_IDENTITY -10000000000 10000000000 PHYS_UNIT "ms" /end CHARACTERISTIC
/begin CHARACTERISTIC FPfu_APUD16_max "FPrm_unlatch(282)" VALUE 0x001E0FC8 /* @ECU_Address@FPrm_unlatch@0x021BD468@ */ ECIPP_ALIGNMENT_FLOAT32_IEEE 10000000000 Compu_IDENTITY -10000000000 10000000000 PHYS_UNIT "ms" /end CHARACTERISTIC
/begin CHARACTERISTIC FPfu_APUD16_min "FPrm_unlatch(283)" VALUE 0x001E0FCC /* @ECU_Address@FPrm_unlatch@0x021BD46C@ */ ECIPP_ALIGNMENT_FLOAT32_IEEE 10000000000 Compu_IDENTITY -10000000000 10000000000 PHYS_UNIT "ms" /end CHARACTERISTIC
/begin CHARACTERISTIC FPfu_APUD17_max "FPrm_unlatch(284)" VALUE 0x001E0FD0 /* @ECU_Address@FPrm_unlatch@0x021BD470@ */ ECIPP_ALIGNMENT_FLOAT32_IEEE 10000000000 Compu_IDENTITY -10000000000 10000000000 PHYS_UNIT "ms" /end CHARACTERISTIC
/begin CHARACTERISTIC FPfu_APUD17_min "FPrm_unlatch(285)" VALUE 0x001E0FD4 /* @ECU_Address@FPrm_unlatch@0x021BD474@ */ ECIPP_ALIGNMENT_FLOAT32_IEEE 10000000000 Compu_IDENTITY -10000000000 10000000000 PHYS_UNIT "ms" /end CHARACTERISTIC
/begin CHARACTERISTIC FPfu_APUD18_max "FPrm_unlatch(286)" VALUE 0x001E0FD8 /* @ECU_Address@FPrm_unlatch@0x021BD478@ */ ECIPP_ALIGNMENT_FLOAT32_IEEE 10000000000 Compu_IDENTITY -10000000000 10000000000 PHYS_UNIT "ms" /end CHARACTERISTIC
/begin CHARACTERISTIC FPfu_APUD18_min "FPrm_unlatch(287)" VALUE 0x001E0FDC /* @ECU_Address@FPrm_unlatch@0x021BD47C@ */ ECIPP_ALIGNMENT_FLOAT32_IEEE 10000000000 Compu_IDENTITY -10000000000 10000000000 PHYS_UNIT "ms" /end CHARACTERISTIC
/begin CHARACTERISTIC FPfu_APUD19_max "FPrm_unlatch(288)" VALUE 0x001E0FE0 /* @ECU_Address@FPrm_unlatch@0x021BD480@ */ ECIPP_ALIGNMENT_FLOAT32_IEEE 10000000000 Compu_IDENTITY -10000000000 10000000000 PHYS_UNIT "ms" /end CHARACTERISTIC
/begin CHARACTERISTIC FPfu_APUD19_min "FPrm_unlatch(289)" VALUE 0x001E0FE4 /* @ECU_Address@FPrm_unlatch@0x021BD484@ */ ECIPP_ALIGNMENT_FLOAT32_IEEE 10000000000 Compu_IDENTITY -10000000000 10000000000 PHYS_UNIT "ms" /end CHARACTERISTIC
/begin GROUP ADIG22_min_EC_Fault "AUX digital 22 low voltage"
 /begin REF_CHARACTERISTIC FCdc4_ADIG22_min FCdtc_ADIG22_min FCfmi_ADIG22_min FCftb_ADIG22_min FCspn_ADIG22_min FPfl_ADIG22_min FPfu_ADIG22_min FPnd_ADIG22_min FPsvr_ADIG22_min FPsw_ext1_ADIG22_min FPsw_ADIG22_min /end REF_CHARACTERISTIC
/end GROUP
/begin GROUP ADIG23_max_EC_Fault "AUX digital 23 high voltage"
 /begin REF_CHARACTERISTIC FCdc4_ADIG23_max FCdtc_ADIG23_max FCfmi_ADIG23_max FCftb_ADIG23_max FCspn_ADIG23_max FPfl_ADIG23_max FPfu_ADIG23_max FPnd_ADIG23_max FPsvr_ADIG23_max FPsw_ext1_ADIG23_max FPsw_ADIG23_max /end REF_CHARACTERISTIC
/end GROUP
/begin GROUP ADIG23_min_EC_Fault "AUX digital 23 low voltage"
 /begin REF_CHARACTERISTIC FCdc4_ADIG23_min FCdtc_ADIG23_min FCfmi_ADIG23_min FCftb_ADIG23_min FCspn_ADIG23_min FPfl_ADIG23_min FPfu_ADIG23_min FPnd_ADIG23_min FPsvr_ADIG23_min FPsw_ext1_ADIG23_min FPsw_ADIG23_min /end REF_CHARACTERISTIC
/end GROUP
/begin GROUP ADIG24_max_EC_Fault "AUX digital 24 high voltage"
 /begin REF_CHARACTERISTIC FCdc4_ADIG24_max FCdtc_ADIG24_max FCfmi_ADIG24_max FCftb_ADIG24_max FCspn_ADIG24_max FPfl_ADIG24_max FPfu_ADIG24_max FPnd_ADIG24_max FPsvr_ADIG24_max FPsw_ext1_ADIG24_max FPsw_ADIG24_max /end REF_CHARACTERISTIC
/end GROUP
/begin GROUP ADIG24_min_EC_Fault "AUX digital 24 low voltage"
 /begin REF_CHARACTERISTIC FCdc4_ADIG24_min FCdtc_ADIG24_min FCfmi_ADIG24_min FCftb_ADIG24_min FCspn_ADIG24_min FPfl_ADIG24_min FPfu_ADIG24_min FPnd_ADIG24_min FPsvr_ADIG24_min FPsw_ext1_ADIG24_min FPsw_ADIG24_min /end REF_CHARACTERISTIC
/end GROUP
/begin GROUP ADIG25_max_EC_Fault "AUX digital 25 high voltage"
 /begin REF_CHARACTERISTIC FCdc4_ADIG25_max FCdtc_ADIG25_max FCfmi_ADIG25_max FCftb_ADIG25_max FCspn_ADIG25_max FPfl_ADIG25_max FPfu_ADIG25_max FPnd_ADIG25_max FPsvr_ADIG25_max FPsw_ext1_ADIG25_max FPsw_ADIG25_max /end REF_CHARACTERISTIC
/end GROUP
/begin GROUP ADIG25_min_EC_Fault "AUX digital 25 low voltage"
 /begin REF_CHARACTERISTIC FCdc4_ADIG25_min FCdtc_ADIG25_min FCfmi_ADIG25_min FCftb_ADIG25_min FCspn_ADIG25_min FPfl_ADIG25_min FPfu_ADIG25_min FPnd_ADIG25_min FPsvr_ADIG25_min FPsw_ext1_ADIG25_min FPsw_ADIG25_min /end REF_CHARACTERISTIC
/end GROUP
/begin GROUP ADIG3_max_EC_Fault "AUX digital 3 high voltage"
 /begin REF_CHARACTERISTIC FCdc4_ADIG3_max FCdtc_ADIG3_max FCfmi_ADIG3_max FCftb_ADIG3_max FCspn_ADIG3_max FPfl_ADIG3_max FPfu_ADIG3_max FPnd_ADIG3_max FPsvr_ADIG3_max FPsw_ext1_ADIG3_max FPsw_ADIG3_max /end REF_CHARACTERISTIC
/end GROUP
/begin GROUP ADIG3_min_EC_Fault "AUX digital 3 low voltage"
 /begin REF_CHARACTERISTIC FCdc4_ADIG3_min FCdtc_ADIG3_min FCfmi_ADIG3_min FCftb_ADIG3_min FCspn_ADIG3_min FPfl_ADIG3_min FPfu_ADIG3_min FPnd_ADIG3_min FPsvr_ADIG3_min FPsw_ext1_ADIG3_min FPsw_ADIG3_min /end REF_CHARACTERISTIC
/end GROUP
/begin GROUP ADIG4_max_EC_Fault "AUX digital 4 high voltage"
 /begin REF_CHARACTERISTIC FCdc4_ADIG4_max FCdtc_ADIG4_max FCfmi_ADIG4_max FCftb_ADIG4_max FCspn_ADIG4_max FPfl_ADIG4_max FPfu_ADIG4_max FPnd_ADIG4_max FPsvr_ADIG4_max FPsw_ext1_ADIG4_max FPsw_ADIG4_max /end REF_CHARACTERISTIC
/end GROUP
/begin GROUP ADIG4_min_EC_Fault "AUX digital 4 low voltage"
 /begin REF_CHARACTERISTIC FCdc4_ADIG4_min FCdtc_ADIG4_min FCfmi_ADIG4_min FCftb_ADIG4_min FCspn_ADIG4_min FPfl_ADIG4_min FPfu_ADIG4_min FPnd_ADIG4_min FPsvr_ADIG4_min FPsw_ext1_ADIG4_min FPsw_ADIG4_min /end REF_CHARACTERISTIC
/end GROUP
/begin GROUP ADIG5_max_EC_Fault "AUX digital 5 high voltage"
 /begin REF_CHARACTERISTIC FCdc4_ADIG5_max FCdtc_ADIG5_max FCfmi_ADIG5_max FCftb_ADIG5_max FCspn_ADIG5_max FPfl_ADIG5_max FPfu_ADIG5_max FPnd_ADIG5_max FPsvr_ADIG5_max FPsw_ext1_ADIG5_max FPsw_ADIG5_max /end REF_CHARACTERISTIC
/end GROUP
/begin GROUP ADIG5_min_EC_Fault "AUX digital 5 low voltage"
 /begin REF_CHARACTERISTIC FCdc4_ADIG5_min FCdtc_ADIG5_min FCfmi_ADIG5_min FCftb_ADIG5_min FCspn_ADIG5_min FPfl_ADIG5_min FPfu_ADIG5_min FPnd_ADIG5_min FPsvr_ADIG5_min FPsw_ext1_ADIG5_min FPsw_ADIG5_min /end REF_CHARACTERISTIC
/end GROUP
/begin GROUP ADIG6_max_EC_Fault "AUX digital 6 high voltage"
 /begin REF_CHARACTERISTIC FCdc4_ADIG6_max FCdtc_ADIG6_max FCfmi_ADIG6_max FCftb_ADIG6_max FCspn_ADIG6_max FPfl_ADIG6_max FPfu_ADIG6_max FPnd_ADIG6_max FPsvr_ADIG6_max FPsw_ext1_ADIG6_max FPsw_ADIG6_max /end REF_CHARACTERISTIC
/end GROUP
/begin GROUP ADIG6_min_EC_Fault "AUX digital 6 low voltage"
 /begin REF_CHARACTERISTIC FCdc4_ADIG6_min FCdtc_ADIG6_min FCfmi_ADIG6_min FCftb_ADIG6_min FCspn_ADIG6_min FPfl_ADIG6_min FPfu_ADIG6_min FPnd_ADIG6_min FPsvr_ADIG6_min FPsw_ext1_ADIG6_min FPsw_ADIG6_min /end REF_CHARACTERISTIC
/end GROUP
/begin GROUP ADIG7_max_EC_Fault "AUX digital 7 high voltage"
 /begin REF_CHARACTERISTIC FCdc4_ADIG7_max FCdtc_ADIG7_max FCfmi_ADIG7_max FCftb_ADIG7_max FCspn_ADIG7_max FPfl_ADIG7_max FPfu_ADIG7_max FPnd_ADIG7_max FPsvr_ADIG7_max FPsw_ext1_ADIG7_max FPsw_ADIG7_max /end REF_CHARACTERISTIC
/end GROUP
/begin GROUP ADIG7_min_EC_Fault "AUX digital 7 low voltage"
 /begin REF_CHARACTERISTIC FCdc4_ADIG7_min FCdtc_ADIG7_min FCfmi_ADIG7_min FCftb_ADIG7_min FCspn_ADIG7_min FPfl_ADIG7_min FPfu_ADIG7_min FPnd_ADIG7_min FPsvr_ADIG7_min FPsw_ext1_ADIG7_min FPsw_ADIG7_min /end REF_CHARACTERISTIC
/end GROUP
/begin GROUP ADIG8_max_EC_Fault "AUX digital 8 high voltage"
 /begin REF_CHARACTERISTIC FCdc4_ADIG8_max FCdtc_ADIG8_max FCfmi_ADIG8_max FCftb_ADIG8_max FCspn_ADIG8_max FPfl_ADIG8_max FPfu_ADIG8_max FPnd_ADIG8_max FPsvr_ADIG8_max FPsw_ext1_ADIG8_max FPsw_ADIG8_max /end REF_CHARACTERISTIC
/end GROUP
/begin GROUP ADIG8_min_EC_Fault "AUX digital 8 low voltage"
 /begin REF_CHARACTERISTIC FCdc4_ADIG8_min FCdtc_ADIG8_min FCfmi_ADIG8_min FCftb_ADIG8_min FCspn_ADIG8_min FPfl_ADIG8_min FPfu_ADIG8_min FPnd_ADIG8_min FPsvr_ADIG8_min FPsw_ext1_ADIG8_min FPsw_ADIG8_min /end REF_CHARACTERISTIC
/end GROUP
/begin GROUP ADIG9_max_EC_Fault "AUX digital 9 high voltage"
 /begin REF_CHARACTERISTIC FCdc4_ADIG9_max FCdtc_ADIG9_max FCfmi_ADIG9_max FCftb_ADIG9_max FCspn_ADIG9_max FPfl_ADIG9_max FPfu_ADIG9_max FPnd_ADIG9_max FPsvr_ADIG9_max FPsw_ext1_ADIG9_max FPsw_ADIG9_max /end REF_CHARACTERISTIC
/end GROUP
/begin GROUP ADIG9_min_EC_Fault "AUX digital 9 low voltage"
 /begin REF_CHARACTERISTIC FCdc4_ADIG9_min FCdtc_ADIG9_min FCfmi_ADIG9_min FCftb_ADIG9_min FCspn_ADIG9_min FPfl_ADIG9_min FPfu_ADIG9_min FPnd_ADIG9_min FPsvr_ADIG9_min FPsw_ext1_ADIG9_min FPsw_ADIG9_min /end REF_CHARACTERISTIC
/end GROUP
/begin GROUP ADloss_EC_Fault "A/D loss"
 /begin REF_CHARACTERISTIC FCdc4_ADloss FCdtc_ADloss FCfmi_ADloss FCftb_ADloss FCspn_ADloss FPfl_ADloss FPfu_ADloss FPnd_ADloss FPsvr_ADloss FPsw_ext1_ADloss FPsw_ADloss /end REF_CHARACTERISTIC
/end GROUP
/begin GROUP AFILT_dP_high_EC_Fault "Air filter differential pressure high"
 /begin REF_CHARACTERISTIC FCdc4_AFILT_dP_high FCdtc_AFILT_dP_high FCfmi_AFILT_dP_high FCftb_AFILT_dP_high FCspn_AFILT_dP_high FPfl_AFILT_dP_high FPfu_AFILT_dP_high FPnd_AFILT_dP_high FPsvr_AFILT_dP_high FPsw_ext1_AFILT_dP_high FPsw_AFILT_dP_high /end REF_CHARACTERISTIC
/end GROUP
/begin GROUP AL_hi_EC_Fault "AL high gasoline bank1"
 /begin REF_CHARACTERISTIC FCdc4_AL_hi FCdtc_AL_hi FCfmi_AL_hi FCftb_AL_hi FCspn_AL_hi FPfl_AL_hi FPfu_AL_hi FPnd_AL_hi FPsvr_AL_hi FPsw_ext1_AL_hi FPsw_AL_hi /end REF_CHARACTERISTIC
/end GROUP
/begin GROUP AL_lo_EC_Fault "AL low gasoline bank1"
 /begin REF_CHARACTERISTIC FCdc4_AL_lo FCdtc_AL_lo FCfmi_AL_lo FCftb_AL_lo FCspn_AL_lo FPfl_AL_lo FPfu_AL_lo FPnd_AL_lo FPsvr_AL_lo FPsw_ext1_AL_lo FPsw_AL_lo /end REF_CHARACTERISTIC
/end GROUP
/begin GROUP ALLP_hi_EC_Fault "AL high LPG"
 /begin REF_CHARACTERISTIC FCdc4_ALLP_hi FCdtc_ALLP_hi FCfmi_ALLP_hi FCftb_ALLP_hi FCspn_ALLP_hi FPfl_ALLP_hi FPfu_ALLP_hi FPnd_ALLP_hi FPsvr_ALLP_hi FPsw_ext1_ALLP_hi FPsw_ALLP_hi /end REF_CHARACTERISTIC
/end GROUP
/begin GROUP ALLP_lo_EC_Fault "AL low LPG"
 /begin REF_CHARACTERISTIC FCdc4_ALLP_lo FCdtc_ALLP_lo FCfmi_ALLP_lo FCftb_ALLP_lo FCspn_ALLP_lo FPfl_ALLP_lo FPfu_ALLP_lo FPnd_ALLP_lo FPsvr_ALLP_lo FPsw_ext1_ALLP_lo FPsw_ALLP_lo /end REF_CHARACTERISTIC
/end GROUP
/begin GROUP ALNG_hi_EC_Fault "AL high NG"
 /begin REF_CHARACTERISTIC FCdc4_ALNG_hi FCdtc_ALNG_hi FCfmi_ALNG_hi FCftb_ALNG_hi FCspn_ALNG_hi FPfl_ALNG_hi FPfu_ALNG_hi FPnd_ALNG_hi FPsvr_ALNG_hi FPsw_ext1_ALNG_hi FPsw_ALNG_hi /end REF_CHARACTERISTIC
/end GROUP
/begin GROUP ALNG_lo_EC_Fault "AL low NG"
 /begin REF_CHARACTERISTIC FCdc4_ALNG_lo FCdtc_ALNG_lo FCfmi_ALNG_lo FCftb_ALNG_lo FCspn_ALNG_lo FPfl_ALNG_lo FPfu_ALNG_lo FPnd_ALNG_lo FPsvr_ALNG_lo FPsw_ext1_ALNG_lo FPsw_ALNG_lo /end REF_CHARACTERISTIC
/end GROUP
/begin GROUP APD1_max_EC_Fault "AUX analog Pull-Down 1 high voltage"
 /begin REF_CHARACTERISTIC FCdc4_APD1_max FCdtc_APD1_max FCfmi_APD1_max FCftb_APD1_max FCspn_APD1_max FPfl_APD1_max FPfu_APD1_max FPnd_APD1_max FPsvr_APD1_max FPsw_ext1_APD1_max FPsw_APD1_max /end REF_CHARACTERISTIC
/end GROUP
/begin GROUP APD1_min_EC_Fault "AUX analog Pull-Down 1 low voltage"
 /begin REF_CHARACTERISTIC FCdc4_APD1_min FCdtc_APD1_min FCfmi_APD1_min FCftb_APD1_min FCspn_APD1_min FPfl_APD1_min FPfu_APD1_min FPnd_APD1_min FPsvr_APD1_min FPsw_ext1_APD1_min FPsw_APD1_min /end REF_CHARACTERISTIC
/end GROUP
/begin GROUP APD2_max_EC_Fault "AUX analog Pull-Down 2 high voltage"
 /begin REF_CHARACTERISTIC FCdc4_APD2_max FCdtc_APD2_max FCfmi_APD2_max FCftb_APD2_max FCspn_APD2_max FPfl_APD2_max FPfu_APD2_max FPnd_APD2_max FPsvr_APD2_max FPsw_ext1_APD2_max FPsw_APD2_max /end REF_CHARACTERISTIC
/end GROUP
/begin GROUP APD2_min_EC_Fault "AUX analog Pull-Down 2 low voltage"
 /begin REF_CHARACTERISTIC FCdc4_APD2_min FCdtc_APD2_min FCfmi_APD2_min FCftb_APD2_min FCspn_APD2_min FPfl_APD2_min FPfu_APD2_min FPnd_APD2_min FPsvr_APD2_min FPsw_ext1_APD2_min FPsw_APD2_min /end REF_CHARACTERISTIC
/end GROUP
/begin GROUP APD3_max_EC_Fault "AUX analog Pull-Down 3 high voltage"
 /begin REF_CHARACTERISTIC FCdc4_APD3_max FCdtc_APD3_max FCfmi_APD3_max FCftb_APD3_max FCspn_APD3_max FPfl_APD3_max FPfu_APD3_max FPnd_APD3_max FPsvr_APD3_max FPsw_ext1_APD3_max FPsw_APD3_max /end REF_CHARACTERISTIC
/end GROUP
/begin GROUP APD3_min_EC_Fault "AUX analog Pull-Down 3 low voltage"
 /begin REF_CHARACTERISTIC FCdc4_APD3_min FCdtc_APD3_min FCfmi_APD3_min FCftb_APD3_min FCspn_APD3_min FPfl_APD3_min FPfu_APD3_min FPnd_APD3_min FPsvr_APD3_min FPsw_ext1_APD3_min FPsw_APD3_min /end REF_CHARACTERISTIC
/end GROUP
/begin GROUP APS1_max_EC_Fault "APS1 high voltage"
 /begin REF_CHARACTERISTIC FCdc4_APS1_max FCdtc_APS1_max FCfmi_APS1_max FCftb_APS1_max FCspn_APS1_max FPfl_APS1_max FPfu_APS1_max FPnd_APS1_max FPsvr_APS1_max FPsw_ext1_APS1_max FPsw_APS1_max /end REF_CHARACTERISTIC
/end GROUP
/begin GROUP APS1_min_EC_Fault "APS1 low voltage"
 /begin REF_CHARACTERISTIC FCdc4_APS1_min FCdtc_APS1_min FCfmi_APS1_min FCftb_APS1_min FCspn_APS1_min FPfl_APS1_min FPfu_APS1_min FPnd_APS1_min FPsvr_APS1_min FPsw_ext1_APS1_min FPsw_APS1_min /end REF_CHARACTERISTIC
/end GROUP
/begin GROUP APS12_OOR_EC_Fault "APS1/2 simultaneous voltages"
 /begin REF_CHARACTERISTIC FCdc4_APS12_OOR FCdtc_APS12_OOR FCfmi_APS12_OOR FCftb_APS12_OOR FCspn_APS12_OOR FPfl_APS12_OOR FPfu_APS12_OOR FPnd_APS12_OOR FPsvr_APS12_OOR FPsw_ext1_APS12_OOR FPsw_APS12_OOR /end REF_CHARACTERISTIC
/end GROUP
/begin GROUP APS12pct_hi_EC_Fault "APS1 higher than APS2"
 /begin REF_CHARACTERISTIC FCdc4_APS12pct_hi FCdtc_APS12pct_hi FCfmi_APS12pct_hi FCftb_APS12pct_hi FCspn_APS12pct_hi FPfl_APS12pct_hi FPfu_APS12pct_hi FPnd_APS12pct_hi FPsvr_APS12pct_hi FPsw_ext1_APS12pct_hi FPsw_APS12pct_hi /end REF_CHARACTERISTIC
/end GROUP
/begin GROUP APS12pct_lo_EC_Fault "APS1 lower than APS2"
 /begin REF_CHARACTERISTIC FCdc4_APS12pct_lo FCdtc_APS12pct_lo FCfmi_APS12pct_lo FCftb_APS12pct_lo FCspn_APS12pct_lo FPfl_APS12pct_lo FPfu_APS12pct_lo FPnd_APS12pct_lo FPsvr_APS12pct_lo FPsw_ext1_APS12pct_lo FPsw_APS12pct_lo /end REF_CHARACTERISTIC
/end GROUP
/begin GROUP APS2_max_EC_Fault "APS2 high voltage"
 /begin REF_CHARACTERISTIC FCdc4_APS2_max FCdtc_APS2_max FCfmi_APS2_max FCftb_APS2_max FCspn_APS2_max FPfl_APS2_max FPfu_APS2_max FPnd_APS2_max FPsvr_APS2_max FPsw_ext1_APS2_max FPsw_APS2_max /end REF_CHARACTERISTIC
/end GROUP
/begin GROUP APS2_min_EC_Fault "APS2 low voltage"
 /begin REF_CHARACTERISTIC FCdc4_APS2_min FCdtc_APS2_min FCfmi_APS2_min FCftb_APS2_min FCspn_APS2_min FPfl_APS2_min FPfu_APS2_min FPnd_APS2_min FPsvr_APS2_min FPsw_ext1_APS2_min FPsw_APS2_min /end REF_CHARACTERISTIC
/end GROUP
/begin GROUP APSerr_neg_EC_Fault "Unable to reach lower APS"
 /begin REF_CHARACTERISTIC FCdc4_APSerr_neg FCdtc_APSerr_neg FCfmi_APSerr_neg FCftb_APSerr_neg FCspn_APSerr_neg FPfl_APSerr_neg FPfu_APSerr_neg FPnd_APSerr_neg FPsvr_APSerr_neg FPsw_ext1_APSerr_neg FPsw_APSerr_neg /end REF_CHARACTERISTIC
/end GROUP
/begin GROUP APSerr_pos_EC_Fault "Unable to reach higher APS"
 /begin REF_CHARACTERISTIC FCdc4_APSerr_pos FCdtc_APSerr_pos FCfmi_APSerr_pos FCftb_APSerr_pos FCspn_APSerr_pos FPfl_APSerr_pos FPfu_APSerr_pos FPnd_APSerr_pos FPsvr_APSerr_pos FPsw_ext1_APSerr_pos FPsw_APSerr_pos /end REF_CHARACTERISTIC
/end GROUP
/begin GROUP APU1_max_EC_Fault "AUX analog Pull-Up 1 high voltage"
 /begin REF_CHARACTERISTIC FCdc4_APU1_max FCdtc_APU1_max FCfmi_APU1_max FCftb_APU1_max FCspn_APU1_max FPfl_APU1_max FPfu_APU1_max FPnd_APU1_max FPsvr_APU1_max FPsw_ext1_APU1_max FPsw_APU1_max /end REF_CHARACTERISTIC
/end GROUP
/begin GROUP APU1_min_EC_Fault "AUX analog Pull-Up 1 low voltage"
 /begin REF_CHARACTERISTIC FCdc4_APU1_min FCdtc_APU1_min FCfmi_APU1_min FCftb_APU1_min FCspn_APU1_min FPfl_APU1_min FPfu_APU1_min FPnd_APU1_min FPsvr_APU1_min FPsw_ext1_APU1_min FPsw_APU1_min /end REF_CHARACTERISTIC
/end GROUP
/begin GROUP APU2_max_EC_Fault "AUX analog Pull-Up 2 high voltage"
 /begin REF_CHARACTERISTIC FCdc4_APU2_max FCdtc_APU2_max FCfmi_APU2_max FCftb_APU2_max FCspn_APU2_max FPfl_APU2_max FPfu_APU2_max FPnd_APU2_max FPsvr_APU2_max FPsw_ext1_APU2_max FPsw_APU2_max /end REF_CHARACTERISTIC
/end GROUP
/begin GROUP APU2_min_EC_Fault "AUX analog Pull-Up 2 low voltage"
 /begin REF_CHARACTERISTIC FCdc4_APU2_min FCdtc_APU2_min FCfmi_APU2_min FCftb_APU2_min FCspn_APU2_min FPfl_APU2_min FPfu_APU2_min FPnd_APU2_min FPsvr_APU2_min FPsw_ext1_APU2_min FPsw_APU2_min /end REF_CHARACTERISTIC
/end GROUP
/begin GROUP APU3_max_EC_Fault "AUX analog Pull-Up 3 high voltage"
 /begin REF_CHARACTERISTIC FCdc4_APU3_max FCdtc_APU3_max FCfmi_APU3_max FCftb_APU3_max FCspn_APU3_max FPfl_APU3_max FPfu_APU3_max FPnd_APU3_max FPsvr_APU3_max FPsw_ext1_APU3_max FPsw_APU3_max /end REF_CHARACTERISTIC
/end GROUP
/begin GROUP APU3_min_EC_Fault "AUX analog Pull-Up 3 low voltage"
 /begin REF_CHARACTERISTIC FCdc4_APU3_min FCdtc_APU3_min FCfmi_APU3_min FCftb_APU3_min FCspn_APU3_min FPfl_APU3_min FPfu_APU3_min FPnd_APU3_min FPsvr_APU3_min FPsw_ext1_APU3_min FPsw_APU3_min /end REF_CHARACTERISTIC
/end GROUP
/begin GROUP APUD1_max_EC_Fault "AUX analog Pull-Up/Down 1 high voltage"
 /begin REF_CHARACTERISTIC FCdc4_APUD1_max FCdtc_APUD1_max FCfmi_APUD1_max FCftb_APUD1_max FCspn_APUD1_max FPfl_APUD1_max FPfu_APUD1_max FPnd_APUD1_max FPsvr_APUD1_max FPsw_ext1_APUD1_max FPsw_APUD1_max /end REF_CHARACTERISTIC
/end GROUP
/begin GROUP APUD1_min_EC_Fault "AUX analog Pull-Up/Down 1 low voltage"
 /begin REF_CHARACTERISTIC FCdc4_APUD1_min FCdtc_APUD1_min FCfmi_APUD1_min FCftb_APUD1_min FCspn_APUD1_min FPfl_APUD1_min FPfu_APUD1_min FPnd_APUD1_min FPsvr_APUD1_min FPsw_ext1_APUD1_min FPsw_APUD1_min /end REF_CHARACTERISTIC
/end GROUP
/begin GROUP APUD10_max_EC_Fault "AUX analog Pull-Up/Down 10 high voltage"
 /begin REF_CHARACTERISTIC FCdc4_APUD10_max FCdtc_APUD10_max FCfmi_APUD10_max FCftb_APUD10_max FCspn_APUD10_max FPfl_APUD10_max FPfu_APUD10_max FPnd_APUD10_max FPsvr_APUD10_max FPsw_ext1_APUD10_max FPsw_APUD10_max /end REF_CHARACTERISTIC
/end GROUP
/begin GROUP APUD10_min_EC_Fault "AUX analog Pull-Up/Down 10 low voltage"
 /begin REF_CHARACTERISTIC FCdc4_APUD10_min FCdtc_APUD10_min FCfmi_APUD10_min FCftb_APUD10_min FCspn_APUD10_min FPfl_APUD10_min FPfu_APUD10_min FPnd_APUD10_min FPsvr_APUD10_min FPsw_ext1_APUD10_min FPsw_APUD10_min /end REF_CHARACTERISTIC
/end GROUP
/begin GROUP APUD11_max_EC_Fault "AUX analog Pull-Up/Down 11 high voltage"
 /begin REF_CHARACTERISTIC FCdc4_APUD11_max FCdtc_APUD11_max FCfmi_APUD11_max FCftb_APUD11_max FCspn_APUD11_max FPfl_APUD11_max FPfu_APUD11_max FPnd_APUD11_max FPsvr_APUD11_max FPsw_ext1_APUD11_max FPsw_APUD11_max /end REF_CHARACTERISTIC
/end GROUP
/begin GROUP APUD11_min_EC_Fault "AUX analog Pull-Up/Down 11 low voltage"
 /begin REF_CHARACTERISTIC FCdc4_APUD11_min FCdtc_APUD11_min FCfmi_APUD11_min FCftb_APUD11_min FCspn_APUD11_min FPfl_APUD11_min FPfu_APUD11_min FPnd_APUD11_min FPsvr_APUD11_min FPsw_ext1_APUD11_min FPsw_APUD11_min /end REF_CHARACTERISTIC
/end GROUP
/begin GROUP APUD12_max_EC_Fault "AUX analog Pull-Up/Down 12 high voltage"
 /begin REF_CHARACTERISTIC FCdc4_APUD12_max FCdtc_APUD12_max FCfmi_APUD12_max FCftb_APUD12_max FCspn_APUD12_max FPfl_APUD12_max FPfu_APUD12_max FPnd_APUD12_max FPsvr_APUD12_max FPsw_ext1_APUD12_max FPsw_APUD12_max /end REF_CHARACTERISTIC
/end GROUP
/begin GROUP APUD12_min_EC_Fault "AUX analog Pull-Up/Down 12 low voltage"
 /begin REF_CHARACTERISTIC FCdc4_APUD12_min FCdtc_APUD12_min FCfmi_APUD12_min FCftb_APUD12_min FCspn_APUD12_min FPfl_APUD12_min FPfu_APUD12_min FPnd_APUD12_min FPsvr_APUD12_min FPsw_ext1_APUD12_min FPsw_APUD12_min /end REF_CHARACTERISTIC
/end GROUP
/begin GROUP APUD13_max_EC_Fault "AUX analog Pull-Up/Down 13 high voltage"
 /begin REF_CHARACTERISTIC FCdc4_APUD13_max FCdtc_APUD13_max FCfmi_APUD13_max FCftb_APUD13_max FCspn_APUD13_max FPfl_APUD13_max FPfu_APUD13_max FPnd_APUD13_max FPsvr_APUD13_max FPsw_ext1_APUD13_max FPsw_APUD13_max /end REF_CHARACTERISTIC
/end GROUP
/begin GROUP APUD13_min_EC_Fault "AUX analog Pull-Up/Down 13 low voltage"
 /begin REF_CHARACTERISTIC FCdc4_APUD13_min FCdtc_APUD13_min FCfmi_APUD13_min FCftb_APUD13_min FCspn_APUD13_min FPfl_APUD13_min FPfu_APUD13_min FPnd_APUD13_min FPsvr_APUD13_min FPsw_ext1_APUD13_min FPsw_APUD13_min /end REF_CHARACTERISTIC
/end GROUP
/begin GROUP APUD14_max_EC_Fault "AUX analog Pull-Up/Down 14 high voltage"
 /begin REF_CHARACTERISTIC FCdc4_APUD14_max FCdtc_APUD14_max FCfmi_APUD14_max FCftb_APUD14_max FCspn_APUD14_max FPfl_APUD14_max FPfu_APUD14_max FPnd_APUD14_max FPsvr_APUD14_max FPsw_ext1_APUD14_max FPsw_APUD14_max /end REF_CHARACTERISTIC
/end GROUP
/begin GROUP APUD14_min_EC_Fault "AUX analog Pull-Up/Down 14 low voltage"
 /begin REF_CHARACTERISTIC FCdc4_APUD14_min FCdtc_APUD14_min FCfmi_APUD14_min FCftb_APUD14_min FCspn_APUD14_min FPfl_APUD14_min FPfu_APUD14_min FPnd_APUD14_min FPsvr_APUD14_min FPsw_ext1_APUD14_min FPsw_APUD14_min /end REF_CHARACTERISTIC
/end GROUP
/begin GROUP APUD15_max_EC_Fault "AUX analog Pull-Up/Down 15 high voltage"
 /begin REF_CHARACTERISTIC FCdc4_APUD15_max FCdtc_APUD15_max FCfmi_APUD15_max FCftb_APUD15_max FCspn_APUD15_max FPfl_APUD15_max FPfu_APUD15_max FPnd_APUD15_max FPsvr_APUD15_max FPsw_ext1_APUD15_max FPsw_APUD15_max /end REF_CHARACTERISTIC
/end GROUP
/begin GROUP APUD15_min_EC_Fault "AUX analog Pull-Up/Down 15 low voltage"
 /begin REF_CHARACTERISTIC FCdc4_APUD15_min FCdtc_APUD15_min FCfmi_APUD15_min FCftb_APUD15_min FCspn_APUD15_min FPfl_APUD15_min FPfu_APUD15_min FPnd_APUD15_min FPsvr_APUD15_min FPsw_ext1_APUD15_min FPsw_APUD15_min /end REF_CHARACTERISTIC
/end GROUP
/begin GROUP APUD16_max_EC_Fault "AUX analog Pull-Up/Down 16 high voltage"
 /begin REF_CHARACTERISTIC FCdc4_APUD16_max FCdtc_APUD16_max FCfmi_APUD16_max FCftb_APUD16_max FCspn_APUD16_max FPfl_APUD16_max FPfu_APUD16_max FPnd_APUD16_max FPsvr_APUD16_max FPsw_ext1_APUD16_max FPsw_APUD16_max /end REF_CHARACTERISTIC
/end GROUP
/begin GROUP APUD16_min_EC_Fault "AUX analog Pull-Up/Down 16 low voltage"
 /begin REF_CHARACTERISTIC FCdc4_APUD16_min FCdtc_APUD16_min FCfmi_APUD16_min FCftb_APUD16_min FCspn_APUD16_min FPfl_APUD16_min FPfu_APUD16_min FPnd_APUD16_min FPsvr_APUD16_min FPsw_ext1_APUD16_min FPsw_APUD16_min /end REF_CHARACTERISTIC
/end GROUP
/begin GROUP APUD17_max_EC_Fault "AUX analog Pull-Up/Down 17 high voltage"
 /begin REF_CHARACTERISTIC FCdc4_APUD17_max FCdtc_APUD17_max FCfmi_APUD17_max FCftb_APUD17_max FCspn_APUD17_max FPfl_APUD17_max FPfu_APUD17_max FPnd_APUD17_max FPsvr_APUD17_max FPsw_ext1_APUD17_max FPsw_APUD17_max /end REF_CHARACTERISTIC
/end GROUP
/begin GROUP APUD17_min_EC_Fault "AUX analog Pull-Up/Down 17 low voltage"
 /begin REF_CHARACTERISTIC FCdc4_APUD17_min FCdtc_APUD17_min FCfmi_APUD17_min FCftb_APUD17_min FCspn_APUD17_min FPfl_APUD17_min FPfu_APUD17_min FPnd_APUD17_min FPsvr_APUD17_min FPsw_ext1_APUD17_min FPsw_APUD17_min /end REF_CHARACTERISTIC
/end GROUP
/begin GROUP APUD18_max_EC_Fault "AUX analog Pull-Up/Down 18 high voltage"
 /begin REF_CHARACTERISTIC FCdc4_APUD18_max FCdtc_APUD18_max FCfmi_APUD18_max FCftb_APUD18_max FCspn_APUD18_max FPfl_APUD18_max FPfu_APUD18_max FPnd_APUD18_max FPsvr_APUD18_max FPsw_ext1_APUD18_max FPsw_APUD18_max /end REF_CHARACTERISTIC
/end GROUP
/begin GROUP APUD18_min_EC_Fault "AUX analog Pull-Up/Down 18 low voltage"
 /begin REF_CHARACTERISTIC FCdc4_APUD18_min FCdtc_APUD18_min FCfmi_APUD18_min FCftb_APUD18_min FCspn_APUD18_min FPfl_APUD18_min FPfu_APUD18_min FPnd_APUD18_min FPsvr_APUD18_min FPsw_ext1_APUD18_min FPsw_APUD18_min /end REF_CHARACTERISTIC
/end GROUP
/begin GROUP APUD19_max_EC_Fault "AUX analog Pull-Up/Down 19 high voltage"
 /begin REF_CHARACTERISTIC FCdc4_APUD19_max FCdtc_APUD19_max FCfmi_APUD19_max FCftb_APUD19_max FCspn_APUD19_max FPfl_APUD19_max FPfu_APUD19_max FPnd_APUD19_max FPsvr_APUD19_max FPsw_ext1_APUD19_max FPsw_APUD19_max /end REF_CHARACTERISTIC
/end GROUP
/begin GROUP APUD19_min_EC_Fault "AUX analog Pull-Up/Down 19 low voltage"
 /begin REF_CHARACTERISTIC FCdc4_APUD19_min FCdtc_APUD19_min FCfmi_APUD19_min FCftb_APUD19_min FCspn_APUD19_min FPfl_APUD19_min FPfu_APUD19_min FPnd_APUD19_min FPsvr_APUD19_min FPsw_ext1_APUD19_min FPsw_APUD19_min /end REF_CHARACTERISTIC
/end GROUP
/end MODULE
/end PROJECT
