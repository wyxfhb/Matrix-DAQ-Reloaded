ASAP2_VERSION 1 61
/begin PROJECT Econtrols_4G "4G Test"
/begin HEADER "4G A2L Configuration" PROJECT_NO EControls4G /* config for version control */ VERSION "$Revision: 82130 $:" /* config for version control */ /end HEADER
/begin MODULE EControls_4G_SH2A "EControls 4G"
/begin MOD_COMMON "" DEPOSIT ABSOLUTE BYTE_ORDER MSB_FIRST /end MOD_COMMON
/* Define the Record Layouts */
/begin RECORD_LAYOUT ECIPP_ALIGNMENT_UBYTE FNC_VALUES 1 UBYTE COLUMN_DIR DIRECT /end RECORD_LAYOUT
/begin RECORD_LAYOUT ECIPP_ALIGNMENT_UWORD FNC_VALUES 1 UWORD COLUMN_DIR DIRECT /end RECORD_LAYOUT
/begin RECORD_LAYOUT ECIPP_ALIGNMENT_SWORD FNC_VALUES 1 SWORD COLUMN_DIR DIRECT /end RECORD_LAYOUT
/begin RECORD_LAYOUT ECIPP_ALIGNMENT_ULONG FNC_VALUES 1 ULONG COLUMN_DIR DIRECT /end RECORD_LAYOUT
/begin RECORD_LAYOUT ECIPP_Lookup_ULONG AXIS_PTS_X 1 ULONG INDEX_INCR DIRECT /end RECORD_LAYOUT
/begin RECORD_LAYOUT ECIPP_ALIGNMENT_FLOAT32_IEEE FNC_VALUES 1 FLOAT32_IEEE COLUMN_DIR DIRECT /end RECORD_LAYOUT
/* Define generic COMPU_METHODS used in the A2L */ /* NOTE: most of the parameters from ECIPP use unique/specific COMPU_METHODS */
/begin COMPU_METHOD Compu_ECIPP_STRINGS "ECIPP Strings " /* Identifier */ RAT_FUNC "%.0" /* Format */ "ASCII" /* Units */ COEFFS 0 1 0 0 0 1 /end COMPU_METHOD
/begin COMPU_METHOD Compu_IDENTITY "Discrete Values " /* Identifier */ IDENTICAL "%.0" /* Format */ "-" /* Units */ /end COMPU_METHOD
/begin CHARACTERISTIC STR_LPCarb_cmnt "General # STR_LPCarb_cmnt" ASCII 0x001E7220 /* @ECU_Address@STR_LPCarb_cmnt@0x02241000@ */ ECIPP_ALIGNMENT_UBYTE 255 Compu_ECIPP_STRINGS 0 255 MATRIX_DIM 59 1 1 /end CHARACTERISTIC
/begin CHARACTERISTIC STR_LPtrim_cmnt "General # STR_LPtrim_cmnt" ASCII 0x001E7324 /* @ECU_Address@STR_LPtrim_cmnt@0x02242000@ */ ECIPP_ALIGNMENT_UBYTE 255 Compu_ECIPP_STRINGS 0 255 MATRIX_DIM 59 1 1 /end CHARACTERISTIC
/begin CHARACTERISTIC STR_Model_Year "General # STR_Model_Year" ASCII 0x001E7360 /* @ECU_Address@STR_Model_Year@0x02243000@ */ ECIPP_ALIGNMENT_UBYTE 255 Compu_ECIPP_STRINGS 0 255 MATRIX_DIM 159 1 1 /end CHARACTERISTIC
/begin CHARACTERISTIC STR_NGCarb_cmnt "General # STR_NGCarb_cmnt" ASCII 0x001E7400 /* @ECU_Address@STR_NGCarb_cmnt@0x02244000@ */ ECIPP_ALIGNMENT_UBYTE 255 Compu_ECIPP_STRINGS 0 255 MATRIX_DIM 59 1 1 /end CHARACTERISTIC
/begin CHARACTERISTIC STR_NGtrim_cmnt "General # STR_NGtrim_cmnt" ASCII 0x001E7504 /* @ECU_Address@STR_NGtrim_cmnt@0x02245000@ */ ECIPP_ALIGNMENT_UBYTE 255 Compu_ECIPP_STRINGS 0 255 MATRIX_DIM 59 1 1 /end CHARACTERISTIC
/begin CHARACTERISTIC STR_OilPgd_comment "General # STR_OilPgd_comment" ASCII 0x001E7740 /* @ECU_Address@STR_OilPgd_comment@0x02246000@ */ ECIPP_ALIGNMENT_UBYTE 255 Compu_ECIPP_STRINGS 0 255 MATRIX_DIM 39 1 1 /end CHARACTERISTIC
/begin CHARACTERISTIC STR_PhiCmt "General # STR_PhiCmt" ASCII 0x001E7768 /* @ECU_Address@STR_PhiCmt@0x02247000@ */ ECIPP_ALIGNMENT_UBYTE 255 Compu_ECIPP_STRINGS 0 255 MATRIX_DIM 99 1 1 /end CHARACTERISTIC
/begin CHARACTERISTIC STR_PhiCmtNG "General # STR_PhiCmtNG" ASCII 0x001E77CC /* @ECU_Address@STR_PhiCmtNG@0x02248000@ */ ECIPP_ALIGNMENT_UBYTE 255 Compu_ECIPP_STRINGS 0 255 MATRIX_DIM 99 1 1 /end CHARACTERISTIC
/begin CHARACTERISTIC STR_PhiCmtP "General # STR_PhiCmtP" ASCII 0x001E7830 /* @ECU_Address@STR_PhiCmtP@0x02249000@ */ ECIPP_ALIGNMENT_UBYTE 255 Compu_ECIPP_STRINGS 0 255 MATRIX_DIM 99 1 1 /end CHARACTERISTIC
/begin CHARACTERISTIC STR_PhicoldCmt "General # STR_PhicoldCmt" ASCII 0x001E7894 /* @ECU_Address@STR_PhicoldCmt@0x0224A000@ */ ECIPP_ALIGNMENT_UBYTE 255 Compu_ECIPP_STRINGS 0 255 MATRIX_DIM 99 1 1 /end CHARACTERISTIC
/begin CHARACTERISTIC STR_PhicoldCmtN "General # STR_PhicoldCmtN" ASCII 0x001E78F8 /* @ECU_Address@STR_PhicoldCmtN@0x0224B000@ */ ECIPP_ALIGNMENT_UBYTE 255 Compu_ECIPP_STRINGS 0 255 MATRIX_DIM 99 1 1 /end CHARACTERISTIC
/begin CHARACTERISTIC STR_PhicoldCmtP "General # STR_PhicoldCmtP" ASCII 0x001E795C /* @ECU_Address@STR_PhicoldCmtP@0x0224C000@ */ ECIPP_ALIGNMENT_UBYTE 255 Compu_ECIPP_STRINGS 0 255 MATRIX_DIM 99 1 1 /end CHARACTERISTIC
/begin CHARACTERISTIC STR_PhitranCmt "General # STR_PhitranCmt" ASCII 0x001E79C0 /* @ECU_Address@STR_PhitranCmt@0x0224D000@ */ ECIPP_ALIGNMENT_UBYTE 255 Compu_ECIPP_STRINGS 0 255 MATRIX_DIM 99 1 1 /end CHARACTERISTIC
/begin CHARACTERISTIC STR_PhitranCmtN "General # STR_PhitranCmtN" ASCII 0x001E7A24 /* @ECU_Address@STR_PhitranCmtN@0x0224E000@ */ ECIPP_ALIGNMENT_UBYTE 255 Compu_ECIPP_STRINGS 0 255 MATRIX_DIM 99 1 1 /end CHARACTERISTIC
/begin CHARACTERISTIC STR_PhitranCmtP "General # STR_PhitranCmtP" ASCII 0x001E7A88 /* @ECU_Address@STR_PhitranCmtP@0x0224F000@ */ ECIPP_ALIGNMENT_UBYTE 255 Compu_ECIPP_STRINGS 0 255 MATRIX_DIM 99 1 1 /end CHARACTERISTIC
/begin CHARACTERISTIC STR_LP_postcat_phi "General # STR_LP_postcat_phi" ASCII 0x001E72C0 /* @ECU_Address@STR_LP_postcat_phi@0x02250000@ */ ECIPP_ALIGNMENT_UBYTE 255 Compu_ECIPP_STRINGS 0 255 MATRIX_DIM 99 1 1 /end CHARACTERISTIC
/begin CHARACTERISTIC STR_NG_postcat_phi "General # STR_NG_postcat_phi" ASCII 0x001E74A0 /* @ECU_Address@STR_NG_postcat_phi@0x02251000@ */ ECIPP_ALIGNMENT_UBYTE 255 Compu_ECIPP_STRINGS 0 255 MATRIX_DIM 99 1 1 /end CHARACTERISTIC
/begin CHARACTERISTIC STR_postcat_phi "General # STR_postcat_phi" ASCII 0x001E9B7C /* @ECU_Address@STR_postcat_phi@0x02252000@ */ ECIPP_ALIGNMENT_UBYTE 255 Compu_ECIPP_STRINGS 0 255 MATRIX_DIM 99 1 1 /end CHARACTERISTIC
/begin CHARACTERISTIC STR_Update_Comment "General # STR_Update_Comment" ASCII 0x001E970C /* @ECU_Address@STR_Update_Comment@0x02253000@ */ ECIPP_ALIGNMENT_UBYTE 255 Compu_ECIPP_STRINGS 0 255 MATRIX_DIM 259 1 1 /end CHARACTERISTIC
/begin CHARACTERISTIC STR_V1gd_comment "General # STR_V1gd_comment" ASCII 0x001E9810 /* @ECU_Address@STR_V1gd_comment@0x02254000@ */ ECIPP_ALIGNMENT_UBYTE 255 Compu_ECIPP_STRINGS 0 255 MATRIX_DIM 39 1 1 /end CHARACTERISTIC
/begin CHARACTERISTIC STR_VECmt "General # STR_VECmt" ASCII 0x001E9838 /* @ECU_Address@STR_VECmt@0x02255000@ */ ECIPP_ALIGNMENT_UBYTE 255 Compu_ECIPP_STRINGS 0 255 MATRIX_DIM 159 1 1 /end CHARACTERISTIC
/begin CHARACTERISTIC STR_Vehicle "General # STR_Vehicle" ASCII 0x001E98D8 /* @ECU_Address@STR_Vehicle@0x02256000@ */ ECIPP_ALIGNMENT_UBYTE 255 Compu_ECIPP_STRINGS 0 255 MATRIX_DIM 199 1 1 /end CHARACTERISTIC
/begin CHARACTERISTIC STR_fuelinj_desc "General # STR_fuelinj_desc" ASCII 0x001E9A78 /* @ECU_Address@STR_fuelinj_desc@0x02257000@ */ ECIPP_ALIGNMENT_UBYTE 255 Compu_ECIPP_STRINGS 0 255 MATRIX_DIM 99 1 1 /end CHARACTERISTIC
/begin CHARACTERISTIC TOCTadpt_init "Spark # TOCTadpt_init" VAL_BLK 0x001C39A2 /* @ECU_Address@TOCTadpt_init@0x0225B000@ */ ECIPP_ALIGNMENT_SWORD 100 Compu_TOCTadpt_init -100 99.9969482421875 MATRIX_DIM 20 1 1 /end CHARACTERISTIC
/begin COMPU_METHOD Compu_TOCTadpt_init "" RAT_FUNC "%.3" "-" COEFFS 0 327.68 0 0 0 1 /end COMPU_METHOD
/begin CHARACTERISTIC TCRI_rho_Prail "Fuel # TCRI_rho_Prail" VAL_BLK 0x001E301E /* @ECU_Address@TCRI_rho_Prail@0x02287000@ */ ECIPP_ALIGNMENT_SWORD 4096 Compu_TCRI_rho_Prail -4096 4095.875 MATRIX_DIM 8 1 1 /end CHARACTERISTIC
/begin COMPU_METHOD Compu_TCRI_rho_Prail " " RAT_FUNC "%.3" "-" COEFFS 0 8 0 0 0 1 /end COMPU_METHOD
/begin CHARACTERISTIC TCRI_rho_FRT "Fuel # TCRI_rho_FRT" VAL_BLK 0x001E3016 /* @ECU_Address@TCRI_rho_FRT@0x02288000@ */ ECIPP_ALIGNMENT_SWORD 564 Compu_TCRI_rho_FRT -1484 563.96875 MATRIX_DIM 4 1 1 /end CHARACTERISTIC
/begin COMPU_METHOD Compu_TCRI_rho_FRT " " RAT_FUNC "%.3" "Fuel Rail Temperature (deg F)" COEFFS 0 32 14720 0 0 1 /end COMPU_METHOD
/begin CHARACTERISTIC TPW_VC_volts_I2 "Fuel # TPW_VC_volts_I2" VAL_BLK 0x001E32EE /* @ECU_Address@TPW_VC_volts_I2@0x022A0000@ */ ECIPP_ALIGNMENT_SWORD 128 Compu_TPW_VC_volts_I2 -128 127.99609375 MATRIX_DIM 16 1 1 /end CHARACTERISTIC
/begin COMPU_METHOD Compu_TPW_VC_volts_I2 " " RAT_FUNC "%.3" "(volts)" COEFFS 0 256 0 0 0 1 /end COMPU_METHOD
/begin CHARACTERISTIC TPW_VC_time_I2 "Fuel # TPW_VC_time_I2" VAL_BLK 0x001E32AE /* @ECU_Address@TPW_VC_time_I2@0x022A1000@ */ ECIPP_ALIGNMENT_SWORD 105 Compu_TPW_VC_time_I2 -104.8576 104.8544 MATRIX_DIM 16 1 1 /end CHARACTERISTIC
/begin COMPU_METHOD Compu_TPW_VC_time_I2 " " RAT_FUNC "%.3" "(ms)" COEFFS 0 312.5 0 0 0 1 /end COMPU_METHOD
/begin CHARACTERISTIC PW_mg_data_I2 "General # PW_mg_data_I2" VAL_BLK 0x001E2F96 /* @ECU_Address@PW_mg_data_I2@0x022A2000@ */ ECIPP_ALIGNMENT_SWORD 512 Compu_PW_mg_data_I2 -512 511.984375 MATRIX_DIM 16 1 1 /end CHARACTERISTIC
/begin COMPU_METHOD Compu_PW_mg_data_I2 " " RAT_FUNC "%.3" "(mg/inj)" COEFFS 0 64 0 0 0 1 /end COMPU_METHOD
/begin CHARACTERISTIC PW_ms_data_I2 "General # PW_ms_data_I2" VAL_BLK 0x001E2FD6 /* @ECU_Address@PW_ms_data_I2@0x022A3000@ */ ECIPP_ALIGNMENT_SWORD 105 Compu_PW_ms_data_I2 -104.8576 104.8544 MATRIX_DIM 16 1 1 /end CHARACTERISTIC
/begin COMPU_METHOD Compu_PW_ms_data_I2 " " RAT_FUNC "%.3" "(ms)" COEFFS 0 312.5 0 0 0 1 /end COMPU_METHOD
/begin CHARACTERISTIC FPcal_P_I2 "IOConfig # FPcal_P_I2" VAL_BLK 0x001C44EC /* @ECU_Address@FPcal_P_I2@0x022A7000@ */ ECIPP_ALIGNMENT_SWORD 256 Compu_FPcal_P_I2 -256 255.9921875 MATRIX_DIM 2 1 1 /end CHARACTERISTIC
/begin COMPU_METHOD Compu_FPcal_P_I2 " " RAT_FUNC "%.3" "-" COEFFS 0 128 0 0 0 1 /end COMPU_METHOD
/begin CHARACTERISTIC CAD_TDC_cyl_shift "IOConfig # CAD_TDC_cyl_shift" VAL_BLK 0x001C442A /* @ECU_Address@CAD_TDC_cyl_shift@0x022A8000@ */ ECIPP_ALIGNMENT_SWORD 2048 Compu_CAD_TDC_cyl_shift -2048 2047.9375 MATRIX_DIM 12 1 1 /end CHARACTERISTIC
/begin COMPU_METHOD Compu_CAD_TDC_cyl_shift " " RAT_FUNC "%.3" "(CAD ATDC nominal)" COEFFS 0 16 0 0 0 1 /end COMPU_METHOD
/begin CHARACTERISTIC STR_engine_defVIN "General # STR_engine_defVIN" ASCII 0x001E9A64 /* @ECU_Address@STR_engine_defVIN@0x022AA000@ */ ECIPP_ALIGNMENT_UBYTE 255 Compu_ECIPP_STRINGS 0 255 MATRIX_DIM 19 1 1 /end CHARACTERISTIC
/begin CHARACTERISTIC TTAUXA_TAUXA "General # TTAUXA_TAUXA" VAL_BLK 0x001C3C94 /* @ECU_Address@TTAUXA_TAUXA@0x022BA000@ */ ECIPP_ALIGNMENT_FLOAT32_IEEE 10000000000 Compu_TTAUXA_TAUXA -10000000000 10000000000 MATRIX_DIM 16 1 1 /end CHARACTERISTIC
/begin COMPU_METHOD Compu_TTAUXA_TAUXA " " RAT_FUNC "%.3" "Temp (deg F)" COEFFS 0 1 460 0 0 1 /end COMPU_METHOD
/begin CHARACTERISTIC TTAUXB_TAUXB "General # TTAUXB_TAUXB" VAL_BLK 0x001E1B88 /* @ECU_Address@TTAUXB_TAUXB@0x022BB000@ */ ECIPP_ALIGNMENT_FLOAT32_IEEE 10000000000 Compu_TTAUXB_TAUXB -10000000000 10000000000 MATRIX_DIM 16 1 1 /end CHARACTERISTIC
/begin COMPU_METHOD Compu_TTAUXB_TAUXB " " RAT_FUNC "%.3" "Temp (deg F)" COEFFS 0 1 460 0 0 1 /end COMPU_METHOD
/begin CHARACTERISTIC TTAUXC_TAUXC "General # TTAUXC_TAUXC" VAL_BLK 0x001E1C08 /* @ECU_Address@TTAUXC_TAUXC@0x022BC000@ */ ECIPP_ALIGNMENT_FLOAT32_IEEE 10000000000 Compu_TTAUXC_TAUXC -10000000000 10000000000 MATRIX_DIM 16 1 1 /end CHARACTERISTIC
/begin COMPU_METHOD Compu_TTAUXC_TAUXC " " RAT_FUNC "%.3" "Temp (deg F)" COEFFS 0 1 460 0 0 1 /end COMPU_METHOD
/begin CHARACTERISTIC TTAUXD_TAUXD "General # TTAUXD_TAUXD" VAL_BLK 0x001E1C88 /* @ECU_Address@TTAUXD_TAUXD@0x022BD000@ */ ECIPP_ALIGNMENT_FLOAT32_IEEE 10000000000 Compu_TTAUXD_TAUXD -10000000000 10000000000 MATRIX_DIM 16 1 1 /end CHARACTERISTIC
/begin COMPU_METHOD Compu_TTAUXD_TAUXD " " RAT_FUNC "%.3" "Temp (deg F)" COEFFS 0 1 460 0 0 1 /end COMPU_METHOD
/begin CHARACTERISTIC TTAUXA_ohms "IOConfig # TTAUXA_ohms" VAL_BLK 0x001C3CD4 /* @ECU_Address@TTAUXA_ohms@0x022BE000@ */ ECIPP_ALIGNMENT_FLOAT32_IEEE 10000000000 Compu_TTAUXA_ohms -10000000000 10000000000 MATRIX_DIM 16 1 1 /end CHARACTERISTIC
/begin COMPU_METHOD Compu_TTAUXA_ohms " " RAT_FUNC "%.3" "Ohms" COEFFS 0 1 0 0 0 1 /end COMPU_METHOD
/begin CHARACTERISTIC TTAUXB_ohms "IOConfig # TTAUXB_ohms" VAL_BLK 0x001E1BC8 /* @ECU_Address@TTAUXB_ohms@0x022BF000@ */ ECIPP_ALIGNMENT_FLOAT32_IEEE 10000000000 Compu_TTAUXB_ohms -10000000000 10000000000 MATRIX_DIM 16 1 1 /end CHARACTERISTIC
/begin COMPU_METHOD Compu_TTAUXB_ohms " " RAT_FUNC "%.3" "Ohms" COEFFS 0 1 0 0 0 1 /end COMPU_METHOD
/begin CHARACTERISTIC TTAUXC_ohms "IOConfig # TTAUXC_ohms" VAL_BLK 0x001E1C48 /* @ECU_Address@TTAUXC_ohms@0x022C0000@ */ ECIPP_ALIGNMENT_FLOAT32_IEEE 10000000000 Compu_TTAUXC_ohms -10000000000 10000000000 MATRIX_DIM 16 1 1 /end CHARACTERISTIC
/begin COMPU_METHOD Compu_TTAUXC_ohms " " RAT_FUNC "%.3" "Ohms" COEFFS 0 1 0 0 0 1 /end COMPU_METHOD
/begin CHARACTERISTIC TTAUXD_ohms "IOConfig # TTAUXD_ohms" VAL_BLK 0x001E1CC8 /* @ECU_Address@TTAUXD_ohms@0x022C1000@ */ ECIPP_ALIGNMENT_FLOAT32_IEEE 10000000000 Compu_TTAUXD_ohms -10000000000 10000000000 MATRIX_DIM 16 1 1 /end CHARACTERISTIC
/begin COMPU_METHOD Compu_TTAUXD_ohms " " RAT_FUNC "%.3" "Ohms" COEFFS 0 1 0 0 0 1 /end COMPU_METHOD
/begin CHARACTERISTIC PauxAcal_V "IOConfig # PauxAcal_V" VAL_BLK 0x001C3AF8 /* @ECU_Address@PauxAcal_V@0x022C2000@ */ ECIPP_ALIGNMENT_FLOAT32_IEEE 10000000000 Compu_PauxAcal_V -10000000000 10000000000 MATRIX_DIM 2 1 1 /end CHARACTERISTIC
/begin COMPU_METHOD Compu_PauxAcal_V " " RAT_FUNC "%.3" "(volts)" COEFFS 0 1 0 0 0 1 /end COMPU_METHOD
/begin CHARACTERISTIC PauxBcal_V "IOConfig # PauxBcal_V" VAL_BLK 0x001C3B08 /* @ECU_Address@PauxBcal_V@0x022C3000@ */ ECIPP_ALIGNMENT_FLOAT32_IEEE 10000000000 Compu_PauxBcal_V -10000000000 10000000000 MATRIX_DIM 2 1 1 /end CHARACTERISTIC
/begin COMPU_METHOD Compu_PauxBcal_V " " RAT_FUNC "%.3" "(volts)" COEFFS 0 1 0 0 0 1 /end COMPU_METHOD
/begin CHARACTERISTIC PauxCcal_V "IOConfig # PauxCcal_V" VAL_BLK 0x001C3B18 /* @ECU_Address@PauxCcal_V@0x022C4000@ */ ECIPP_ALIGNMENT_FLOAT32_IEEE 10000000000 Compu_PauxCcal_V -10000000000 10000000000 MATRIX_DIM 2 1 1 /end CHARACTERISTIC
/begin COMPU_METHOD Compu_PauxCcal_V " " RAT_FUNC "%.3" "(volts)" COEFFS 0 1 0 0 0 1 /end COMPU_METHOD
/begin CHARACTERISTIC PauxDcal_V "IOConfig # PauxDcal_V" VAL_BLK 0x001C3B28 /* @ECU_Address@PauxDcal_V@0x022C5000@ */ ECIPP_ALIGNMENT_FLOAT32_IEEE 10000000000 Compu_PauxDcal_V -10000000000 10000000000 MATRIX_DIM 2 1 1 /end CHARACTERISTIC
/begin COMPU_METHOD Compu_PauxDcal_V " " RAT_FUNC "%.3" "(volts)" COEFFS 0 1 0 0 0 1 /end COMPU_METHOD
/begin CHARACTERISTIC PauxAcal_P "IOConfig # PauxAcal_P" VAL_BLK 0x001C3AF0 /* @ECU_Address@PauxAcal_P@0x022C6000@ */ ECIPP_ALIGNMENT_FLOAT32_IEEE 10000000000 Compu_PauxAcal_P -10000000000 10000000000 MATRIX_DIM 2 1 1 /end CHARACTERISTIC
/begin COMPU_METHOD Compu_PauxAcal_P " " RAT_FUNC "%.3" "-" COEFFS 0 1 0 0 0 1 /end COMPU_METHOD
/begin CHARACTERISTIC PauxBcal_P "IOConfig # PauxBcal_P" VAL_BLK 0x001C3B00 /* @ECU_Address@PauxBcal_P@0x022C7000@ */ ECIPP_ALIGNMENT_FLOAT32_IEEE 10000000000 Compu_PauxBcal_P -10000000000 10000000000 MATRIX_DIM 2 1 1 /end CHARACTERISTIC
/begin COMPU_METHOD Compu_PauxBcal_P " " RAT_FUNC "%.3" "-" COEFFS 0 1 0 0 0 1 /end COMPU_METHOD
/begin CHARACTERISTIC PauxCcal_P "IOConfig # PauxCcal_P" VAL_BLK 0x001C3B10 /* @ECU_Address@PauxCcal_P@0x022C8000@ */ ECIPP_ALIGNMENT_FLOAT32_IEEE 10000000000 Compu_PauxCcal_P -10000000000 10000000000 MATRIX_DIM 2 1 1 /end CHARACTERISTIC
/begin COMPU_METHOD Compu_PauxCcal_P " " RAT_FUNC "%.3" "-" COEFFS 0 1 0 0 0 1 /end COMPU_METHOD
/begin CHARACTERISTIC PauxDcal_P "IOConfig # PauxDcal_P" VAL_BLK 0x001C3B20 /* @ECU_Address@PauxDcal_P@0x022C9000@ */ ECIPP_ALIGNMENT_FLOAT32_IEEE 10000000000 Compu_PauxDcal_P -10000000000 10000000000 MATRIX_DIM 2 1 1 /end CHARACTERISTIC
/begin COMPU_METHOD Compu_PauxDcal_P " " RAT_FUNC "%.3" "-" COEFFS 0 1 0 0 0 1 /end COMPU_METHOD
/begin CHARACTERISTIC TMAF32_flow_Hz "Air # TMAF32_flow_Hz" VAL_BLK 0x001E1A88 /* @ECU_Address@TMAF32_flow_Hz@0x022D8000@ */ ECIPP_ALIGNMENT_FLOAT32_IEEE 10000000000 Compu_TMAF32_flow_Hz -10000000000 10000000000 MATRIX_DIM 32 1 1 /end CHARACTERISTIC
/begin COMPU_METHOD Compu_TMAF32_flow_Hz " " RAT_FUNC "%.3" "(Hz)" COEFFS 0 1 0 0 0 1 /end COMPU_METHOD
/begin CHARACTERISTIC TMAF32_flow_gsec "Air # TMAF32_flow_gsec" VAL_BLK 0x001E1B08 /* @ECU_Address@TMAF32_flow_gsec@0x022D9000@ */ ECIPP_ALIGNMENT_FLOAT32_IEEE 10000000000 Compu_TMAF32_flow_gsec -10000000000 10000000000 MATRIX_DIM 32 1 1 /end CHARACTERISTIC
/begin COMPU_METHOD Compu_TMAF32_flow_gsec " " RAT_FUNC "%.3" "(g/sec)" COEFFS 0 1 0 0 0 1 /end COMPU_METHOD
/begin MEASUREMENT TTMTPSad_Apct "Adaptive Throttle Model TPS Area" SWORD Compu_TTMTPSad_Apct 0 0 -100 99.9969482421875 ECU_ADDRESS 0x02311000 MATRIX_DIM 20 1 1 /end MEASUREMENT
/begin COMPU_METHOD Compu_TTMTPSad_Apct " " RAT_FUNC "%.1" "Area Adapt (%)" COEFFS 0 327.68 0 0 0 1 /end COMPU_METHOD
/begin CHARACTERISTIC TTMTPSad_TPS "Air # TTMTPSad_TPS" VAL_BLK 0x001C5BC2 /* @ECU_Address@TTMTPSad_TPS@0x02312000@ */ ECIPP_ALIGNMENT_SWORD 100 Compu_TTMTPSad_TPS -100 99.9969482421875 MATRIX_DIM 10 1 1 /end CHARACTERISTIC
/begin COMPU_METHOD Compu_TTMTPSad_TPS " " RAT_FUNC "%.1" "TPS (%)" COEFFS 0 327.68 0 0 0 1 /end COMPU_METHOD
/begin CHARACTERISTIC TTMTPSad_PR "Air # TTMTPSad_PR" VAL_BLK 0x001C5BBE /* @ECU_Address@TTMTPSad_PR@0x02313000@ */ ECIPP_ALIGNMENT_SWORD 1 Compu_TTMTPSad_PR -1 0.999969482421875 MATRIX_DIM 2 1 1 /end CHARACTERISTIC
/begin COMPU_METHOD Compu_TTMTPSad_PR " " RAT_FUNC "%.3" "PR (MAP/TIP)" COEFFS 0 32768 0 0 0 1 /end COMPU_METHOD
/begin CHARACTERISTIC UEGOHst_recvr_def "IOConfig # UEGOHst_recvr_def" VAL_BLK 0x001ECD80 /* @ECU_Address@UEGOHst_recvr_def@0x0232B000@ */ ECIPP_ALIGNMENT_SWORD 32767 Compu_UEGOHst_recvr_def -32768 32767 MATRIX_DIM 11 1 1 /end CHARACTERISTIC
/begin COMPU_METHOD Compu_UEGOHst_recvr_def " " RAT_FUNC "%.0" "(hours)" COEFFS 0 1 0 0 0 1 /end COMPU_METHOD
/begin CHARACTERISTIC UEGOHst_drift_def "IOConfig # UEGOHst_drift_def" VAL_BLK 0x001ECD96 /* @ECU_Address@UEGOHst_drift_def@0x0232C000@ */ ECIPP_ALIGNMENT_SWORD 100 Compu_UEGOHst_drift_def -100 99.9969482421875 MATRIX_DIM 11 1 1 /end CHARACTERISTIC
/begin COMPU_METHOD Compu_UEGOHst_drift_def " " RAT_FUNC "%.3" "Error (% Ip)" COEFFS 0 327.68 0 0 0 1 /end COMPU_METHOD
/begin MEASUREMENT UEGOHst_recvr_hours "IOConfig # UEGOHst_recvr_hours" SWORD Compu_UEGOHst_recvr_hours 0 0 -32768 32767 ECU_ADDRESS 0x0232D000 MATRIX_DIM 11 1 1 /end MEASUREMENT
/begin COMPU_METHOD Compu_UEGOHst_recvr_hours " " RAT_FUNC "%.0" "Hours since recovery" COEFFS 0 1 0 0 0 1 /end COMPU_METHOD
/begin MEASUREMENT UEGOHst_drift_pct "IOConfig # UEGOHst_drift_pct" SWORD Compu_UEGOHst_drift_pct 0 0 -100 99.9969482421875 ECU_ADDRESS 0x0232E000 MATRIX_DIM 11 1 1 /end MEASUREMENT
/begin COMPU_METHOD Compu_UEGOHst_drift_pct " " RAT_FUNC "%.1" "Ip Error (%)" COEFFS 0 327.68 0 0 0 1 /end COMPU_METHOD
/begin MEASUREMENT UEGO1Hst_recoveries "UEGO1 Recoveries" UWORD Compu_UEGO1Hst_recoveries 0 0 0 65535 ECU_ADDRESS 0x0232F000 MATRIX_DIM 11 1 1 /end MEASUREMENT
/begin COMPU_METHOD Compu_UEGO1Hst_recoveries " " RAT_FUNC "%.0" "Recovs" COEFFS 0 1 0 0 0 1 /end COMPU_METHOD
/begin MEASUREMENT UEGO1Hst_drift_pre "UEGO1 Pre-recoveries" UWORD Compu_UEGO1Hst_drift_pre 0 0 0 65535 ECU_ADDRESS 0x02330000 MATRIX_DIM 11 1 1 /end MEASUREMENT
/begin COMPU_METHOD Compu_UEGO1Hst_drift_pre " " RAT_FUNC "%.0" "Pre Recovs" COEFFS 0 1 0 0 0 1 /end COMPU_METHOD
/begin MEASUREMENT UEGO1Hst_drift_post "UEGO1 Post-recoveries" UWORD Compu_UEGO1Hst_drift_post 0 0 0 65535 ECU_ADDRESS 0x02331000 MATRIX_DIM 11 1 1 /end MEASUREMENT
/begin COMPU_METHOD Compu_UEGO1Hst_drift_post " " RAT_FUNC "%.0" "Post Recovs" COEFFS 0 1 0 0 0 1 /end COMPU_METHOD
/begin MEASUREMENT UEGO2Hst_recoveries "UEGO2 Recoveries" UWORD Compu_UEGO2Hst_recoveries 0 0 0 65535 ECU_ADDRESS 0x02332000 MATRIX_DIM 11 1 1 /end MEASUREMENT
/begin COMPU_METHOD Compu_UEGO2Hst_recoveries " " RAT_FUNC "%.0" "Recovs" COEFFS 0 1 0 0 0 1 /end COMPU_METHOD
/begin MEASUREMENT UEGO2Hst_drift_pre "UEGO2 Pre-recoveries" UWORD Compu_UEGO2Hst_drift_pre 0 0 0 65535 ECU_ADDRESS 0x02333000 MATRIX_DIM 11 1 1 /end MEASUREMENT
/begin COMPU_METHOD Compu_UEGO2Hst_drift_pre " " RAT_FUNC "%.0" "Pre Recovs" COEFFS 0 1 0 0 0 1 /end COMPU_METHOD
/begin MEASUREMENT UEGO2Hst_drift_post "UEGO2 Post-recoveries" UWORD Compu_UEGO2Hst_drift_post 0 0 0 65535 ECU_ADDRESS 0x02334000 MATRIX_DIM 11 1 1 /end MEASUREMENT
/begin COMPU_METHOD Compu_UEGO2Hst_drift_post " " RAT_FUNC "%.0" "Post Recovs" COEFFS 0 1 0 0 0 1 /end COMPU_METHOD
/begin CHARACTERISTIC TTC_comp_margin "Air # TTC_comp_margin" VAL_BLK 0x001E337E /* @ECU_Address@TTC_comp_margin@0x02342000@ */ ECIPP_ALIGNMENT_SWORD 200 Compu_TTC_comp_margin -200 199.993896484375 MATRIX_DIM 4 1 1 /end CHARACTERISTIC
/begin COMPU_METHOD Compu_TTC_comp_margin " " RAT_FUNC "%.3" "Surge-Choke Margin (%)" COEFFS 0 163.84 0 0 0 1 /end COMPU_METHOD
/begin CHARACTERISTIC TTC_turb_WGA_pct "Air # TTC_turb_WGA_pct" VAL_BLK 0x001E3456 /* @ECU_Address@TTC_turb_WGA_pct@0x02346000@ */ ECIPP_ALIGNMENT_SWORD 200 Compu_TTC_turb_WGA_pct -200 199.993896484375 MATRIX_DIM 8 1 1 /end CHARACTERISTIC
/begin COMPU_METHOD Compu_TTC_turb_WGA_pct " " RAT_FUNC "%.3" "WGA Position (%)" COEFFS 0 163.84 0 0 0 1 /end COMPU_METHOD
/begin CHARACTERISTIC TTC_turb_WGA_crct "Air # TTC_turb_WGA_crct" VAL_BLK 0x001E3446 /* @ECU_Address@TTC_turb_WGA_crct@0x02349000@ */ ECIPP_ALIGNMENT_SWORD 200 Compu_TTC_turb_WGA_crct -200 199.993896484375 MATRIX_DIM 8 1 1 /end CHARACTERISTIC
/begin COMPU_METHOD Compu_TTC_turb_WGA_crct " " RAT_FUNC "%.3" "-" COEFFS 0 163.84 0 0 0 1 /end COMPU_METHOD
/begin CHARACTERISTIC TTC_turb_mdot1c_Npct "Air # TTC_turb_mdot1c_Npct" VAL_BLK 0x001E34E6 /* @ECU_Address@TTC_turb_mdot1c_Npct@0x0234A000@ */ ECIPP_ALIGNMENT_SWORD 200 Compu_TTC_turb_mdot1c_Npct -200 199.993896484375 MATRIX_DIM 4 1 1 /end CHARACTERISTIC
/begin COMPU_METHOD Compu_TTC_turb_mdot1c_Npct " " RAT_FUNC "%.3" "Turbine Corrected Speed (% ref)" COEFFS 0 163.84 0 0 0 1 /end COMPU_METHOD
/begin CHARACTERISTIC TTM_EGRAad_PR "Air # TTM_EGRAad_PR" VAL_BLK 0x001C01D0 /* @ECU_Address@TTM_EGRAad_PR@0x0234F000@ */ ECIPP_ALIGNMENT_FLOAT32_IEEE 10000000000 Compu_TTM_EGRAad_PR -10000000000 10000000000 MATRIX_DIM 2 1 1 /end CHARACTERISTIC
/begin COMPU_METHOD Compu_TTM_EGRAad_PR " " RAT_FUNC "%.3" "PR (EGRLP/EGRHP)" COEFFS 0 1 0 0 0 1 /end COMPU_METHOD
/begin CHARACTERISTIC TUEGON_Vheater "CL # TUEGON_Vheater" VAL_BLK 0x001CA392 /* @ECU_Address@TUEGON_Vheater@0x02350000@ */ ECIPP_ALIGNMENT_SWORD 32 Compu_TUEGON_Vheater -32 31.9990234375 MATRIX_DIM 16 1 1 /end CHARACTERISTIC
/begin COMPU_METHOD Compu_TUEGON_Vheater " " RAT_FUNC "%.3" "Cmd (volts)" COEFFS 0 1024 0 0 0 1 /end COMPU_METHOD
/begin CHARACTERISTIC TUEGON_Vheater_sec "CL # TUEGON_Vheater_sec" VAL_BLK 0x001CA3B2 /* @ECU_Address@TUEGON_Vheater_sec@0x02351000@ */ ECIPP_ALIGNMENT_SWORD 524 Compu_TUEGON_Vheater_sec -524.288 524.272 MATRIX_DIM 16 1 1 /end CHARACTERISTIC
/begin COMPU_METHOD Compu_TUEGON_Vheater_sec " " RAT_FUNC "%.3" "(seconds)" COEFFS 0 62.5 0 0 0 1 /end COMPU_METHOD
/begin CHARACTERISTIC TCATdP_vdot "Air # TCATdP_vdot" VAL_BLK 0x001E57F2 /* @ECU_Address@TCATdP_vdot@0x0235E000@ */ ECIPP_ALIGNMENT_UWORD 8192 Compu_TCATdP_vdot 0 8191.875 MATRIX_DIM 8 1 1 /end CHARACTERISTIC
/begin COMPU_METHOD Compu_TCATdP_vdot " " RAT_FUNC "%.3" "-" COEFFS 0 8 0 0 0 1 /end COMPU_METHOD
/begin CHARACTERISTIC TCATdP_min "Air # TCATdP_min" VAL_BLK 0x001E3006 /* @ECU_Address@TCATdP_min@0x0235F000@ */ ECIPP_ALIGNMENT_SWORD 32 Compu_TCATdP_min -32 31.9990234375 MATRIX_DIM 8 1 1 /end CHARACTERISTIC
/begin COMPU_METHOD Compu_TCATdP_min " " RAT_FUNC "%.3" "-" COEFFS 0 1024 0 0 0 1 /end COMPU_METHOD
/begin CHARACTERISTIC TCATdP_max "Air # TCATdP_max" VAL_BLK 0x001E2FF6 /* @ECU_Address@TCATdP_max@0x02360000@ */ ECIPP_ALIGNMENT_SWORD 32 Compu_TCATdP_max -32 31.9990234375 MATRIX_DIM 8 1 1 /end CHARACTERISTIC
/begin COMPU_METHOD Compu_TCATdP_max " " RAT_FUNC "%.3" "-" COEFFS 0 1024 0 0 0 1 /end COMPU_METHOD
/begin CHARACTERISTIC TIpark_tps "IOConfig # TIpark_tps" VAL_BLK 0x001E3126 /* @ECU_Address@TIpark_tps@0x02361000@ */ ECIPP_ALIGNMENT_SWORD 100 Compu_TIpark_tps -100 99.9969482421875 MATRIX_DIM 4 1 1 /end CHARACTERISTIC
/begin COMPU_METHOD Compu_TIpark_tps " " RAT_FUNC "%.3" "amps" COEFFS 0 327.68 0 0 0 1 /end COMPU_METHOD
/begin CHARACTERISTIC TIpark_DBW_Ilim "IOConfig # TIpark_DBW_Ilim" VAL_BLK 0x001C9C94 /* @ECU_Address@TIpark_DBW_Ilim@0x02362000@ */ ECIPP_ALIGNMENT_SWORD 32 Compu_TIpark_DBW_Ilim -32 31.9990234375 MATRIX_DIM 4 1 1 /end CHARACTERISTIC
/begin COMPU_METHOD Compu_TIpark_DBW_Ilim " " RAT_FUNC "%.3" "amps" COEFFS 0 1024 0 0 0 1 /end COMPU_METHOD
/begin CHARACTERISTIC TIpark_HBA_Ilim "IOConfig # TIpark_HBA_Ilim" VAL_BLK 0x001C9E68 /* @ECU_Address@TIpark_HBA_Ilim@0x02363000@ */ ECIPP_ALIGNMENT_SWORD 32 Compu_TIpark_HBA_Ilim -32 31.9990234375 MATRIX_DIM 4 1 1 /end CHARACTERISTIC
/begin COMPU_METHOD Compu_TIpark_HBA_Ilim " " RAT_FUNC "%.3" "amps" COEFFS 0 1024 0 0 0 1 /end COMPU_METHOD
/begin CHARACTERISTIC TIpark_HBB_Ilim "IOConfig # TIpark_HBB_Ilim" VAL_BLK 0x001C9F08 /* @ECU_Address@TIpark_HBB_Ilim@0x02364000@ */ ECIPP_ALIGNMENT_SWORD 32 Compu_TIpark_HBB_Ilim -32 31.9990234375 MATRIX_DIM 4 1 1 /end CHARACTERISTIC
/begin COMPU_METHOD Compu_TIpark_HBB_Ilim " " RAT_FUNC "%.3" "amps" COEFFS 0 1024 0 0 0 1 /end COMPU_METHOD
/begin CHARACTERISTIC TUEGO_1Dlmt_sec "CL # TUEGO_1Dlmt_sec" VAL_BLK 0x001C5C4E /* @ECU_Address@TUEGO_1Dlmt_sec@0x02365000@ */ ECIPP_ALIGNMENT_SWORD 524 Compu_TUEGO_1Dlmt_sec -524.288 524.272 MATRIX_DIM 4 1 1 /end CHARACTERISTIC
/begin COMPU_METHOD Compu_TUEGO_1Dlmt_sec " " RAT_FUNC "%.3" "(seconds)" COEFFS 0 62.5 0 0 0 1 /end COMPU_METHOD
/begin CHARACTERISTIC TUEGOB_1Dlmt_min "CL # TUEGOB_1Dlmt_min" VAL_BLK 0x001CA336 /* @ECU_Address@TUEGOB_1Dlmt_min@0x02366000@ */ ECIPP_ALIGNMENT_SWORD 32 Compu_TUEGOB_1Dlmt_min -32 31.9990234375 MATRIX_DIM 4 1 1 /end CHARACTERISTIC
/begin COMPU_METHOD Compu_TUEGOB_1Dlmt_min " " RAT_FUNC "%.3" "(volts)" COEFFS 0 1024 0 0 0 1 /end COMPU_METHOD
/begin CHARACTERISTIC TUEGOB_1Dlmt_max "CL # TUEGOB_1Dlmt_max" VAL_BLK 0x001CA33E /* @ECU_Address@TUEGOB_1Dlmt_max@0x02367000@ */ ECIPP_ALIGNMENT_SWORD 32 Compu_TUEGOB_1Dlmt_max -32 31.9990234375 MATRIX_DIM 4 1 1 /end CHARACTERISTIC
/begin COMPU_METHOD Compu_TUEGOB_1Dlmt_max " " RAT_FUNC "%.3" "(volts)" COEFFS 0 1024 0 0 0 1 /end COMPU_METHOD
/begin CHARACTERISTIC TUEGON_1Dlmt_min "CL # TUEGON_1Dlmt_min" VAL_BLK 0x001CA3D2 /* @ECU_Address@TUEGON_1Dlmt_min@0x02368000@ */ ECIPP_ALIGNMENT_SWORD 32 Compu_TUEGON_1Dlmt_min -32 31.9990234375 MATRIX_DIM 4 1 1 /end CHARACTERISTIC
/begin COMPU_METHOD Compu_TUEGON_1Dlmt_min " " RAT_FUNC "%.3" "(volts)" COEFFS 0 1024 0 0 0 1 /end COMPU_METHOD
/begin CHARACTERISTIC TUEGON_1Dlmt_max "CL # TUEGON_1Dlmt_max" VAL_BLK 0x001CA3DA /* @ECU_Address@TUEGON_1Dlmt_max@0x02369000@ */ ECIPP_ALIGNMENT_SWORD 32 Compu_TUEGON_1Dlmt_max -32 31.9990234375 MATRIX_DIM 4 1 1 /end CHARACTERISTIC
/begin COMPU_METHOD Compu_TUEGON_1Dlmt_max " " RAT_FUNC "%.3" "(volts)" COEFFS 0 1024 0 0 0 1 /end COMPU_METHOD
/begin CHARACTERISTIC TFauxAcal_V "IOConfig # TFauxAcal_V" VAL_BLK 0x001E19C0 /* @ECU_Address@TFauxAcal_V@0x0236B000@ */ ECIPP_ALIGNMENT_FLOAT32_IEEE 10000000000 Compu_TFauxAcal_V -10000000000 10000000000 MATRIX_DIM 6 1 1 /end CHARACTERISTIC
/begin COMPU_METHOD Compu_TFauxAcal_V " " RAT_FUNC "%.3" "(volts)" COEFFS 0 1 0 0 0 1 /end COMPU_METHOD
/begin CHARACTERISTIC TFauxBcal_V "IOConfig # TFauxBcal_V" VAL_BLK 0x001E19F0 /* @ECU_Address@TFauxBcal_V@0x0236C000@ */ ECIPP_ALIGNMENT_FLOAT32_IEEE 10000000000 Compu_TFauxBcal_V -10000000000 10000000000 MATRIX_DIM 6 1 1 /end CHARACTERISTIC
/begin COMPU_METHOD Compu_TFauxBcal_V " " RAT_FUNC "%.3" "(volts)" COEFFS 0 1 0 0 0 1 /end COMPU_METHOD
/begin CHARACTERISTIC TFauxAcal_F "IOConfig # TFauxAcal_F" VAL_BLK 0x001E19A8 /* @ECU_Address@TFauxAcal_F@0x0236D000@ */ ECIPP_ALIGNMENT_FLOAT32_IEEE 10000000000 Compu_TFauxAcal_F -10000000000 10000000000 MATRIX_DIM 6 1 1 /end CHARACTERISTIC
/begin COMPU_METHOD Compu_TFauxAcal_F " " RAT_FUNC "%.3" "-" COEFFS 0 1 0 0 0 1 /end COMPU_METHOD
/begin CHARACTERISTIC TFauxBcal_F "IOConfig # TFauxBcal_F" VAL_BLK 0x001E19D8 /* @ECU_Address@TFauxBcal_F@0x0236E000@ */ ECIPP_ALIGNMENT_FLOAT32_IEEE 10000000000 Compu_TFauxBcal_F -10000000000 10000000000 MATRIX_DIM 6 1 1 /end CHARACTERISTIC
/begin COMPU_METHOD Compu_TFauxBcal_F " " RAT_FUNC "%.3" "-" COEFFS 0 1 0 0 0 1 /end COMPU_METHOD
/begin CHARACTERISTIC TIPAdaptMAP "Gov # TIPAdaptMAP" VAL_BLK 0x001C51E0 /* @ECU_Address@TIPAdaptMAP@0x02390000@ */ ECIPP_ALIGNMENT_SWORD 128 Compu_TIPAdaptMAP -128 127.99609375 MATRIX_DIM 8 1 1 /end CHARACTERISTIC
/begin COMPU_METHOD Compu_TIPAdaptMAP " " RAT_FUNC "%.1" "MAP (psia)" COEFFS 0 256 0 0 0 1 /end COMPU_METHOD
/begin CHARACTERISTIC TIPAdaptRPM "Gov # TIPAdaptRPM" VAL_BLK 0x001C51F0 /* @ECU_Address@TIPAdaptRPM@0x02391000@ */ ECIPP_ALIGNMENT_SWORD 32767 Compu_TIPAdaptRPM -32768 32767 MATRIX_DIM 5 1 1 /end CHARACTERISTIC
/begin COMPU_METHOD Compu_TIPAdaptRPM " " RAT_FUNC "%.0" "Speed (rpm)" COEFFS 0 1 0 0 0 1 /end COMPU_METHOD
/begin MEASUREMENT TIPAdaptTbl "Slave TIP Adaptive Table" SWORD Compu_TIPAdaptTbl 0 0 -100 99.9969482421875 ECU_ADDRESS 0x02392000 MATRIX_DIM 40 1 1 /end MEASUREMENT
/begin COMPU_METHOD Compu_TIPAdaptTbl " " RAT_FUNC "%.1" "TIP Correction (%)" COEFFS 0 327.68 0 0 0 1 /end COMPU_METHOD
/begin CHARACTERISTIC STR_LPIgnAdvCmt "General # STR_LPIgnAdvCmt" ASCII 0x001E725C /* @ECU_Address@STR_LPIgnAdvCmt@0x02393000@ */ ECIPP_ALIGNMENT_UBYTE 255 Compu_ECIPP_STRINGS 0 255 MATRIX_DIM 99 1 1 /end CHARACTERISTIC
/begin CHARACTERISTIC STR_NGIgnAdvCmt "General # STR_NGIgnAdvCmt" ASCII 0x001E743C /* @ECU_Address@STR_NGIgnAdvCmt@0x02394000@ */ ECIPP_ALIGNMENT_UBYTE 255 Compu_ECIPP_STRINGS 0 255 MATRIX_DIM 99 1 1 /end CHARACTERISTIC
/begin MEASUREMENT TTM_EGRAad_in2 "EGR Valve Adaptive Effective Area" FLOAT32_IEEE Compu_TTM_EGRAad_in2 0 0 -10000000000 10000000000 ECU_ADDRESS 0x02395000 MATRIX_DIM 32 1 1 /end MEASUREMENT
/begin COMPU_METHOD Compu_TTM_EGRAad_in2 " " RAT_FUNC "%.3" "Area Adapt (in^2)" COEFFS 0 1 0 0 0 1 /end COMPU_METHOD
/begin CHARACTERISTIC TPW_VC_PCF "Fuel # TPW_VC_PCF" VAL_BLK 0x001E324E /* @ECU_Address@TPW_VC_PCF@0x02396000@ */ ECIPP_ALIGNMENT_SWORD 0 Compu_TPW_VC_PCF -0.1024 0.102396875 MATRIX_DIM 16 1 1 /end CHARACTERISTIC
/begin COMPU_METHOD Compu_TPW_VC_PCF " " RAT_FUNC "%.3" "(ms/psi)" COEFFS 0 320000 0 0 0 1 /end COMPU_METHOD
/begin CHARACTERISTIC TPW_VC_PCF_I2 "Fuel # TPW_VC_PCF_I2" VAL_BLK 0x001E326E /* @ECU_Address@TPW_VC_PCF_I2@0x02397000@ */ ECIPP_ALIGNMENT_SWORD 0 Compu_TPW_VC_PCF_I2 -0.1024 0.102396875 MATRIX_DIM 16 1 1 /end CHARACTERISTIC
/begin COMPU_METHOD Compu_TPW_VC_PCF_I2 " " RAT_FUNC "%.3" "(ms/psi)" COEFFS 0 320000 0 0 0 1 /end COMPU_METHOD
/begin CHARACTERISTIC TPW_VC_peak "Fuel # TPW_VC_peak" VAL_BLK 0x001E5810 /* @ECU_Address@TPW_VC_peak@0x02398000@ */ ECIPP_ALIGNMENT_UWORD 210 Compu_TPW_VC_peak 0 209.712 MATRIX_DIM 16 1 1 /end CHARACTERISTIC
/begin COMPU_METHOD Compu_TPW_VC_peak " " RAT_FUNC "%.3" "Hold Time (ms)" COEFFS 0 312.5 0 0 0 1 /end COMPU_METHOD
/begin CHARACTERISTIC TPW_VC_peak_I2 "Fuel # TPW_VC_peak_I2" VAL_BLK 0x001E5830 /* @ECU_Address@TPW_VC_peak_I2@0x02399000@ */ ECIPP_ALIGNMENT_UWORD 210 Compu_TPW_VC_peak_I2 0 209.712 MATRIX_DIM 16 1 1 /end CHARACTERISTIC
/begin COMPU_METHOD Compu_TPW_VC_peak_I2 " " RAT_FUNC "%.3" "Hold Time (ms)" COEFFS 0 312.5 0 0 0 1 /end COMPU_METHOD
/begin CHARACTERISTIC ECTHst_Tbl_ECT "General # ECTHst_Tbl_ECT" VAL_BLK 0x001E380A /* @ECU_Address@ECTHst_Tbl_ECT@0x023BF000@ */ ECIPP_ALIGNMENT_UWORD 564 Compu_ECTHst_Tbl_ECT -460 563.984375 MATRIX_DIM 8 1 1 /end CHARACTERISTIC
/begin COMPU_METHOD Compu_ECTHst_Tbl_ECT " " RAT_FUNC "%.1" "ECT (degF)" COEFFS 0 64 29440 0 0 1 /end COMPU_METHOD
/begin CHARACTERISTIC TEGR_PRf_PR "Air # TEGR_PRf_PR" VAL_BLK 0x001C0130 /* @ECU_Address@TEGR_PRf_PR@0x023C9000@ */ ECIPP_ALIGNMENT_FLOAT32_IEEE 10000000000 Compu_TEGR_PRf_PR -10000000000 10000000000 MATRIX_DIM 6 1 1 /end CHARACTERISTIC
/begin COMPU_METHOD Compu_TEGR_PRf_PR " " RAT_FUNC "%.3" "PR (psia)" COEFFS 0 1 0 0 0 1 /end COMPU_METHOD
/begin MEASUREMENT TEGR_PRf_crct "EGR Pressure Ratio Adaptive Correction" FLOAT32_IEEE Compu_TEGR_PRf_crct 0 0 -10000000000 10000000000 ECU_ADDRESS 0x023CA000 MATRIX_DIM 36 1 1 /end MEASUREMENT
/begin COMPU_METHOD Compu_TEGR_PRf_crct " " RAT_FUNC "%.2" "-" COEFFS 0 0.01 0 0 0 1 /end COMPU_METHOD
/begin CHARACTERISTIC TEGRad_in2pct_pct "Air # TEGRad_in2pct_pct" VAL_BLK 0x001C0902 /* @ECU_Address@TEGRad_in2pct_pct@0x023D3000@ */ ECIPP_ALIGNMENT_SWORD 100 Compu_TEGRad_in2pct_pct -100 99.9969482421875 MATRIX_DIM 6 1 1 /end CHARACTERISTIC
/begin COMPU_METHOD Compu_TEGRad_in2pct_pct " " RAT_FUNC "%.3" "(%)" COEFFS 0 327.68 0 0 0 1 /end COMPU_METHOD
/begin CHARACTERISTIC TEGRad_in2pct_min "Air # TEGRad_in2pct_min" VAL_BLK 0x001C08F6 /* @ECU_Address@TEGRad_in2pct_min@0x023D4000@ */ ECIPP_ALIGNMENT_SWORD 16 Compu_TEGRad_in2pct_min -16 15.99951171875 MATRIX_DIM 6 1 1 /end CHARACTERISTIC
/begin COMPU_METHOD Compu_TEGRad_in2pct_min " " RAT_FUNC "%.3" "100%)" COEFFS 0 2048 0 0 0 1 /end COMPU_METHOD
/begin CHARACTERISTIC TTM_TPSAad_PR "Air # TTM_TPSAad_PR" VAL_BLK 0x001C3D14 /* @ECU_Address@TTM_TPSAad_PR@0x024C7000@ */ ECIPP_ALIGNMENT_FLOAT32_IEEE 10000000000 Compu_TTM_TPSAad_PR -10000000000 10000000000 MATRIX_DIM 2 1 1 /end CHARACTERISTIC
/begin COMPU_METHOD Compu_TTM_TPSAad_PR " " RAT_FUNC "%.3" "PR (TOP/TIP)" COEFFS 0 1 0 0 0 1 /end COMPU_METHOD
/begin MEASUREMENT TTM_TPSAad_in2 "Throttle Adaptive Effective Area" FLOAT32_IEEE Compu_TTM_TPSAad_in2 0 0 -10000000000 10000000000 ECU_ADDRESS 0x024C8000 MATRIX_DIM 32 1 1 /end MEASUREMENT
/begin COMPU_METHOD Compu_TTM_TPSAad_in2 " " RAT_FUNC "%.3" "Area Adapt (in^2)" COEFFS 0 1 0 0 0 1 /end COMPU_METHOD
/begin CHARACTERISTIC TTPSad_in2pct_pct "Air # TTPSad_in2pct_pct" VAL_BLK 0x001C5BE6 /* @ECU_Address@TTPSad_in2pct_pct@0x024C9000@ */ ECIPP_ALIGNMENT_SWORD 100 Compu_TTPSad_in2pct_pct -100 99.9969482421875 MATRIX_DIM 4 1 1 /end CHARACTERISTIC
/begin COMPU_METHOD Compu_TTPSad_in2pct_pct " " RAT_FUNC "%.3" "(%)" COEFFS 0 327.68 0 0 0 1 /end COMPU_METHOD
/begin CHARACTERISTIC TTPSad_in2pct_min "Air # TTPSad_in2pct_min" VAL_BLK 0x001C5BDE /* @ECU_Address@TTPSad_in2pct_min@0x024CA000@ */ ECIPP_ALIGNMENT_SWORD 16 Compu_TTPSad_in2pct_min -16 15.99951171875 MATRIX_DIM 4 1 1 /end CHARACTERISTIC
/begin COMPU_METHOD Compu_TTPSad_in2pct_min " " RAT_FUNC "%.3" "(in^2/100%)" COEFFS 0 2048 0 0 0 1 /end COMPU_METHOD
/begin CHARACTERISTIC TTPSad_in2pct_max "Air # TTPSad_in2pct_max" VAL_BLK 0x001C5BD6 /* @ECU_Address@TTPSad_in2pct_max@0x024CB000@ */ ECIPP_ALIGNMENT_SWORD 16 Compu_TTPSad_in2pct_max -16 15.99951171875 MATRIX_DIM 4 1 1 /end CHARACTERISTIC
/begin COMPU_METHOD Compu_TTPSad_in2pct_max " " RAT_FUNC "%.3" "(in^2/100%)" COEFFS 0 2048 0 0 0 1 /end COMPU_METHOD
/begin CHARACTERISTIC TTPS_PRf_TIP "Air # TTPS_PRf_TIP" VAL_BLK 0x001C3D34 /* @ECU_Address@TTPS_PRf_TIP@0x024CC000@ */ ECIPP_ALIGNMENT_FLOAT32_IEEE 10000000000 Compu_TTPS_PRf_TIP -10000000000 10000000000 MATRIX_DIM 6 1 1 /end CHARACTERISTIC
/begin COMPU_METHOD Compu_TTPS_PRf_TIP " " RAT_FUNC "%.1" "TIP (psia)" COEFFS 0 1 0 0 0 1 /end COMPU_METHOD
/begin CHARACTERISTIC TTPS_PRf_PR "Air # TTPS_PRf_PR" VAL_BLK 0x001C3D1C /* @ECU_Address@TTPS_PRf_PR@0x024CD000@ */ ECIPP_ALIGNMENT_FLOAT32_IEEE 10000000000 Compu_TTPS_PRf_PR -10000000000 10000000000 MATRIX_DIM 6 1 1 /end CHARACTERISTIC
/begin COMPU_METHOD Compu_TTPS_PRf_PR " " RAT_FUNC "%.3" "PR (psia)" COEFFS 0 1 0 0 0 1 /end COMPU_METHOD
/begin MEASUREMENT TTPS_PRf_crct "TPS Pressure Ratio Adaptive Correction" FLOAT32_IEEE Compu_TTPS_PRf_crct 0 0 -10000000000 10000000000 ECU_ADDRESS 0x024CE000 MATRIX_DIM 36 1 1 /end MEASUREMENT
/begin COMPU_METHOD Compu_TTPS_PRf_crct " " RAT_FUNC "%.2" "-" COEFFS 0 0.01 0 0 0 1 /end COMPU_METHOD
/begin CHARACTERISTIC TICAV_expadpt_rpm "FaultConfig # TICAV_expadpt_rpm" VAL_BLK 0x001CA284 /* @ECU_Address@TICAV_expadpt_rpm@0x0259D000@ */ ECIPP_ALIGNMENT_SWORD 32767 Compu_TICAV_expadpt_rpm -32768 32767 MATRIX_DIM 12 1 1 /end CHARACTERISTIC
/begin COMPU_METHOD Compu_TICAV_expadpt_rpm " " RAT_FUNC "%.0" "Speed (rpm)" COEFFS 0 1 0 0 0 1 /end COMPU_METHOD
/begin CHARACTERISTIC TICAV_expadpt_maL "FaultConfig # TICAV_expadpt_maL" VAL_BLK 0x001CA278 /* @ECU_Address@TICAV_expadpt_maL@0x0259E000@ */ ECIPP_ALIGNMENT_SWORD 8192 Compu_TICAV_expadpt_maL -8192 8191.75 MATRIX_DIM 6 1 1 /end CHARACTERISTIC
/begin COMPU_METHOD Compu_TICAV_expadpt_maL " " RAT_FUNC "%.0" "Air flow (mg/L-disp)" COEFFS 0 4 0 0 0 1 /end COMPU_METHOD
/begin MEASUREMENT ICAV_expadpt1 "ICAV Cylinder 1 adaptive" FLOAT32_IEEE Compu_ICAV_expadpt1 0 0 -10000000000 10000000000 ECU_ADDRESS 0x0259F000 MATRIX_DIM 72 1 1 /end MEASUREMENT
/begin COMPU_METHOD Compu_ICAV_expadpt1 " " RAT_FUNC "%.2" "% speed deviation" COEFFS 0 0.01 0 0 0 1 /end COMPU_METHOD
/begin MEASUREMENT ICAV_expadpt2 "ICAV Cylinder 2 adaptive" FLOAT32_IEEE Compu_ICAV_expadpt2 0 0 -10000000000 10000000000 ECU_ADDRESS 0x025A0000 MATRIX_DIM 72 1 1 /end MEASUREMENT
/begin COMPU_METHOD Compu_ICAV_expadpt2 " " RAT_FUNC "%.2" "% speed deviation" COEFFS 0 0.01 0 0 0 1 /end COMPU_METHOD
/begin MEASUREMENT ICAV_expadpt3 "ICAV Cylinder 3 adaptive" FLOAT32_IEEE Compu_ICAV_expadpt3 0 0 -10000000000 10000000000 ECU_ADDRESS 0x025A1000 MATRIX_DIM 72 1 1 /end MEASUREMENT
/begin COMPU_METHOD Compu_ICAV_expadpt3 " " RAT_FUNC "%.2" "% speed deviation" COEFFS 0 0.01 0 0 0 1 /end COMPU_METHOD
/begin MEASUREMENT ICAV_expadpt4 "ICAV Cylinder 4 adaptive" FLOAT32_IEEE Compu_ICAV_expadpt4 0 0 -10000000000 10000000000 ECU_ADDRESS 0x025A2000 MATRIX_DIM 72 1 1 /end MEASUREMENT
/begin COMPU_METHOD Compu_ICAV_expadpt4 " " RAT_FUNC "%.2" "% speed deviation" COEFFS 0 0.01 0 0 0 1 /end COMPU_METHOD
/begin MEASUREMENT ICAV_expadpt5 "ICAV Cylinder 5 adaptive" FLOAT32_IEEE Compu_ICAV_expadpt5 0 0 -10000000000 10000000000 ECU_ADDRESS 0x025A3000 MATRIX_DIM 72 1 1 /end MEASUREMENT
/begin COMPU_METHOD Compu_ICAV_expadpt5 " " RAT_FUNC "%.2" "% speed deviation" COEFFS 0 0.01 0 0 0 1 /end COMPU_METHOD
/begin MEASUREMENT ICAV_expadpt6 "ICAV Cylinder 6 adaptive" FLOAT32_IEEE Compu_ICAV_expadpt6 0 0 -10000000000 10000000000 ECU_ADDRESS 0x025A4000 MATRIX_DIM 72 1 1 /end MEASUREMENT
/begin COMPU_METHOD Compu_ICAV_expadpt6 " " RAT_FUNC "%.2" "% speed deviation" COEFFS 0 0.01 0 0 0 1 /end COMPU_METHOD
/begin MEASUREMENT ICAV_expadpt7 "ICAV Cylinder 7 adaptive" FLOAT32_IEEE Compu_ICAV_expadpt7 0 0 -10000000000 10000000000 ECU_ADDRESS 0x025A5000 MATRIX_DIM 72 1 1 /end MEASUREMENT
/begin COMPU_METHOD Compu_ICAV_expadpt7 " " RAT_FUNC "%.2" "% speed deviation" COEFFS 0 0.01 0 0 0 1 /end COMPU_METHOD
/begin MEASUREMENT ICAV_expadpt8 "ICAV Cylinder 8 adaptive" FLOAT32_IEEE Compu_ICAV_expadpt8 0 0 -10000000000 10000000000 ECU_ADDRESS 0x025A6000 MATRIX_DIM 72 1 1 /end MEASUREMENT
/begin COMPU_METHOD Compu_ICAV_expadpt8 " " RAT_FUNC "%.2" "% speed deviation" COEFFS 0 0.01 0 0 0 1 /end COMPU_METHOD
/begin MEASUREMENT ICAV_expadpt9 "ICAV Cylinder 9 adaptive" FLOAT32_IEEE Compu_ICAV_expadpt9 0 0 -10000000000 10000000000 ECU_ADDRESS 0x025A7000 MATRIX_DIM 72 1 1 /end MEASUREMENT
/begin COMPU_METHOD Compu_ICAV_expadpt9 " " RAT_FUNC "%.2" "% speed deviation" COEFFS 0 0.01 0 0 0 1 /end COMPU_METHOD
/begin MEASUREMENT ICAV_expadpt10 "ICAV Cylinder 10 adaptive" FLOAT32_IEEE Compu_ICAV_expadpt10 0 0 -10000000000 10000000000 ECU_ADDRESS 0x025A8000 MATRIX_DIM 72 1 1 /end MEASUREMENT
/begin COMPU_METHOD Compu_ICAV_expadpt10 " " RAT_FUNC "%.2" "% speed deviation" COEFFS 0 0.01 0 0 0 1 /end COMPU_METHOD
/begin MEASUREMENT ICAV_expadptT "ICAV Adaptive histogram" ULONG Compu_ICAV_expadptT 0 0 0 65535.9999847412 ECU_ADDRESS 0x025A9000 MATRIX_DIM 72 1 1 /end MEASUREMENT
/begin COMPU_METHOD Compu_ICAV_expadptT " " RAT_FUNC "%.0" "cycles" COEFFS 0 65536 0 0 0 1 /end COMPU_METHOD
/begin CHARACTERISTIC HstSL_expTbl_RPMdf "FaultConfig # HstSL_expTbl_RPMdf" VAL_BLK 0x001ECCF8 /* @ECU_Address@HstSL_expTbl_RPMdf@0x025AA000@ */ ECIPP_ALIGNMENT_UWORD 65535 Compu_HstSL_expTbl_RPMdf 0 65535 MATRIX_DIM 12 1 1 /end CHARACTERISTIC
/begin COMPU_METHOD Compu_HstSL_expTbl_RPMdf " " RAT_FUNC "%.0" "-" COEFFS 0 1 0 0 0 1 /end COMPU_METHOD
/begin MEASUREMENT HstSL_expTbl_RPM "General # HstSL_expTbl_RPM" UWORD Compu_HstSL_expTbl_RPM 0 0 0 65535 ECU_ADDRESS 0x025AB000 MATRIX_DIM 12 1 1 /end MEASUREMENT
/begin COMPU_METHOD Compu_HstSL_expTbl_RPM " " RAT_FUNC "%.0" "Speed (rpm)" COEFFS 0 1 0 0 0 1 /end COMPU_METHOD
/begin CHARACTERISTIC TEGRwr_Vheater "CL # TEGRwr_Vheater" VAL_BLK 0x001E30CE /* @ECU_Address@TEGRwr_Vheater@0x025B8000@ */ ECIPP_ALIGNMENT_SWORD 32 Compu_TEGRwr_Vheater -32 31.9990234375 MATRIX_DIM 6 1 1 /end CHARACTERISTIC
/begin COMPU_METHOD Compu_TEGRwr_Vheater " " RAT_FUNC "%.3" "Cmd (volts)" COEFFS 0 1024 0 0 0 1 /end COMPU_METHOD
/begin CHARACTERISTIC TEGRwr_Vheater_sec "CL # TEGRwr_Vheater_sec" VAL_BLK 0x001E30DA /* @ECU_Address@TEGRwr_Vheater_sec@0x025B9000@ */ ECIPP_ALIGNMENT_SWORD 524 Compu_TEGRwr_Vheater_sec -524.288 524.272 MATRIX_DIM 6 1 1 /end CHARACTERISTIC
/begin COMPU_METHOD Compu_TEGRwr_Vheater_sec " " RAT_FUNC "%.3" "(seconds)" COEFFS 0 62.5 0 0 0 1 /end COMPU_METHOD
/begin CHARACTERISTIC J1939_PGN_tout "FaultConfig # J1939_PGN_tout (Fault Condition:Run-time > time above and PGN =)" VAL_BLK 0x001C7C8C /* @ECU_Address@J1939_PGN_tout@0x025BA000@ */ ECIPP_ALIGNMENT_UWORD 65535 Compu_J1939_PGN_tout 0 65535 MATRIX_DIM 10 1 1 /end CHARACTERISTIC
/begin COMPU_METHOD Compu_J1939_PGN_tout " " RAT_FUNC "%.0" "-" COEFFS 0 1 0 0 0 1 /end COMPU_METHOD
/begin CHARACTERISTIC TEGR_PRf_EGRLP "Air # TEGR_PRf_EGRLP" VAL_BLK 0x001C0118 /* @ECU_Address@TEGR_PRf_EGRLP@0x025C6000@ */ ECIPP_ALIGNMENT_FLOAT32_IEEE 10000000000 Compu_TEGR_PRf_EGRLP -10000000000 10000000000 MATRIX_DIM 6 1 1 /end CHARACTERISTIC
/begin COMPU_METHOD Compu_TEGR_PRf_EGRLP " " RAT_FUNC "%.1" "EGRLP (psia)" COEFFS 0 1 0 0 0 1 /end COMPU_METHOD
/begin CHARACTERISTIC cal_grp_scalars "General # cal_grp_scalars" VAL_BLK 0x001E9BE7 /* @ECU_Address@cal_grp_scalars@0x25FF0000@ */ ECIPP_ALIGNMENT_UBYTE 255 Compu_cal_grp_scalars 0 255 MATRIX_DIM 10668 1 1 /end CHARACTERISTIC
/begin COMPU_METHOD Compu_cal_grp_scalars " " RAT_FUNC "%.0" "N" COEFFS 0 1 0 0 0 1 /end COMPU_METHOD
/begin CHARACTERISTIC cal_grp_tables "General # cal_grp_tables" VAL_BLK 0x001EC593 /* @ECU_Address@cal_grp_tables@0x02600000@ */ ECIPP_ALIGNMENT_UBYTE 255 Compu_cal_grp_tables 0 255 MATRIX_DIM 1768 1 1 /end CHARACTERISTIC
/begin COMPU_METHOD Compu_cal_grp_tables " " RAT_FUNC "%.0" "N" COEFFS 0 1 0 0 0 1 /end COMPU_METHOD
/begin CHARACTERISTIC FCtl_cal_grp "General # FCtl_cal_grp" VAL_BLK 0x001E612D /* @ECU_Address@FCtl_cal_grp@0x02601000@ */ ECIPP_ALIGNMENT_UBYTE 255 Compu_FCtl_cal_grp 0 255 MATRIX_DIM 1046 1 1 /end CHARACTERISTIC
/begin COMPU_METHOD Compu_FCtl_cal_grp " " RAT_FUNC "%.0" "-" COEFFS 0 1 0 0 0 1 /end COMPU_METHOD
/begin CHARACTERISTIC STR_engine_chassis_ID "General # STR_engine_chassis_ID" ASCII 0x001C0000 /* @ECU_Address@STR_engine_chassis_ID@0x0261C000@ */ ECIPP_ALIGNMENT_UBYTE 255 Compu_ECIPP_STRINGS 0 255 MATRIX_DIM 19 1 1 /end CHARACTERISTIC
/begin CHARACTERISTIC STR_DID_0xF196 "General # STR_DID_0xF196" ASCII 0x001C89BD /* @ECU_Address@STR_DID_0xF196@0x0261F000@ */ ECIPP_ALIGNMENT_UBYTE 255 Compu_ECIPP_STRINGS 0 255 MATRIX_DIM 9 1 1 /end CHARACTERISTIC
/begin CHARACTERISTIC HEX_F201_ids "IOConfig # HEX_F201_ids" VAL_BLK 0x001E2DBC /* @ECU_Address@HEX_F201_ids@0x0263A000@ */ ECIPP_ALIGNMENT_ULONG 4294967295 Compu_HEX_F201_ids 0 4294967295 MATRIX_DIM 80 1 1 /end CHARACTERISTIC
/begin COMPU_METHOD Compu_HEX_F201_ids " " RAT_FUNC "%.0" "DID F202" COEFFS 0 1 0 0 0 1 /end COMPU_METHOD
/begin CHARACTERISTIC TVSFan_pwr_rpm "IOConfig # TVSFan_pwr_rpm" VAL_BLK 0x001E36AE /* @ECU_Address@TVSFan_pwr_rpm@0x02645000@ */ ECIPP_ALIGNMENT_SWORD 32767 Compu_TVSFan_pwr_rpm -32768 32767 MATRIX_DIM 16 1 1 /end CHARACTERISTIC
/begin COMPU_METHOD Compu_TVSFan_pwr_rpm " " RAT_FUNC "%.0" "(rpm)" COEFFS 0 1 0 0 0 1 /end COMPU_METHOD
/begin CHARACTERISTIC TVSFan_pwr_kW "IOConfig # TVSFan_pwr_kW" VAL_BLK 0x001E5868 /* @ECU_Address@TVSFan_pwr_kW@0x02646000@ */ ECIPP_ALIGNMENT_UWORD 4096 Compu_TVSFan_pwr_kW 0 4095.9375 MATRIX_DIM 16 1 1 /end CHARACTERISTIC
/begin COMPU_METHOD Compu_TVSFan_pwr_kW " " RAT_FUNC "%.3" "(kW)" COEFFS 0 16 0 0 0 1 /end COMPU_METHOD
/begin MEASUREMENT J1939RC_ER_rpm "General # J1939RC_ER_rpm" UWORD Compu_J1939RC_ER_rpm 0 0 0 65535 ECU_ADDRESS 0x02652000 MATRIX_DIM 5 1 1 /end MEASUREMENT
/begin COMPU_METHOD Compu_J1939RC_ER_rpm " " RAT_FUNC "%.0" "Speed (rpm)" COEFFS 0 1 0 0 0 1 /end COMPU_METHOD
/begin MEASUREMENT J1939RC_EXR_rpm "General # J1939RC_EXR_rpm" UWORD Compu_J1939RC_EXR_rpm 0 0 0 65535 ECU_ADDRESS 0x02653000 MATRIX_DIM 5 1 1 /end MEASUREMENT
/begin COMPU_METHOD Compu_J1939RC_EXR_rpm " " RAT_FUNC "%.0" "Speed (rpm)" COEFFS 0 1 0 0 0 1 /end COMPU_METHOD
/begin CHARACTERISTIC STR_cal_pwd "Cal pwd" ASCII 0x001E9A14 /* @ECU_Address@STR_cal_pwd@0x0265A000@ */ ECIPP_ALIGNMENT_UBYTE 255 Compu_ECIPP_STRINGS 0 255 MATRIX_DIM 19 1 1 /end CHARACTERISTIC
/begin CHARACTERISTIC TPhi_FSO_CBT "Fuel # TPhi_FSO_CBT" VAL_BLK 0x001C58D6 /* @ECU_Address@TPhi_FSO_CBT@0x02663000@ */ ECIPP_ALIGNMENT_SWORD 7732 Compu_TPhi_FSO_CBT -8652 7731.75 MATRIX_DIM 4 1 1 /end CHARACTERISTIC
/begin COMPU_METHOD Compu_TPhi_FSO_CBT " " RAT_FUNC "%.0" "CBT (deg F)" COEFFS 0 4 1840 0 0 1 /end COMPU_METHOD
/begin CHARACTERISTIC TPhi_FSO_offset_cal "Fuel # TPhi_FSO_offset_cal" VAL_BLK 0x001CA2B8 /* @ECU_Address@TPhi_FSO_offset_cal@0x02664000@ */ ECIPP_ALIGNMENT_SWORD 200 Compu_TPhi_FSO_offset_cal -200 199.993896484375 MATRIX_DIM 3 1 1 /end CHARACTERISTIC
/begin COMPU_METHOD Compu_TPhi_FSO_offset_cal " " RAT_FUNC "%.3" "Enrichment (%)" COEFFS 0 163.84 0 0 0 1 /end COMPU_METHOD
/begin MEASUREMENT TPhi_FSO_offset "FSO Phi Catalyst Enrichment in Cold Start Mode" SWORD Compu_TPhi_FSO_offset 0 0 -200 199.993896484375 ECU_ADDRESS 0x02665000 MATRIX_DIM 4 1 1 /end MEASUREMENT
/begin COMPU_METHOD Compu_TPhi_FSO_offset " " RAT_FUNC "%.3" "Phi Offset" COEFFS 0 163.84 0 0 0 1 /end COMPU_METHOD
/begin CHARACTERISTIC HEX_FSS_DID_tbl "General # HEX_FSS_DID_tbl" VAL_BLK 0x001E56B8 /* @ECU_Address@HEX_FSS_DID_tbl@0x02666000@ */ ECIPP_ALIGNMENT_UWORD 65535 Compu_HEX_FSS_DID_tbl 0 65535 MATRIX_DIM 15 1 1 /end CHARACTERISTIC
/begin COMPU_METHOD Compu_HEX_FSS_DID_tbl " " RAT_FUNC "%.0" "FSS DIDs" COEFFS 0 1 0 0 0 1 /end COMPU_METHOD
/begin CHARACTERISTIC Tdrvtrim_V_volts "IOConfig # Tdrvtrim_V_volts" VAL_BLK 0x001E36D2 /* @ECU_Address@Tdrvtrim_V_volts@0x02667000@ */ ECIPP_ALIGNMENT_SWORD 128 Compu_Tdrvtrim_V_volts -128 127.99609375 MATRIX_DIM 2 1 1 /end CHARACTERISTIC
/begin COMPU_METHOD Compu_Tdrvtrim_V_volts " " RAT_FUNC "%.3" "(volts)" COEFFS 0 256 0 0 0 1 /end COMPU_METHOD
/begin CHARACTERISTIC Tdrvtrim_V_angle "IOConfig # Tdrvtrim_V_angle" VAL_BLK 0x001E36CE /* @ECU_Address@Tdrvtrim_V_angle@0x02668000@ */ ECIPP_ALIGNMENT_SWORD 2048 Compu_Tdrvtrim_V_angle -2048 2047.9375 MATRIX_DIM 2 1 1 /end CHARACTERISTIC
/begin COMPU_METHOD Compu_Tdrvtrim_V_angle " " RAT_FUNC "%.3" "(degrees)" COEFFS 0 16 0 0 0 1 /end COMPU_METHOD
/begin CHARACTERISTIC Tdrvtrim_cmd_pct "IOConfig # Tdrvtrim_cmd_pct" VAL_BLK 0x001E36DA /* @ECU_Address@Tdrvtrim_cmd_pct@0x02669000@ */ ECIPP_ALIGNMENT_SWORD 200 Compu_Tdrvtrim_cmd_pct -200 199.993896484375 MATRIX_DIM 2 1 1 /end CHARACTERISTIC
/begin COMPU_METHOD Compu_Tdrvtrim_cmd_pct " " RAT_FUNC "%.3" "(%)" COEFFS 0 163.84 0 0 0 1 /end COMPU_METHOD
/begin CHARACTERISTIC Tdrvtrim_cmd_angle "IOConfig # Tdrvtrim_cmd_angle" VAL_BLK 0x001E36D6 /* @ECU_Address@Tdrvtrim_cmd_angle@0x0266A000@ */ ECIPP_ALIGNMENT_SWORD 2048 Compu_Tdrvtrim_cmd_angle -2048 2047.9375 MATRIX_DIM 2 1 1 /end CHARACTERISTIC
/begin COMPU_METHOD Compu_Tdrvtrim_cmd_angle " " RAT_FUNC "%.3" "(degrees)" COEFFS 0 16 0 0 0 1 /end COMPU_METHOD
/begin CHARACTERISTIC THstIBF_MAP_def "FaultConfig # THstIBF_MAP_def" VAL_BLK 0x001ECCD6 /* @ECU_Address@THstIBF_MAP_def@0x02673000@ */ ECIPP_ALIGNMENT_UWORD 256 Compu_THstIBF_MAP_def 0 255.99609375 MATRIX_DIM 5 1 1 /end CHARACTERISTIC
/begin COMPU_METHOD Compu_THstIBF_MAP_def " " RAT_FUNC "%.3" "MAP load (psia)" COEFFS 0 256 0 0 0 1 /end COMPU_METHOD
/begin MEASUREMENT THstIBF_MAP "General # THstIBF_MAP" UWORD Compu_THstIBF_MAP 0 0 0 255.99609375 ECU_ADDRESS 0x02674000 MATRIX_DIM 5 1 1 /end MEASUREMENT
/begin COMPU_METHOD Compu_THstIBF_MAP " " RAT_FUNC "%.1" "MAP load (psia)" COEFFS 0 256 0 0 0 1 /end COMPU_METHOD
/begin CHARACTERISTIC THstIBF_RPM_def "FaultConfig # THstIBF_RPM_def" VAL_BLK 0x001ECCE0 /* @ECU_Address@THstIBF_RPM_def@0x02675000@ */ ECIPP_ALIGNMENT_UWORD 65535 Compu_THstIBF_RPM_def 0 65535 MATRIX_DIM 6 1 1 /end CHARACTERISTIC
/begin COMPU_METHOD Compu_THstIBF_RPM_def " " RAT_FUNC "%.0" "-" COEFFS 0 1 0 0 0 1 /end COMPU_METHOD
/begin MEASUREMENT THstIBF_RPM "General # THstIBF_RPM" UWORD Compu_THstIBF_RPM 0 0 0 65535 ECU_ADDRESS 0x02676000 MATRIX_DIM 6 1 1 /end MEASUREMENT
/begin COMPU_METHOD Compu_THstIBF_RPM " " RAT_FUNC "%.0" "Speed (rpm)" COEFFS 0 1 0 0 0 1 /end COMPU_METHOD
/begin CHARACTERISTIC THrsIBF_hrs_def "FaultConfig # THrsIBF_hrs_def" VAL_BLK 0x001E5808 /* @ECU_Address@THrsIBF_hrs_def@0x02679000@ */ ECIPP_ALIGNMENT_UWORD 65535 Compu_THrsIBF_hrs_def 0 65535 MATRIX_DIM 4 1 1 /end CHARACTERISTIC
/begin COMPU_METHOD Compu_THrsIBF_hrs_def " " RAT_FUNC "%.0" "-" COEFFS 0 1 0 0 0 1 /end COMPU_METHOD
/begin MEASUREMENT THrsIBF_hrs "General # THrsIBF_hrs" UWORD Compu_THrsIBF_hrs 0 0 0 65535 ECU_ADDRESS 0x0267A000 MATRIX_DIM 4 1 1 /end MEASUREMENT
/begin COMPU_METHOD Compu_THrsIBF_hrs " " RAT_FUNC "%.0" "Time (hours)" COEFFS 0 1 0 0 0 1 /end COMPU_METHOD
/begin CHARACTERISTIC TTM_IRVA_pct "Air # TTM_IRVA_pct" VAL_BLK 0x001C0218 /* @ECU_Address@TTM_IRVA_pct@0x02681000@ */ ECIPP_ALIGNMENT_FLOAT32_IEEE 10000000000 Compu_TTM_IRVA_pct -10000000000 10000000000 MATRIX_DIM 16 1 1 /end CHARACTERISTIC
/begin COMPU_METHOD Compu_TTM_IRVA_pct " " RAT_FUNC "%.3" "(%)" COEFFS 0 0.01 0 0 0 1 /end COMPU_METHOD
/begin CHARACTERISTIC TTM_IRVA_A "Air # TTM_IRVA_A" VAL_BLK 0x001C01D8 /* @ECU_Address@TTM_IRVA_A@0x02682000@ */ ECIPP_ALIGNMENT_FLOAT32_IEEE 10000000000 Compu_TTM_IRVA_A -10000000000 10000000000 MATRIX_DIM 16 1 1 /end CHARACTERISTIC
/begin COMPU_METHOD Compu_TTM_IRVA_A " " RAT_FUNC "%.3" "(in^2)" COEFFS 0 1 0 0 0 1 /end COMPU_METHOD
/begin CHARACTERISTIC TEGRad_in2pct_max_f "Air # TEGRad_in2pct_max_f" VAL_BLK 0x001C0178 /* @ECU_Address@TEGRad_in2pct_max_f@0x02689000@ */ ECIPP_ALIGNMENT_FLOAT32_IEEE 10000000000 Compu_TEGRad_in2pct_max_f -10000000000 10000000000 MATRIX_DIM 6 1 1 /end CHARACTERISTIC
/begin COMPU_METHOD Compu_TEGRad_in2pct_max_f " " RAT_FUNC "%.3" "100%)" COEFFS 0 1 0 0 0 1 /end COMPU_METHOD
/begin CHARACTERISTIC HstSL_Tbl_load_cmddf "FaultConfig # HstSL_Tbl_load_cmddf" VAL_BLK 0x001ECD10 /* @ECU_Address@HstSL_Tbl_load_cmddf@0x0268F000@ */ ECIPP_ALIGNMENT_UWORD 100 Compu_HstSL_Tbl_load_cmddf 0 99.9984741210938 MATRIX_DIM 6 1 1 /end CHARACTERISTIC
/begin COMPU_METHOD Compu_HstSL_Tbl_load_cmddf " " RAT_FUNC "%.3" "Load command (%)" COEFFS 0 655.36 0 0 0 1 /end COMPU_METHOD
/begin CHARACTERISTIC TCDdur_Vbat "General # TCDdur_Vbat" VAL_BLK 0x001ECE88 /* @ECU_Address@TCDdur_Vbat@0x02693000@ */ ECIPP_ALIGNMENT_SWORD 128 Compu_TCDdur_Vbat -128 127.99609375 MATRIX_DIM 8 1 1 /end CHARACTERISTIC
/begin COMPU_METHOD Compu_TCDdur_Vbat " " RAT_FUNC "%.3" "volts" COEFFS 0 256 0 0 0 1 /end COMPU_METHOD
/begin CHARACTERISTIC TCDdur_180V "General # TCDdur_180V" VAL_BLK 0x001ECE58 /* @ECU_Address@TCDdur_180V@0x02694000@ */ ECIPP_ALIGNMENT_SWORD 128 Compu_TCDdur_180V -128 127.99609375 MATRIX_DIM 8 1 1 /end CHARACTERISTIC
/begin COMPU_METHOD Compu_TCDdur_180V " " RAT_FUNC "%.3" "ms" COEFFS 0 256 0 0 0 1 /end COMPU_METHOD
/begin CHARACTERISTIC TCDdur_230V "General # TCDdur_230V" VAL_BLK 0x001ECE68 /* @ECU_Address@TCDdur_230V@0x02695000@ */ ECIPP_ALIGNMENT_SWORD 128 Compu_TCDdur_230V -128 127.99609375 MATRIX_DIM 8 1 1 /end CHARACTERISTIC
/begin COMPU_METHOD Compu_TCDdur_230V " " RAT_FUNC "%.3" "ms" COEFFS 0 256 0 0 0 1 /end COMPU_METHOD
/begin CHARACTERISTIC TCDdur_290V "General # TCDdur_290V" VAL_BLK 0x001ECE78 /* @ECU_Address@TCDdur_290V@0x02696000@ */ ECIPP_ALIGNMENT_SWORD 128 Compu_TCDdur_290V -128 127.99609375 MATRIX_DIM 8 1 1 /end CHARACTERISTIC
/begin COMPU_METHOD Compu_TCDdur_290V " " RAT_FUNC "%.3" "ms" COEFFS 0 256 0 0 0 1 /end COMPU_METHOD
/begin CHARACTERISTIC TMF_KVspkadv "General # TMF_KVspkadv" VAL_BLK 0x001ECE98 /* @ECU_Address@TMF_KVspkadv@0x0269A000@ */ ECIPP_ALIGNMENT_SWORD 2048 Compu_TMF_KVspkadv -2048 2047.9375 MATRIX_DIM 8 1 1 /end CHARACTERISTIC
/begin COMPU_METHOD Compu_TMF_KVspkadv " " RAT_FUNC "%.3" "(CAD)" COEFFS 0 16 0 0 0 1 /end COMPU_METHOD
/begin CHARACTERISTIC TMF_deltaKV "General # TMF_deltaKV" VAL_BLK 0x001ECEA8 /* @ECU_Address@TMF_deltaKV@0x0269B000@ */ ECIPP_ALIGNMENT_SWORD 66 Compu_TMF_deltaKV -65.536 65.534 MATRIX_DIM 8 1 1 /end CHARACTERISTIC
/begin COMPU_METHOD Compu_TMF_deltaKV " " RAT_FUNC "%.3" "KV" COEFFS 0 500 0 0 0 1 /end COMPU_METHOD
/begin CHARACTERISTIC TMF_deltaKV2 "General # TMF_deltaKV2" VAL_BLK 0x001ECEB8 /* @ECU_Address@TMF_deltaKV2@0x0269C000@ */ ECIPP_ALIGNMENT_SWORD 66 Compu_TMF_deltaKV2 -65.536 65.534 MATRIX_DIM 8 1 1 /end CHARACTERISTIC
/begin COMPU_METHOD Compu_TMF_deltaKV2 " " RAT_FUNC "%.3" "KV2" COEFFS 0 500 0 0 0 1 /end COMPU_METHOD
/begin CHARACTERISTIC TCD_MFexpected "General # TCD_MFexpected" VAL_BLK 0x001ECDB8 /* @ECU_Address@TCD_MFexpected@0x0269D000@ */ ECIPP_ALIGNMENT_SWORD 66 Compu_TCD_MFexpected -65.536 65.534 MATRIX_DIM 64 1 1 /end CHARACTERISTIC
/begin COMPU_METHOD Compu_TCD_MFexpected "" RAT_FUNC "%.3" "-" COEFFS 0 500 0 0 0 1 /end COMPU_METHOD
/begin CHARACTERISTIC TCD_MFexpected_RPM "General # TCD_MFexpected_RPM" VAL_BLK 0x001ECE48 /* @ECU_Address@TCD_MFexpected_RPM@0x0269E000@ */ ECIPP_ALIGNMENT_SWORD 32767 Compu_TCD_MFexpected_RPM -32768 32767 MATRIX_DIM 8 1 1 /end CHARACTERISTIC
/begin COMPU_METHOD Compu_TCD_MFexpected_RPM " " RAT_FUNC "%.0" "-" COEFFS 0 1 0 0 0 1 /end COMPU_METHOD
/begin CHARACTERISTIC TCD_MFexpected_MAP "General # TCD_MFexpected_MAP" VAL_BLK 0x001ECE38 /* @ECU_Address@TCD_MFexpected_MAP@0x0269F000@ */ ECIPP_ALIGNMENT_SWORD 128 Compu_TCD_MFexpected_MAP -128 127.99609375 MATRIX_DIM 8 1 1 /end CHARACTERISTIC
/begin COMPU_METHOD Compu_TCD_MFexpected_MAP " " RAT_FUNC "%.3" "-" COEFFS 0 256 0 0 0 1 /end COMPU_METHOD
/begin CHARACTERISTIC STR_DID_0xF180 "General # STR_DID_0xF180" ASCII 0x001C89B1 /* @ECU_Address@STR_DID_0xF180@0x026B8000@ */ ECIPP_ALIGNMENT_UBYTE 255 Compu_ECIPP_STRINGS 0 255 MATRIX_DIM 11 1 1 /end CHARACTERISTIC
/begin CHARACTERISTIC FCdc4_AL2_hi "FCtl_DTC_0x04(40)" VALUE 0x001E40E6 /* @ECU_Address@FCtl_DTC_0x04@0x024C4050@ */ ECIPP_ALIGNMENT_UWORD 65535 Compu_IDENTITY 0 65535 PHYS_UNIT "System ID + DTC" /end CHARACTERISTIC
/begin CHARACTERISTIC FCdc4_AL2_lo "FCtl_DTC_0x04(41)" VALUE 0x001E40E8 /* @ECU_Address@FCtl_DTC_0x04@0x024C4052@ */ ECIPP_ALIGNMENT_UWORD 65535 Compu_IDENTITY 0 65535 PHYS_UNIT "System ID + DTC" /end CHARACTERISTIC
/begin CHARACTERISTIC FCdc4_CD_MF10 "FCtl_DTC_0x04(994)" VALUE 0x001E485A /* @ECU_Address@FCtl_DTC_0x04@0x024C47C4@ */ ECIPP_ALIGNMENT_UWORD 65535 Compu_IDENTITY 0 65535 PHYS_UNIT "System ID + DTC" /end CHARACTERISTIC
/begin CHARACTERISTIC FCdc4_CD_MF11 "FCtl_DTC_0x04(995)" VALUE 0x001E485C /* @ECU_Address@FCtl_DTC_0x04@0x024C47C6@ */ ECIPP_ALIGNMENT_UWORD 65535 Compu_IDENTITY 0 65535 PHYS_UNIT "System ID + DTC" /end CHARACTERISTIC
/begin CHARACTERISTIC FCdc4_CD_MF12 "FCtl_DTC_0x04(996)" VALUE 0x001E485E /* @ECU_Address@FCtl_DTC_0x04@0x024C47C8@ */ ECIPP_ALIGNMENT_UWORD 65535 Compu_IDENTITY 0 65535 PHYS_UNIT "System ID + DTC" /end CHARACTERISTIC
/begin CHARACTERISTIC FCdc4_CD_MF2 "FCtl_DTC_0x04(986)" VALUE 0x001E484A /* @ECU_Address@FCtl_DTC_0x04@0x024C47B4@ */ ECIPP_ALIGNMENT_UWORD 65535 Compu_IDENTITY 0 65535 PHYS_UNIT "System ID + DTC" /end CHARACTERISTIC
/begin CHARACTERISTIC FCdc4_CD_MF3 "FCtl_DTC_0x04(987)" VALUE 0x001E484C /* @ECU_Address@FCtl_DTC_0x04@0x024C47B6@ */ ECIPP_ALIGNMENT_UWORD 65535 Compu_IDENTITY 0 65535 PHYS_UNIT "System ID + DTC" /end CHARACTERISTIC
/begin CHARACTERISTIC FCdc4_CD_MF4 "FCtl_DTC_0x04(988)" VALUE 0x001E484E /* @ECU_Address@FCtl_DTC_0x04@0x024C47B8@ */ ECIPP_ALIGNMENT_UWORD 65535 Compu_IDENTITY 0 65535 PHYS_UNIT "System ID + DTC" /end CHARACTERISTIC
/begin CHARACTERISTIC FCdc4_CD_MF5 "FCtl_DTC_0x04(989)" VALUE 0x001E4850 /* @ECU_Address@FCtl_DTC_0x04@0x024C47BA@ */ ECIPP_ALIGNMENT_UWORD 65535 Compu_IDENTITY 0 65535 PHYS_UNIT "System ID + DTC" /end CHARACTERISTIC
/begin CHARACTERISTIC FCdc4_CD_MF6 "FCtl_DTC_0x04(990)" VALUE 0x001E4852 /* @ECU_Address@FCtl_DTC_0x04@0x024C47BC@ */ ECIPP_ALIGNMENT_UWORD 65535 Compu_IDENTITY 0 65535 PHYS_UNIT "System ID + DTC" /end CHARACTERISTIC
/begin CHARACTERISTIC FCdc4_CD_MF7 "FCtl_DTC_0x04(991)" VALUE 0x001E4854 /* @ECU_Address@FCtl_DTC_0x04@0x024C47BE@ */ ECIPP_ALIGNMENT_UWORD 65535 Compu_IDENTITY 0 65535 PHYS_UNIT "System ID + DTC" /end CHARACTERISTIC
/begin CHARACTERISTIC FCdc4_CD_MF8 "FCtl_DTC_0x04(992)" VALUE 0x001E4856 /* @ECU_Address@FCtl_DTC_0x04@0x024C47C0@ */ ECIPP_ALIGNMENT_UWORD 65535 Compu_IDENTITY 0 65535 PHYS_UNIT "System ID + DTC" /end CHARACTERISTIC
/begin CHARACTERISTIC FCdc4_CD_MF9 "FCtl_DTC_0x04(993)" VALUE 0x001E4858 /* @ECU_Address@FCtl_DTC_0x04@0x024C47C2@ */ ECIPP_ALIGNMENT_UWORD 65535 Compu_IDENTITY 0 65535 PHYS_UNIT "System ID + DTC" /end CHARACTERISTIC
/begin CHARACTERISTIC FCdc4_CFVxminFT "FCtl_DTC_0x04(533)" VALUE 0x001E44C0 /* @ECU_Address@FCtl_DTC_0x04@0x024C442A@ */ ECIPP_ALIGNMENT_UWORD 65535 Compu_IDENTITY 0 65535 PHYS_UNIT "System ID + DTC" /end CHARACTERISTIC
/begin CHARACTERISTIC FCdc4_CL2_hi "FCtl_DTC_0x04(34)" VALUE 0x001E40DA /* @ECU_Address@FCtl_DTC_0x04@0x024C4044@ */ ECIPP_ALIGNMENT_UWORD 65535 Compu_IDENTITY 0 65535 PHYS_UNIT "System ID + DTC" /end CHARACTERISTIC
/begin CHARACTERISTIC FCdc4_CL2_lo "FCtl_DTC_0x04(35)" VALUE 0x001E40DC /* @ECU_Address@FCtl_DTC_0x04@0x024C4046@ */ ECIPP_ALIGNMENT_UWORD 65535 Compu_IDENTITY 0 65535 PHYS_UNIT "System ID + DTC" /end CHARACTERISTIC
/begin CHARACTERISTIC FCdc4_CM2_unresp "FCtl_DTC_0x04(800)" VALUE 0x001E46D6 /* @ECU_Address@FCtl_DTC_0x04@0x024C4640@ */ ECIPP_ALIGNMENT_UWORD 65535 Compu_IDENTITY 0 65535 PHYS_UNIT "System ID + DTC" /end CHARACTERISTIC
/begin CHARACTERISTIC FCdc4_CM2gsln_inact "FCtl_DTC_0x04(199)" VALUE 0x001E4224 /* @ECU_Address@FCtl_DTC_0x04@0x024C418E@ */ ECIPP_ALIGNMENT_UWORD 65535 Compu_IDENTITY 0 65535 PHYS_UNIT "System ID + DTC" /end CHARACTERISTIC
/begin CHARACTERISTIC FCdc4_EGO4_open "FCtl_DTC_0x04(200)" VALUE 0x001E4226 /* @ECU_Address@FCtl_DTC_0x04@0x024C4190@ */ ECIPP_ALIGNMENT_UWORD 65535 Compu_IDENTITY 0 65535 PHYS_UNIT "System ID + DTC" /end CHARACTERISTIC
/begin CHARACTERISTIC FCdc4_EMWT2_HiExp1 "FCtl_DTC_0x04(226)" VALUE 0x001E425A /* @ECU_Address@FCtl_DTC_0x04@0x024C41C4@ */ ECIPP_ALIGNMENT_UWORD 65535 Compu_IDENTITY 0 65535 PHYS_UNIT "System ID + DTC" /end CHARACTERISTIC
/begin CHARACTERISTIC FCdc4_EMWT2_HiExp2 "FCtl_DTC_0x04(228)" VALUE 0x001E425E /* @ECU_Address@FCtl_DTC_0x04@0x024C41C8@ */ ECIPP_ALIGNMENT_UWORD 65535 Compu_IDENTITY 0 65535 PHYS_UNIT "System ID + DTC" /end CHARACTERISTIC
/begin CHARACTERISTIC FCdc4_EMWT2_maxv "FCtl_DTC_0x04(222)" VALUE 0x001E4252 /* @ECU_Address@FCtl_DTC_0x04@0x024C41BC@ */ ECIPP_ALIGNMENT_UWORD 65535 Compu_IDENTITY 0 65535 PHYS_UNIT "System ID + DTC" /end CHARACTERISTIC
/begin CHARACTERISTIC FCdc4_EMWT2_minv "FCtl_DTC_0x04(224)" VALUE 0x001E4256 /* @ECU_Address@FCtl_DTC_0x04@0x024C41C0@ */ ECIPP_ALIGNMENT_UWORD 65535 Compu_IDENTITY 0 65535 PHYS_UNIT "System ID + DTC" /end CHARACTERISTIC
/begin CHARACTERISTIC FCdc4_ERWT2_HiExp1 "FCtl_DTC_0x04(238)" VALUE 0x001E4272 /* @ECU_Address@FCtl_DTC_0x04@0x024C41DC@ */ ECIPP_ALIGNMENT_UWORD 65535 Compu_IDENTITY 0 65535 PHYS_UNIT "System ID + DTC" /end CHARACTERISTIC
/begin CHARACTERISTIC FCdc4_ERWT2_HiExp2 "FCtl_DTC_0x04(240)" VALUE 0x001E4276 /* @ECU_Address@FCtl_DTC_0x04@0x024C41E0@ */ ECIPP_ALIGNMENT_UWORD 65535 Compu_IDENTITY 0 65535 PHYS_UNIT "System ID + DTC" /end CHARACTERISTIC
/begin CHARACTERISTIC FCdc4_ERWT2_maxv "FCtl_DTC_0x04(234)" VALUE 0x001E426A /* @ECU_Address@FCtl_DTC_0x04@0x024C41D4@ */ ECIPP_ALIGNMENT_UWORD 65535 Compu_IDENTITY 0 65535 PHYS_UNIT "System ID + DTC" /end CHARACTERISTIC
/begin CHARACTERISTIC FCdc4_ERWT2_minv "FCtl_DTC_0x04(236)" VALUE 0x001E426E /* @ECU_Address@FCtl_DTC_0x04@0x024C41D8@ */ ECIPP_ALIGNMENT_UWORD 65535 Compu_IDENTITY 0 65535 PHYS_UNIT "System ID + DTC" /end CHARACTERISTIC
/begin CHARACTERISTIC FCdc4_GLOW10_open "FCtl_DTC_0x04(492)" VALUE 0x001E446E /* @ECU_Address@FCtl_DTC_0x04@0x024C43D8@ */ ECIPP_ALIGNMENT_UWORD 65535 Compu_IDENTITY 0 65535 PHYS_UNIT "System ID + DTC" /end CHARACTERISTIC
/begin CHARACTERISTIC FCdc4_GLOW10_short "FCtl_DTC_0x04(502)" VALUE 0x001E4482 /* @ECU_Address@FCtl_DTC_0x04@0x024C43EC@ */ ECIPP_ALIGNMENT_UWORD 65535 Compu_IDENTITY 0 65535 PHYS_UNIT "System ID + DTC" /end CHARACTERISTIC
/begin CHARACTERISTIC FCdc4_GLOW11_open "FCtl_DTC_0x04(1033)" VALUE 0x001E48A8 /* @ECU_Address@FCtl_DTC_0x04@0x024C4812@ */ ECIPP_ALIGNMENT_UWORD 65535 Compu_IDENTITY 0 65535 PHYS_UNIT "System ID + DTC" /end CHARACTERISTIC
/begin CHARACTERISTIC FCdc4_GLOW11_short "FCtl_DTC_0x04(1035)" VALUE 0x001E48AC /* @ECU_Address@FCtl_DTC_0x04@0x024C4816@ */ ECIPP_ALIGNMENT_UWORD 65535 Compu_IDENTITY 0 65535 PHYS_UNIT "System ID + DTC" /end CHARACTERISTIC
/begin CHARACTERISTIC FCdc4_GLOW12_open "FCtl_DTC_0x04(1034)" VALUE 0x001E48AA /* @ECU_Address@FCtl_DTC_0x04@0x024C4814@ */ ECIPP_ALIGNMENT_UWORD 65535 Compu_IDENTITY 0 65535 PHYS_UNIT "System ID + DTC" /end CHARACTERISTIC
/begin CHARACTERISTIC FCdc4_GLOW12_short "FCtl_DTC_0x04(1036)" VALUE 0x001E48AE /* @ECU_Address@FCtl_DTC_0x04@0x024C4818@ */ ECIPP_ALIGNMENT_UWORD 65535 Compu_IDENTITY 0 65535 PHYS_UNIT "System ID + DTC" /end CHARACTERISTIC
/begin CHARACTERISTIC FCdc4_GLOW2_open "FCtl_DTC_0x04(484)" VALUE 0x001E445E /* @ECU_Address@FCtl_DTC_0x04@0x024C43C8@ */ ECIPP_ALIGNMENT_UWORD 65535 Compu_IDENTITY 0 65535 PHYS_UNIT "System ID + DTC" /end CHARACTERISTIC
/begin CHARACTERISTIC FCdc4_GLOW2_short "FCtl_DTC_0x04(494)" VALUE 0x001E4472 /* @ECU_Address@FCtl_DTC_0x04@0x024C43DC@ */ ECIPP_ALIGNMENT_UWORD 65535 Compu_IDENTITY 0 65535 PHYS_UNIT "System ID + DTC" /end CHARACTERISTIC
/begin CHARACTERISTIC FCdc4_GLOW3_open "FCtl_DTC_0x04(485)" VALUE 0x001E4460 /* @ECU_Address@FCtl_DTC_0x04@0x024C43CA@ */ ECIPP_ALIGNMENT_UWORD 65535 Compu_IDENTITY 0 65535 PHYS_UNIT "System ID + DTC" /end CHARACTERISTIC
/begin CHARACTERISTIC FCdc4_GLOW3_short "FCtl_DTC_0x04(495)" VALUE 0x001E4474 /* @ECU_Address@FCtl_DTC_0x04@0x024C43DE@ */ ECIPP_ALIGNMENT_UWORD 65535 Compu_IDENTITY 0 65535 PHYS_UNIT "System ID + DTC" /end CHARACTERISTIC
/begin CHARACTERISTIC FCdc4_GLOW4_open "FCtl_DTC_0x04(486)" VALUE 0x001E4462 /* @ECU_Address@FCtl_DTC_0x04@0x024C43CC@ */ ECIPP_ALIGNMENT_UWORD 65535 Compu_IDENTITY 0 65535 PHYS_UNIT "System ID + DTC" /end CHARACTERISTIC
/begin CHARACTERISTIC FCdc4_GLOW4_short "FCtl_DTC_0x04(496)" VALUE 0x001E4476 /* @ECU_Address@FCtl_DTC_0x04@0x024C43E0@ */ ECIPP_ALIGNMENT_UWORD 65535 Compu_IDENTITY 0 65535 PHYS_UNIT "System ID + DTC" /end CHARACTERISTIC
/begin CHARACTERISTIC FCdc4_GLOW5_open "FCtl_DTC_0x04(487)" VALUE 0x001E4464 /* @ECU_Address@FCtl_DTC_0x04@0x024C43CE@ */ ECIPP_ALIGNMENT_UWORD 65535 Compu_IDENTITY 0 65535 PHYS_UNIT "System ID + DTC" /end CHARACTERISTIC
/begin CHARACTERISTIC FCdc4_GLOW5_short "FCtl_DTC_0x04(497)" VALUE 0x001E4478 /* @ECU_Address@FCtl_DTC_0x04@0x024C43E2@ */ ECIPP_ALIGNMENT_UWORD 65535 Compu_IDENTITY 0 65535 PHYS_UNIT "System ID + DTC" /end CHARACTERISTIC
/begin CHARACTERISTIC FCdc4_GLOW6_open "FCtl_DTC_0x04(488)" VALUE 0x001E4466 /* @ECU_Address@FCtl_DTC_0x04@0x024C43D0@ */ ECIPP_ALIGNMENT_UWORD 65535 Compu_IDENTITY 0 65535 PHYS_UNIT "System ID + DTC" /end CHARACTERISTIC
/begin CHARACTERISTIC FCdc4_GLOW6_short "FCtl_DTC_0x04(498)" VALUE 0x001E447A /* @ECU_Address@FCtl_DTC_0x04@0x024C43E4@ */ ECIPP_ALIGNMENT_UWORD 65535 Compu_IDENTITY 0 65535 PHYS_UNIT "System ID + DTC" /end CHARACTERISTIC
/begin CHARACTERISTIC FCdc4_GLOW7_open "FCtl_DTC_0x04(489)" VALUE 0x001E4468 /* @ECU_Address@FCtl_DTC_0x04@0x024C43D2@ */ ECIPP_ALIGNMENT_UWORD 65535 Compu_IDENTITY 0 65535 PHYS_UNIT "System ID + DTC" /end CHARACTERISTIC
/begin CHARACTERISTIC FCdc4_GLOW7_short "FCtl_DTC_0x04(499)" VALUE 0x001E447C /* @ECU_Address@FCtl_DTC_0x04@0x024C43E6@ */ ECIPP_ALIGNMENT_UWORD 65535 Compu_IDENTITY 0 65535 PHYS_UNIT "System ID + DTC" /end CHARACTERISTIC
/begin CHARACTERISTIC FCdc4_GLOW8_open "FCtl_DTC_0x04(490)" VALUE 0x001E446A /* @ECU_Address@FCtl_DTC_0x04@0x024C43D4@ */ ECIPP_ALIGNMENT_UWORD 65535 Compu_IDENTITY 0 65535 PHYS_UNIT "System ID + DTC" /end CHARACTERISTIC
/begin CHARACTERISTIC FCdc4_GLOW8_short "FCtl_DTC_0x04(500)" VALUE 0x001E447E /* @ECU_Address@FCtl_DTC_0x04@0x024C43E8@ */ ECIPP_ALIGNMENT_UWORD 65535 Compu_IDENTITY 0 65535 PHYS_UNIT "System ID + DTC" /end CHARACTERISTIC
/begin CHARACTERISTIC FCdc4_GLOW9_open "FCtl_DTC_0x04(491)" VALUE 0x001E446C /* @ECU_Address@FCtl_DTC_0x04@0x024C43D6@ */ ECIPP_ALIGNMENT_UWORD 65535 Compu_IDENTITY 0 65535 PHYS_UNIT "System ID + DTC" /end CHARACTERISTIC
/begin CHARACTERISTIC FCdc4_GLOW9_short "FCtl_DTC_0x04(501)" VALUE 0x001E4480 /* @ECU_Address@FCtl_DTC_0x04@0x024C43EA@ */ ECIPP_ALIGNMENT_UWORD 65535 Compu_IDENTITY 0 65535 PHYS_UNIT "System ID + DTC" /end CHARACTERISTIC
/begin CHARACTERISTIC FCdc4_ICAVD10_mis "FCtl_DTC_0x04(315)" VALUE 0x001E430C /* @ECU_Address@FCtl_DTC_0x04@0x024C4276@ */ ECIPP_ALIGNMENT_UWORD 65535 Compu_IDENTITY 0 65535 PHYS_UNIT "System ID + DTC" /end CHARACTERISTIC
/begin CHARACTERISTIC FCdc4_ICAVD10_miscat "FCtl_DTC_0x04(317)" VALUE 0x001E4310 /* @ECU_Address@FCtl_DTC_0x04@0x024C427A@ */ ECIPP_ALIGNMENT_UWORD 65535 Compu_IDENTITY 0 65535 PHYS_UNIT "System ID + DTC" /end CHARACTERISTIC
/begin CHARACTERISTIC FCdc4_ICAVD11_mis "FCtl_DTC_0x04(1029)" VALUE 0x001E48A0 /* @ECU_Address@FCtl_DTC_0x04@0x024C480A@ */ ECIPP_ALIGNMENT_UWORD 65535 Compu_IDENTITY 0 65535 PHYS_UNIT "System ID + DTC" /end CHARACTERISTIC
/begin CHARACTERISTIC FCdc4_ICAVD11_miscat "FCtl_DTC_0x04(1031)" VALUE 0x001E48A4 /* @ECU_Address@FCtl_DTC_0x04@0x024C480E@ */ ECIPP_ALIGNMENT_UWORD 65535 Compu_IDENTITY 0 65535 PHYS_UNIT "System ID + DTC" /end CHARACTERISTIC
/begin CHARACTERISTIC FCdc4_ICAVD12_mis "FCtl_DTC_0x04(1030)" VALUE 0x001E48A2 /* @ECU_Address@FCtl_DTC_0x04@0x024C480C@ */ ECIPP_ALIGNMENT_UWORD 65535 Compu_IDENTITY 0 65535 PHYS_UNIT "System ID + DTC" /end CHARACTERISTIC
/begin CHARACTERISTIC FCdc4_ICAVD12_miscat "FCtl_DTC_0x04(1032)" VALUE 0x001E48A6 /* @ECU_Address@FCtl_DTC_0x04@0x024C4810@ */ ECIPP_ALIGNMENT_UWORD 65535 Compu_IDENTITY 0 65535 PHYS_UNIT "System ID + DTC" /end CHARACTERISTIC
/begin CHARACTERISTIC FCdc4_ICAVD2_mis "FCtl_DTC_0x04(260)" VALUE 0x001E429E /* @ECU_Address@FCtl_DTC_0x04@0x024C4208@ */ ECIPP_ALIGNMENT_UWORD 65535 Compu_IDENTITY 0 65535 PHYS_UNIT "System ID + DTC" /end CHARACTERISTIC
/begin CHARACTERISTIC FCdc4_ICAVD2_miscat "FCtl_DTC_0x04(268)" VALUE 0x001E42AE /* @ECU_Address@FCtl_DTC_0x04@0x024C4218@ */ ECIPP_ALIGNMENT_UWORD 65535 Compu_IDENTITY 0 65535 PHYS_UNIT "System ID + DTC" /end CHARACTERISTIC
/begin CHARACTERISTIC FCdc4_ICAVD3_mis "FCtl_DTC_0x04(261)" VALUE 0x001E42A0 /* @ECU_Address@FCtl_DTC_0x04@0x024C420A@ */ ECIPP_ALIGNMENT_UWORD 65535 Compu_IDENTITY 0 65535 PHYS_UNIT "System ID + DTC" /end CHARACTERISTIC
/begin CHARACTERISTIC FCdc4_ICAVD3_miscat "FCtl_DTC_0x04(269)" VALUE 0x001E42B0 /* @ECU_Address@FCtl_DTC_0x04@0x024C421A@ */ ECIPP_ALIGNMENT_UWORD 65535 Compu_IDENTITY 0 65535 PHYS_UNIT "System ID + DTC" /end CHARACTERISTIC
/begin CHARACTERISTIC FCdc4_ICAVD4_mis "FCtl_DTC_0x04(262)" VALUE 0x001E42A2 /* @ECU_Address@FCtl_DTC_0x04@0x024C420C@ */ ECIPP_ALIGNMENT_UWORD 65535 Compu_IDENTITY 0 65535 PHYS_UNIT "System ID + DTC" /end CHARACTERISTIC
/begin CHARACTERISTIC FCdc4_ICAVD4_miscat "FCtl_DTC_0x04(270)" VALUE 0x001E42B2 /* @ECU_Address@FCtl_DTC_0x04@0x024C421C@ */ ECIPP_ALIGNMENT_UWORD 65535 Compu_IDENTITY 0 65535 PHYS_UNIT "System ID + DTC" /end CHARACTERISTIC
/begin CHARACTERISTIC FCdc4_ICAVD5_mis "FCtl_DTC_0x04(263)" VALUE 0x001E42A4 /* @ECU_Address@FCtl_DTC_0x04@0x024C420E@ */ ECIPP_ALIGNMENT_UWORD 65535 Compu_IDENTITY 0 65535 PHYS_UNIT "System ID + DTC" /end CHARACTERISTIC
/begin CHARACTERISTIC FCdc4_ICAVD5_miscat "FCtl_DTC_0x04(271)" VALUE 0x001E42B4 /* @ECU_Address@FCtl_DTC_0x04@0x024C421E@ */ ECIPP_ALIGNMENT_UWORD 65535 Compu_IDENTITY 0 65535 PHYS_UNIT "System ID + DTC" /end CHARACTERISTIC
/begin CHARACTERISTIC FCdc4_ICAVD6_mis "FCtl_DTC_0x04(264)" VALUE 0x001E42A6 /* @ECU_Address@FCtl_DTC_0x04@0x024C4210@ */ ECIPP_ALIGNMENT_UWORD 65535 Compu_IDENTITY 0 65535 PHYS_UNIT "System ID + DTC" /end CHARACTERISTIC
/begin CHARACTERISTIC FCdc4_ICAVD6_miscat "FCtl_DTC_0x04(272)" VALUE 0x001E42B6 /* @ECU_Address@FCtl_DTC_0x04@0x024C4220@ */ ECIPP_ALIGNMENT_UWORD 65535 Compu_IDENTITY 0 65535 PHYS_UNIT "System ID + DTC" /end CHARACTERISTIC
/begin CHARACTERISTIC FCdc4_ICAVD7_mis "FCtl_DTC_0x04(265)" VALUE 0x001E42A8 /* @ECU_Address@FCtl_DTC_0x04@0x024C4212@ */ ECIPP_ALIGNMENT_UWORD 65535 Compu_IDENTITY 0 65535 PHYS_UNIT "System ID + DTC" /end CHARACTERISTIC
/begin CHARACTERISTIC FCdc4_ICAVD7_miscat "FCtl_DTC_0x04(273)" VALUE 0x001E42B8 /* @ECU_Address@FCtl_DTC_0x04@0x024C4222@ */ ECIPP_ALIGNMENT_UWORD 65535 Compu_IDENTITY 0 65535 PHYS_UNIT "System ID + DTC" /end CHARACTERISTIC
/begin CHARACTERISTIC FCdc4_ICAVD8_mis "FCtl_DTC_0x04(266)" VALUE 0x001E42AA /* @ECU_Address@FCtl_DTC_0x04@0x024C4214@ */ ECIPP_ALIGNMENT_UWORD 65535 Compu_IDENTITY 0 65535 PHYS_UNIT "System ID + DTC" /end CHARACTERISTIC
/begin CHARACTERISTIC FCdc4_ICAVD8_miscat "FCtl_DTC_0x04(274)" VALUE 0x001E42BA /* @ECU_Address@FCtl_DTC_0x04@0x024C4224@ */ ECIPP_ALIGNMENT_UWORD 65535 Compu_IDENTITY 0 65535 PHYS_UNIT "System ID + DTC" /end CHARACTERISTIC
/begin CHARACTERISTIC FCdc4_ICAVD9_mis "FCtl_DTC_0x04(314)" VALUE 0x001E430A /* @ECU_Address@FCtl_DTC_0x04@0x024C4274@ */ ECIPP_ALIGNMENT_UWORD 65535 Compu_IDENTITY 0 65535 PHYS_UNIT "System ID + DTC" /end CHARACTERISTIC
/begin CHARACTERISTIC FCdc4_ICAVD9_miscat "FCtl_DTC_0x04(316)" VALUE 0x001E430E /* @ECU_Address@FCtl_DTC_0x04@0x024C4278@ */ ECIPP_ALIGNMENT_UWORD 65535 Compu_IDENTITY 0 65535 PHYS_UNIT "System ID + DTC" /end CHARACTERISTIC
/begin CHARACTERISTIC FCdc4_INJD10_off_lo "FCtl_DTC_0x04(55)" VALUE 0x001E4104 /* @ECU_Address@FCtl_DTC_0x04@0x024C406E@ */ ECIPP_ALIGNMENT_UWORD 65535 Compu_IDENTITY 0 65535 PHYS_UNIT "System ID + DTC" /end CHARACTERISTIC
/begin CHARACTERISTIC FCdc4_INJD10_on_hi "FCtl_DTC_0x04(65)" VALUE 0x001E4118 /* @ECU_Address@FCtl_DTC_0x04@0x024C4082@ */ ECIPP_ALIGNMENT_UWORD 65535 Compu_IDENTITY 0 65535 PHYS_UNIT "System ID + DTC" /end CHARACTERISTIC
/begin CHARACTERISTIC FCdc4_INJD11_off_lo "FCtl_DTC_0x04(1017)" VALUE 0x001E4888 /* @ECU_Address@FCtl_DTC_0x04@0x024C47F2@ */ ECIPP_ALIGNMENT_UWORD 65535 Compu_IDENTITY 0 65535 PHYS_UNIT "System ID + DTC" /end CHARACTERISTIC
/begin CHARACTERISTIC FCdc4_INJD11_on_hi "FCtl_DTC_0x04(1019)" VALUE 0x001E488C /* @ECU_Address@FCtl_DTC_0x04@0x024C47F6@ */ ECIPP_ALIGNMENT_UWORD 65535 Compu_IDENTITY 0 65535 PHYS_UNIT "System ID + DTC" /end CHARACTERISTIC
/begin CHARACTERISTIC FCdc4_INJD12_off_lo "FCtl_DTC_0x04(1018)" VALUE 0x001E488A /* @ECU_Address@FCtl_DTC_0x04@0x024C47F4@ */ ECIPP_ALIGNMENT_UWORD 65535 Compu_IDENTITY 0 65535 PHYS_UNIT "System ID + DTC" /end CHARACTERISTIC
/begin CHARACTERISTIC FCdc4_INJD12_on_hi "FCtl_DTC_0x04(1020)" VALUE 0x001E488E /* @ECU_Address@FCtl_DTC_0x04@0x024C47F8@ */ ECIPP_ALIGNMENT_UWORD 65535 Compu_IDENTITY 0 65535 PHYS_UNIT "System ID + DTC" /end CHARACTERISTIC
/begin CHARACTERISTIC FCdc4_INJD2_boost_lo "FCtl_DTC_0x04(579)" VALUE 0x001E451C /* @ECU_Address@FCtl_DTC_0x04@0x024C4486@ */ ECIPP_ALIGNMENT_UWORD 65535 Compu_IDENTITY 0 65535 PHYS_UNIT "System ID + DTC" /end CHARACTERISTIC
/begin CHARACTERISTIC FCdc4_INJD2_HS_Ihi "FCtl_DTC_0x04(563)" VALUE 0x001E44FC /* @ECU_Address@FCtl_DTC_0x04@0x024C4466@ */ ECIPP_ALIGNMENT_UWORD 65535 Compu_IDENTITY 0 65535 PHYS_UNIT "System ID + DTC" /end CHARACTERISTIC
/begin CHARACTERISTIC FCdc4_INJD2_HW_int "FCtl_DTC_0x04(581)" VALUE 0x001E4520 /* @ECU_Address@FCtl_DTC_0x04@0x024C448A@ */ ECIPP_ALIGNMENT_UWORD 65535 Compu_IDENTITY 0 65535 PHYS_UNIT "System ID + DTC" /end CHARACTERISTIC
/begin CHARACTERISTIC FCdc4_INJD2_LS_Ihi "FCtl_DTC_0x04(571)" VALUE 0x001E450C /* @ECU_Address@FCtl_DTC_0x04@0x024C4476@ */ ECIPP_ALIGNMENT_UWORD 65535 Compu_IDENTITY 0 65535 PHYS_UNIT "System ID + DTC" /end CHARACTERISTIC
/begin CHARACTERISTIC FCdc4_INJD2_off_lo "FCtl_DTC_0x04(47)" VALUE 0x001E40F4 /* @ECU_Address@FCtl_DTC_0x04@0x024C405E@ */ ECIPP_ALIGNMENT_UWORD 65535 Compu_IDENTITY 0 65535 PHYS_UNIT "System ID + DTC" /end CHARACTERISTIC
/begin CHARACTERISTIC FCdc4_INJD2_on_hi "FCtl_DTC_0x04(57)" VALUE 0x001E4108 /* @ECU_Address@FCtl_DTC_0x04@0x024C4072@ */ ECIPP_ALIGNMENT_UWORD 65535 Compu_IDENTITY 0 65535 PHYS_UNIT "System ID + DTC" /end CHARACTERISTIC
/begin CHARACTERISTIC FCdc4_INJD3_HS_Ihi "FCtl_DTC_0x04(564)" VALUE 0x001E44FE /* @ECU_Address@FCtl_DTC_0x04@0x024C4468@ */ ECIPP_ALIGNMENT_UWORD 65535 Compu_IDENTITY 0 65535 PHYS_UNIT "System ID + DTC" /end CHARACTERISTIC
/begin CHARACTERISTIC FCdc4_INJD3_LS_Ihi "FCtl_DTC_0x04(572)" VALUE 0x001E450E /* @ECU_Address@FCtl_DTC_0x04@0x024C4478@ */ ECIPP_ALIGNMENT_UWORD 65535 Compu_IDENTITY 0 65535 PHYS_UNIT "System ID + DTC" /end CHARACTERISTIC
/begin CHARACTERISTIC FCdc4_INJD3_off_lo "FCtl_DTC_0x04(48)" VALUE 0x001E40F6 /* @ECU_Address@FCtl_DTC_0x04@0x024C4060@ */ ECIPP_ALIGNMENT_UWORD 65535 Compu_IDENTITY 0 65535 PHYS_UNIT "System ID + DTC" /end CHARACTERISTIC
/begin CHARACTERISTIC FCdc4_INJD3_on_hi "FCtl_DTC_0x04(58)" VALUE 0x001E410A /* @ECU_Address@FCtl_DTC_0x04@0x024C4074@ */ ECIPP_ALIGNMENT_UWORD 65535 Compu_IDENTITY 0 65535 PHYS_UNIT "System ID + DTC" /end CHARACTERISTIC
/begin CHARACTERISTIC FCdc4_INJD4_HS_Ihi "FCtl_DTC_0x04(565)" VALUE 0x001E4500 /* @ECU_Address@FCtl_DTC_0x04@0x024C446A@ */ ECIPP_ALIGNMENT_UWORD 65535 Compu_IDENTITY 0 65535 PHYS_UNIT "System ID + DTC" /end CHARACTERISTIC
/begin CHARACTERISTIC FCdc4_INJD4_LS_Ihi "FCtl_DTC_0x04(573)" VALUE 0x001E4510 /* @ECU_Address@FCtl_DTC_0x04@0x024C447A@ */ ECIPP_ALIGNMENT_UWORD 65535 Compu_IDENTITY 0 65535 PHYS_UNIT "System ID + DTC" /end CHARACTERISTIC
/begin CHARACTERISTIC FCdc4_INJD4_off_lo "FCtl_DTC_0x04(49)" VALUE 0x001E40F8 /* @ECU_Address@FCtl_DTC_0x04@0x024C4062@ */ ECIPP_ALIGNMENT_UWORD 65535 Compu_IDENTITY 0 65535 PHYS_UNIT "System ID + DTC" /end CHARACTERISTIC
/begin CHARACTERISTIC FCdc4_INJD4_on_hi "FCtl_DTC_0x04(59)" VALUE 0x001E410C /* @ECU_Address@FCtl_DTC_0x04@0x024C4076@ */ ECIPP_ALIGNMENT_UWORD 65535 Compu_IDENTITY 0 65535 PHYS_UNIT "System ID + DTC" /end CHARACTERISTIC
/begin CHARACTERISTIC FCdc4_INJD5_HS_Ihi "FCtl_DTC_0x04(566)" VALUE 0x001E4502 /* @ECU_Address@FCtl_DTC_0x04@0x024C446C@ */ ECIPP_ALIGNMENT_UWORD 65535 Compu_IDENTITY 0 65535 PHYS_UNIT "System ID + DTC" /end CHARACTERISTIC
/begin CHARACTERISTIC FCdc4_INJD5_LS_Ihi "FCtl_DTC_0x04(574)" VALUE 0x001E4512 /* @ECU_Address@FCtl_DTC_0x04@0x024C447C@ */ ECIPP_ALIGNMENT_UWORD 65535 Compu_IDENTITY 0 65535 PHYS_UNIT "System ID + DTC" /end CHARACTERISTIC
/begin CHARACTERISTIC FCdc4_INJD5_off_lo "FCtl_DTC_0x04(50)" VALUE 0x001E40FA /* @ECU_Address@FCtl_DTC_0x04@0x024C4064@ */ ECIPP_ALIGNMENT_UWORD 65535 Compu_IDENTITY 0 65535 PHYS_UNIT "System ID + DTC" /end CHARACTERISTIC
/begin CHARACTERISTIC FCdc4_INJD5_on_hi "FCtl_DTC_0x04(60)" VALUE 0x001E410E /* @ECU_Address@FCtl_DTC_0x04@0x024C4078@ */ ECIPP_ALIGNMENT_UWORD 65535 Compu_IDENTITY 0 65535 PHYS_UNIT "System ID + DTC" /end CHARACTERISTIC
/begin CHARACTERISTIC FCdc4_INJD6_HS_Ihi "FCtl_DTC_0x04(567)" VALUE 0x001E4504 /* @ECU_Address@FCtl_DTC_0x04@0x024C446E@ */ ECIPP_ALIGNMENT_UWORD 65535 Compu_IDENTITY 0 65535 PHYS_UNIT "System ID + DTC" /end CHARACTERISTIC
/begin CHARACTERISTIC FCdc4_INJD6_LS_Ihi "FCtl_DTC_0x04(575)" VALUE 0x001E4514 /* @ECU_Address@FCtl_DTC_0x04@0x024C447E@ */ ECIPP_ALIGNMENT_UWORD 65535 Compu_IDENTITY 0 65535 PHYS_UNIT "System ID + DTC" /end CHARACTERISTIC
/begin CHARACTERISTIC FCdc4_INJD6_off_lo "FCtl_DTC_0x04(51)" VALUE 0x001E40FC /* @ECU_Address@FCtl_DTC_0x04@0x024C4066@ */ ECIPP_ALIGNMENT_UWORD 65535 Compu_IDENTITY 0 65535 PHYS_UNIT "System ID + DTC" /end CHARACTERISTIC
/begin CHARACTERISTIC FCdc4_INJD6_on_hi "FCtl_DTC_0x04(61)" VALUE 0x001E4110 /* @ECU_Address@FCtl_DTC_0x04@0x024C407A@ */ ECIPP_ALIGNMENT_UWORD 65535 Compu_IDENTITY 0 65535 PHYS_UNIT "System ID + DTC" /end CHARACTERISTIC
/begin CHARACTERISTIC FCdc4_INJD7_HS_Ihi "FCtl_DTC_0x04(568)" VALUE 0x001E4506 /* @ECU_Address@FCtl_DTC_0x04@0x024C4470@ */ ECIPP_ALIGNMENT_UWORD 65535 Compu_IDENTITY 0 65535 PHYS_UNIT "System ID + DTC" /end CHARACTERISTIC
/begin CHARACTERISTIC FCdc4_INJD7_LS_Ihi "FCtl_DTC_0x04(576)" VALUE 0x001E4516 /* @ECU_Address@FCtl_DTC_0x04@0x024C4480@ */ ECIPP_ALIGNMENT_UWORD 65535 Compu_IDENTITY 0 65535 PHYS_UNIT "System ID + DTC" /end CHARACTERISTIC
/begin CHARACTERISTIC FCdc4_INJD7_off_lo "FCtl_DTC_0x04(52)" VALUE 0x001E40FE /* @ECU_Address@FCtl_DTC_0x04@0x024C4068@ */ ECIPP_ALIGNMENT_UWORD 65535 Compu_IDENTITY 0 65535 PHYS_UNIT "System ID + DTC" /end CHARACTERISTIC
/begin CHARACTERISTIC FCdc4_INJD7_on_hi "FCtl_DTC_0x04(62)" VALUE 0x001E4112 /* @ECU_Address@FCtl_DTC_0x04@0x024C407C@ */ ECIPP_ALIGNMENT_UWORD 65535 Compu_IDENTITY 0 65535 PHYS_UNIT "System ID + DTC" /end CHARACTERISTIC
/begin CHARACTERISTIC FCdc4_INJD8_HS_Ihi "FCtl_DTC_0x04(569)" VALUE 0x001E4508 /* @ECU_Address@FCtl_DTC_0x04@0x024C4472@ */ ECIPP_ALIGNMENT_UWORD 65535 Compu_IDENTITY 0 65535 PHYS_UNIT "System ID + DTC" /end CHARACTERISTIC
/begin CHARACTERISTIC FCdc4_INJD8_LS_Ihi "FCtl_DTC_0x04(577)" VALUE 0x001E4518 /* @ECU_Address@FCtl_DTC_0x04@0x024C4482@ */ ECIPP_ALIGNMENT_UWORD 65535 Compu_IDENTITY 0 65535 PHYS_UNIT "System ID + DTC" /end CHARACTERISTIC
/begin CHARACTERISTIC FCdc4_INJD8_off_lo "FCtl_DTC_0x04(53)" VALUE 0x001E4100 /* @ECU_Address@FCtl_DTC_0x04@0x024C406A@ */ ECIPP_ALIGNMENT_UWORD 65535 Compu_IDENTITY 0 65535 PHYS_UNIT "System ID + DTC" /end CHARACTERISTIC
/begin CHARACTERISTIC FCdc4_INJD8_on_hi "FCtl_DTC_0x04(63)" VALUE 0x001E4114 /* @ECU_Address@FCtl_DTC_0x04@0x024C407E@ */ ECIPP_ALIGNMENT_UWORD 65535 Compu_IDENTITY 0 65535 PHYS_UNIT "System ID + DTC" /end CHARACTERISTIC
/begin CHARACTERISTIC FCdc4_INJD9_off_lo "FCtl_DTC_0x04(54)" VALUE 0x001E4102 /* @ECU_Address@FCtl_DTC_0x04@0x024C406C@ */ ECIPP_ALIGNMENT_UWORD 65535 Compu_IDENTITY 0 65535 PHYS_UNIT "System ID + DTC" /end CHARACTERISTIC
/begin CHARACTERISTIC FCdc4_INJD9_on_hi "FCtl_DTC_0x04(64)" VALUE 0x001E4116 /* @ECU_Address@FCtl_DTC_0x04@0x024C4080@ */ ECIPP_ALIGNMENT_UWORD 65535 Compu_IDENTITY 0 65535 PHYS_UNIT "System ID + DTC" /end CHARACTERISTIC
/begin CHARACTERISTIC FCdc4_KNK10_max "FCtl_DTC_0x04(1012)" VALUE 0x001E487E /* @ECU_Address@FCtl_DTC_0x04@0x024C47E8@ */ ECIPP_ALIGNMENT_UWORD 65535 Compu_IDENTITY 0 65535 PHYS_UNIT "System ID + DTC" /end CHARACTERISTIC
/begin CHARACTERISTIC FCdc4_KNK10_min "FCtl_DTC_0x04(1003)" VALUE 0x001E486C /* @ECU_Address@FCtl_DTC_0x04@0x024C47D6@ */ ECIPP_ALIGNMENT_UWORD 65535 Compu_IDENTITY 0 65535 PHYS_UNIT "System ID + DTC" /end CHARACTERISTIC
/begin CHARACTERISTIC FCdc4_KNK11_max "FCtl_DTC_0x04(1013)" VALUE 0x001E4880 /* @ECU_Address@FCtl_DTC_0x04@0x024C47EA@ */ ECIPP_ALIGNMENT_UWORD 65535 Compu_IDENTITY 0 65535 PHYS_UNIT "System ID + DTC" /end CHARACTERISTIC
/begin CHARACTERISTIC FCdc4_KNK11_min "FCtl_DTC_0x04(1004)" VALUE 0x001E486E /* @ECU_Address@FCtl_DTC_0x04@0x024C47D8@ */ ECIPP_ALIGNMENT_UWORD 65535 Compu_IDENTITY 0 65535 PHYS_UNIT "System ID + DTC" /end CHARACTERISTIC
/begin CHARACTERISTIC FCdc4_KNK12_max "FCtl_DTC_0x04(1014)" VALUE 0x001E4882 /* @ECU_Address@FCtl_DTC_0x04@0x024C47EC@ */ ECIPP_ALIGNMENT_UWORD 65535 Compu_IDENTITY 0 65535 PHYS_UNIT "System ID + DTC" /end CHARACTERISTIC
/begin CHARACTERISTIC FCdc4_KNK12_min "FCtl_DTC_0x04(1005)" VALUE 0x001E4870 /* @ECU_Address@FCtl_DTC_0x04@0x024C47DA@ */ ECIPP_ALIGNMENT_UWORD 65535 Compu_IDENTITY 0 65535 PHYS_UNIT "System ID + DTC" /end CHARACTERISTIC
/begin CHARACTERISTIC FCdc4_KNK2_max "FCtl_DTC_0x04(185)" VALUE 0x001E4208 /* @ECU_Address@FCtl_DTC_0x04@0x024C4172@ */ ECIPP_ALIGNMENT_UWORD 65535 Compu_IDENTITY 0 65535 PHYS_UNIT "System ID + DTC" /end CHARACTERISTIC
/begin CHARACTERISTIC FCdc4_KNK2_min "FCtl_DTC_0x04(184)" VALUE 0x001E4206 /* @ECU_Address@FCtl_DTC_0x04@0x024C4170@ */ ECIPP_ALIGNMENT_UWORD 65535 Compu_IDENTITY 0 65535 PHYS_UNIT "System ID + DTC" /end CHARACTERISTIC
/begin CHARACTERISTIC FCdc4_KNK3_max "FCtl_DTC_0x04(806)" VALUE 0x001E46E2 /* @ECU_Address@FCtl_DTC_0x04@0x024C464C@ */ ECIPP_ALIGNMENT_UWORD 65535 Compu_IDENTITY 0 65535 PHYS_UNIT "System ID + DTC" /end CHARACTERISTIC
/begin CHARACTERISTIC FCdc4_KNK3_min "FCtl_DTC_0x04(805)" VALUE 0x001E46E0 /* @ECU_Address@FCtl_DTC_0x04@0x024C464A@ */ ECIPP_ALIGNMENT_UWORD 65535 Compu_IDENTITY 0 65535 PHYS_UNIT "System ID + DTC" /end CHARACTERISTIC
/begin CHARACTERISTIC FCdc4_KNK4_max "FCtl_DTC_0x04(1006)" VALUE 0x001E4872 /* @ECU_Address@FCtl_DTC_0x04@0x024C47DC@ */ ECIPP_ALIGNMENT_UWORD 65535 Compu_IDENTITY 0 65535 PHYS_UNIT "System ID + DTC" /end CHARACTERISTIC
/begin CHARACTERISTIC FCdc4_KNK4_min "FCtl_DTC_0x04(997)" VALUE 0x001E4860 /* @ECU_Address@FCtl_DTC_0x04@0x024C47CA@ */ ECIPP_ALIGNMENT_UWORD 65535 Compu_IDENTITY 0 65535 PHYS_UNIT "System ID + DTC" /end CHARACTERISTIC
/begin CHARACTERISTIC FCdc4_KNK5_max "FCtl_DTC_0x04(1007)" VALUE 0x001E4874 /* @ECU_Address@FCtl_DTC_0x04@0x024C47DE@ */ ECIPP_ALIGNMENT_UWORD 65535 Compu_IDENTITY 0 65535 PHYS_UNIT "System ID + DTC" /end CHARACTERISTIC
/begin CHARACTERISTIC FCdc4_KNK5_min "FCtl_DTC_0x04(998)" VALUE 0x001E4862 /* @ECU_Address@FCtl_DTC_0x04@0x024C47CC@ */ ECIPP_ALIGNMENT_UWORD 65535 Compu_IDENTITY 0 65535 PHYS_UNIT "System ID + DTC" /end CHARACTERISTIC
/begin CHARACTERISTIC FCdc4_KNK6_max "FCtl_DTC_0x04(1008)" VALUE 0x001E4876 /* @ECU_Address@FCtl_DTC_0x04@0x024C47E0@ */ ECIPP_ALIGNMENT_UWORD 65535 Compu_IDENTITY 0 65535 PHYS_UNIT "System ID + DTC" /end CHARACTERISTIC
/begin CHARACTERISTIC FCdc4_KNK6_min "FCtl_DTC_0x04(999)" VALUE 0x001E4864 /* @ECU_Address@FCtl_DTC_0x04@0x024C47CE@ */ ECIPP_ALIGNMENT_UWORD 65535 Compu_IDENTITY 0 65535 PHYS_UNIT "System ID + DTC" /end CHARACTERISTIC
/begin CHARACTERISTIC FCdc4_KNK7_max "FCtl_DTC_0x04(1009)" VALUE 0x001E4878 /* @ECU_Address@FCtl_DTC_0x04@0x024C47E2@ */ ECIPP_ALIGNMENT_UWORD 65535 Compu_IDENTITY 0 65535 PHYS_UNIT "System ID + DTC" /end CHARACTERISTIC
/begin CHARACTERISTIC FCdc4_KNK7_min "FCtl_DTC_0x04(1000)" VALUE 0x001E4866 /* @ECU_Address@FCtl_DTC_0x04@0x024C47D0@ */ ECIPP_ALIGNMENT_UWORD 65535 Compu_IDENTITY 0 65535 PHYS_UNIT "System ID + DTC" /end CHARACTERISTIC
/begin CHARACTERISTIC FCdc4_KNK8_max "FCtl_DTC_0x04(1010)" VALUE 0x001E487A /* @ECU_Address@FCtl_DTC_0x04@0x024C47E4@ */ ECIPP_ALIGNMENT_UWORD 65535 Compu_IDENTITY 0 65535 PHYS_UNIT "System ID + DTC" /end CHARACTERISTIC
/begin CHARACTERISTIC FCdc4_KNK8_min "FCtl_DTC_0x04(1001)" VALUE 0x001E4868 /* @ECU_Address@FCtl_DTC_0x04@0x024C47D2@ */ ECIPP_ALIGNMENT_UWORD 65535 Compu_IDENTITY 0 65535 PHYS_UNIT "System ID + DTC" /end CHARACTERISTIC
/begin CHARACTERISTIC FCdc4_KNK9_max "FCtl_DTC_0x04(1011)" VALUE 0x001E487C /* @ECU_Address@FCtl_DTC_0x04@0x024C47E6@ */ ECIPP_ALIGNMENT_UWORD 65535 Compu_IDENTITY 0 65535 PHYS_UNIT "System ID + DTC" /end CHARACTERISTIC
/begin CHARACTERISTIC FCdc4_KNK9_min "FCtl_DTC_0x04(1002)" VALUE 0x001E486A /* @ECU_Address@FCtl_DTC_0x04@0x024C47D4@ */ ECIPP_ALIGNMENT_UWORD 65535 Compu_IDENTITY 0 65535 PHYS_UNIT "System ID + DTC" /end CHARACTERISTIC
/begin CHARACTERISTIC FCdc4_KV10_deltaHi "FCtl_DTC_0x04(970)" VALUE 0x001E482A /* @ECU_Address@FCtl_DTC_0x04@0x024C4794@ */ ECIPP_ALIGNMENT_UWORD 65535 Compu_IDENTITY 0 65535 PHYS_UNIT "System ID + DTC" /end CHARACTERISTIC
/begin CHARACTERISTIC FCdc4_KV10_deltaLo "FCtl_DTC_0x04(982)" VALUE 0x001E4842 /* @ECU_Address@FCtl_DTC_0x04@0x024C47AC@ */ ECIPP_ALIGNMENT_UWORD 65535 Compu_IDENTITY 0 65535 PHYS_UNIT "System ID + DTC" /end CHARACTERISTIC
/begin CHARACTERISTIC FCdc4_KV10_high "FCtl_DTC_0x04(886)" VALUE 0x001E4782 /* @ECU_Address@FCtl_DTC_0x04@0x024C46EC@ */ ECIPP_ALIGNMENT_UWORD 65535 Compu_IDENTITY 0 65535 PHYS_UNIT "System ID + DTC" /end CHARACTERISTIC
/begin CHARACTERISTIC FCdc4_KV10_low "FCtl_DTC_0x04(898)" VALUE 0x001E479A /* @ECU_Address@FCtl_DTC_0x04@0x024C4704@ */ ECIPP_ALIGNMENT_UWORD 65535 Compu_IDENTITY 0 65535 PHYS_UNIT "System ID + DTC" /end CHARACTERISTIC
/begin CHARACTERISTIC FCdc4_KV11_deltaHi "FCtl_DTC_0x04(971)" VALUE 0x001E482C /* @ECU_Address@FCtl_DTC_0x04@0x024C4796@ */ ECIPP_ALIGNMENT_UWORD 65535 Compu_IDENTITY 0 65535 PHYS_UNIT "System ID + DTC" /end CHARACTERISTIC
/begin CHARACTERISTIC FCdc4_KV11_deltaLo "FCtl_DTC_0x04(983)" VALUE 0x001E4844 /* @ECU_Address@FCtl_DTC_0x04@0x024C47AE@ */ ECIPP_ALIGNMENT_UWORD 65535 Compu_IDENTITY 0 65535 PHYS_UNIT "System ID + DTC" /end CHARACTERISTIC
/begin CHARACTERISTIC FCdc4_KV11_high "FCtl_DTC_0x04(887)" VALUE 0x001E4784 /* @ECU_Address@FCtl_DTC_0x04@0x024C46EE@ */ ECIPP_ALIGNMENT_UWORD 65535 Compu_IDENTITY 0 65535 PHYS_UNIT "System ID + DTC" /end CHARACTERISTIC
/begin CHARACTERISTIC FCdc4_KV11_low "FCtl_DTC_0x04(899)" VALUE 0x001E479C /* @ECU_Address@FCtl_DTC_0x04@0x024C4706@ */ ECIPP_ALIGNMENT_UWORD 65535 Compu_IDENTITY 0 65535 PHYS_UNIT "System ID + DTC" /end CHARACTERISTIC
/begin CHARACTERISTIC FCdc4_KV12_deltaHi "FCtl_DTC_0x04(972)" VALUE 0x001E482E /* @ECU_Address@FCtl_DTC_0x04@0x024C4798@ */ ECIPP_ALIGNMENT_UWORD 65535 Compu_IDENTITY 0 65535 PHYS_UNIT "System ID + DTC" /end CHARACTERISTIC
/begin CHARACTERISTIC FCdc4_KV12_deltaLo "FCtl_DTC_0x04(984)" VALUE 0x001E4846 /* @ECU_Address@FCtl_DTC_0x04@0x024C47B0@ */ ECIPP_ALIGNMENT_UWORD 65535 Compu_IDENTITY 0 65535 PHYS_UNIT "System ID + DTC" /end CHARACTERISTIC
/begin CHARACTERISTIC FCdc4_KV12_high "FCtl_DTC_0x04(888)" VALUE 0x001E4786 /* @ECU_Address@FCtl_DTC_0x04@0x024C46F0@ */ ECIPP_ALIGNMENT_UWORD 65535 Compu_IDENTITY 0 65535 PHYS_UNIT "System ID + DTC" /end CHARACTERISTIC
/begin CHARACTERISTIC FCdc4_KV12_low "FCtl_DTC_0x04(900)" VALUE 0x001E479E /* @ECU_Address@FCtl_DTC_0x04@0x024C4708@ */ ECIPP_ALIGNMENT_UWORD 65535 Compu_IDENTITY 0 65535 PHYS_UNIT "System ID + DTC" /end CHARACTERISTIC
/begin CHARACTERISTIC FCdc4_KV2_deltaHi "FCtl_DTC_0x04(962)" VALUE 0x001E481A /* @ECU_Address@FCtl_DTC_0x04@0x024C4784@ */ ECIPP_ALIGNMENT_UWORD 65535 Compu_IDENTITY 0 65535 PHYS_UNIT "System ID + DTC" /end CHARACTERISTIC
/begin CHARACTERISTIC FCdc4_KV2_deltaLo "FCtl_DTC_0x04(974)" VALUE 0x001E4832 /* @ECU_Address@FCtl_DTC_0x04@0x024C479C@ */ ECIPP_ALIGNMENT_UWORD 65535 Compu_IDENTITY 0 65535 PHYS_UNIT "System ID + DTC" /end CHARACTERISTIC
/begin CHARACTERISTIC FCdc4_KV2_high "FCtl_DTC_0x04(878)" VALUE 0x001E4772 /* @ECU_Address@FCtl_DTC_0x04@0x024C46DC@ */ ECIPP_ALIGNMENT_UWORD 65535 Compu_IDENTITY 0 65535 PHYS_UNIT "System ID + DTC" /end CHARACTERISTIC
/begin CHARACTERISTIC FCdc4_KV2_low "FCtl_DTC_0x04(890)" VALUE 0x001E478A /* @ECU_Address@FCtl_DTC_0x04@0x024C46F4@ */ ECIPP_ALIGNMENT_UWORD 65535 Compu_IDENTITY 0 65535 PHYS_UNIT "System ID + DTC" /end CHARACTERISTIC
/begin CHARACTERISTIC FCdc4_KV3_deltaHi "FCtl_DTC_0x04(963)" VALUE 0x001E481C /* @ECU_Address@FCtl_DTC_0x04@0x024C4786@ */ ECIPP_ALIGNMENT_UWORD 65535 Compu_IDENTITY 0 65535 PHYS_UNIT "System ID + DTC" /end CHARACTERISTIC
/begin CHARACTERISTIC FCdc4_KV3_deltaLo "FCtl_DTC_0x04(975)" VALUE 0x001E4834 /* @ECU_Address@FCtl_DTC_0x04@0x024C479E@ */ ECIPP_ALIGNMENT_UWORD 65535 Compu_IDENTITY 0 65535 PHYS_UNIT "System ID + DTC" /end CHARACTERISTIC
/begin CHARACTERISTIC FCdc4_KV3_high "FCtl_DTC_0x04(879)" VALUE 0x001E4774 /* @ECU_Address@FCtl_DTC_0x04@0x024C46DE@ */ ECIPP_ALIGNMENT_UWORD 65535 Compu_IDENTITY 0 65535 PHYS_UNIT "System ID + DTC" /end CHARACTERISTIC
/begin CHARACTERISTIC FCdc4_KV3_low "FCtl_DTC_0x04(891)" VALUE 0x001E478C /* @ECU_Address@FCtl_DTC_0x04@0x024C46F6@ */ ECIPP_ALIGNMENT_UWORD 65535 Compu_IDENTITY 0 65535 PHYS_UNIT "System ID + DTC" /end CHARACTERISTIC
/begin CHARACTERISTIC FCdc4_KV4_deltaHi "FCtl_DTC_0x04(964)" VALUE 0x001E481E /* @ECU_Address@FCtl_DTC_0x04@0x024C4788@ */ ECIPP_ALIGNMENT_UWORD 65535 Compu_IDENTITY 0 65535 PHYS_UNIT "System ID + DTC" /end CHARACTERISTIC
/begin CHARACTERISTIC FCdc4_KV4_deltaLo "FCtl_DTC_0x04(976)" VALUE 0x001E4836 /* @ECU_Address@FCtl_DTC_0x04@0x024C47A0@ */ ECIPP_ALIGNMENT_UWORD 65535 Compu_IDENTITY 0 65535 PHYS_UNIT "System ID + DTC" /end CHARACTERISTIC
/begin CHARACTERISTIC FCdc4_KV4_high "FCtl_DTC_0x04(880)" VALUE 0x001E4776 /* @ECU_Address@FCtl_DTC_0x04@0x024C46E0@ */ ECIPP_ALIGNMENT_UWORD 65535 Compu_IDENTITY 0 65535 PHYS_UNIT "System ID + DTC" /end CHARACTERISTIC
/begin CHARACTERISTIC FCdc4_KV4_low "FCtl_DTC_0x04(892)" VALUE 0x001E478E /* @ECU_Address@FCtl_DTC_0x04@0x024C46F8@ */ ECIPP_ALIGNMENT_UWORD 65535 Compu_IDENTITY 0 65535 PHYS_UNIT "System ID + DTC" /end CHARACTERISTIC
/begin CHARACTERISTIC FCdc4_KV5_deltaHi "FCtl_DTC_0x04(965)" VALUE 0x001E4820 /* @ECU_Address@FCtl_DTC_0x04@0x024C478A@ */ ECIPP_ALIGNMENT_UWORD 65535 Compu_IDENTITY 0 65535 PHYS_UNIT "System ID + DTC" /end CHARACTERISTIC
/begin CHARACTERISTIC FCdc4_KV5_deltaLo "FCtl_DTC_0x04(977)" VALUE 0x001E4838 /* @ECU_Address@FCtl_DTC_0x04@0x024C47A2@ */ ECIPP_ALIGNMENT_UWORD 65535 Compu_IDENTITY 0 65535 PHYS_UNIT "System ID + DTC" /end CHARACTERISTIC
/begin CHARACTERISTIC FCdc4_KV5_high "FCtl_DTC_0x04(881)" VALUE 0x001E4778 /* @ECU_Address@FCtl_DTC_0x04@0x024C46E2@ */ ECIPP_ALIGNMENT_UWORD 65535 Compu_IDENTITY 0 65535 PHYS_UNIT "System ID + DTC" /end CHARACTERISTIC
/begin CHARACTERISTIC FCdc4_KV5_low "FCtl_DTC_0x04(893)" VALUE 0x001E4790 /* @ECU_Address@FCtl_DTC_0x04@0x024C46FA@ */ ECIPP_ALIGNMENT_UWORD 65535 Compu_IDENTITY 0 65535 PHYS_UNIT "System ID + DTC" /end CHARACTERISTIC
/begin CHARACTERISTIC FCdc4_KV6_deltaHi "FCtl_DTC_0x04(966)" VALUE 0x001E4822 /* @ECU_Address@FCtl_DTC_0x04@0x024C478C@ */ ECIPP_ALIGNMENT_UWORD 65535 Compu_IDENTITY 0 65535 PHYS_UNIT "System ID + DTC" /end CHARACTERISTIC
/begin CHARACTERISTIC FCdc4_KV6_deltaLo "FCtl_DTC_0x04(978)" VALUE 0x001E483A /* @ECU_Address@FCtl_DTC_0x04@0x024C47A4@ */ ECIPP_ALIGNMENT_UWORD 65535 Compu_IDENTITY 0 65535 PHYS_UNIT "System ID + DTC" /end CHARACTERISTIC
/begin CHARACTERISTIC FCdc4_KV6_high "FCtl_DTC_0x04(882)" VALUE 0x001E477A /* @ECU_Address@FCtl_DTC_0x04@0x024C46E4@ */ ECIPP_ALIGNMENT_UWORD 65535 Compu_IDENTITY 0 65535 PHYS_UNIT "System ID + DTC" /end CHARACTERISTIC
/begin CHARACTERISTIC FCdc4_KV6_low "FCtl_DTC_0x04(894)" VALUE 0x001E4792 /* @ECU_Address@FCtl_DTC_0x04@0x024C46FC@ */ ECIPP_ALIGNMENT_UWORD 65535 Compu_IDENTITY 0 65535 PHYS_UNIT "System ID + DTC" /end CHARACTERISTIC
/begin CHARACTERISTIC FCdc4_KV7_deltaHi "FCtl_DTC_0x04(967)" VALUE 0x001E4824 /* @ECU_Address@FCtl_DTC_0x04@0x024C478E@ */ ECIPP_ALIGNMENT_UWORD 65535 Compu_IDENTITY 0 65535 PHYS_UNIT "System ID + DTC" /end CHARACTERISTIC
/begin CHARACTERISTIC FCdc4_KV7_deltaLo "FCtl_DTC_0x04(979)" VALUE 0x001E483C /* @ECU_Address@FCtl_DTC_0x04@0x024C47A6@ */ ECIPP_ALIGNMENT_UWORD 65535 Compu_IDENTITY 0 65535 PHYS_UNIT "System ID + DTC" /end CHARACTERISTIC
/begin CHARACTERISTIC FCdc4_KV7_high "FCtl_DTC_0x04(883)" VALUE 0x001E477C /* @ECU_Address@FCtl_DTC_0x04@0x024C46E6@ */ ECIPP_ALIGNMENT_UWORD 65535 Compu_IDENTITY 0 65535 PHYS_UNIT "System ID + DTC" /end CHARACTERISTIC
/begin CHARACTERISTIC FCdc4_KV7_low "FCtl_DTC_0x04(895)" VALUE 0x001E4794 /* @ECU_Address@FCtl_DTC_0x04@0x024C46FE@ */ ECIPP_ALIGNMENT_UWORD 65535 Compu_IDENTITY 0 65535 PHYS_UNIT "System ID + DTC" /end CHARACTERISTIC
/begin CHARACTERISTIC FCdc4_KV8_deltaHi "FCtl_DTC_0x04(968)" VALUE 0x001E4826 /* @ECU_Address@FCtl_DTC_0x04@0x024C4790@ */ ECIPP_ALIGNMENT_UWORD 65535 Compu_IDENTITY 0 65535 PHYS_UNIT "System ID + DTC" /end CHARACTERISTIC
/begin CHARACTERISTIC FCdc4_KV8_deltaLo "FCtl_DTC_0x04(980)" VALUE 0x001E483E /* @ECU_Address@FCtl_DTC_0x04@0x024C47A8@ */ ECIPP_ALIGNMENT_UWORD 65535 Compu_IDENTITY 0 65535 PHYS_UNIT "System ID + DTC" /end CHARACTERISTIC
/begin CHARACTERISTIC FCdc4_KV8_high "FCtl_DTC_0x04(884)" VALUE 0x001E477E /* @ECU_Address@FCtl_DTC_0x04@0x024C46E8@ */ ECIPP_ALIGNMENT_UWORD 65535 Compu_IDENTITY 0 65535 PHYS_UNIT "System ID + DTC" /end CHARACTERISTIC
/begin CHARACTERISTIC FCdc4_KV8_low "FCtl_DTC_0x04(896)" VALUE 0x001E4796 /* @ECU_Address@FCtl_DTC_0x04@0x024C4700@ */ ECIPP_ALIGNMENT_UWORD 65535 Compu_IDENTITY 0 65535 PHYS_UNIT "System ID + DTC" /end CHARACTERISTIC
/begin CHARACTERISTIC FCdc4_KV9_deltaHi "FCtl_DTC_0x04(969)" VALUE 0x001E4828 /* @ECU_Address@FCtl_DTC_0x04@0x024C4792@ */ ECIPP_ALIGNMENT_UWORD 65535 Compu_IDENTITY 0 65535 PHYS_UNIT "System ID + DTC" /end CHARACTERISTIC
/begin CHARACTERISTIC FCdc4_KV9_deltaLo "FCtl_DTC_0x04(981)" VALUE 0x001E4840 /* @ECU_Address@FCtl_DTC_0x04@0x024C47AA@ */ ECIPP_ALIGNMENT_UWORD 65535 Compu_IDENTITY 0 65535 PHYS_UNIT "System ID + DTC" /end CHARACTERISTIC
/begin CHARACTERISTIC FCdc4_KV9_high "FCtl_DTC_0x04(885)" VALUE 0x001E4780 /* @ECU_Address@FCtl_DTC_0x04@0x024C46EA@ */ ECIPP_ALIGNMENT_UWORD 65535 Compu_IDENTITY 0 65535 PHYS_UNIT "System ID + DTC" /end CHARACTERISTIC
/begin CHARACTERISTIC FCdc4_KV9_low "FCtl_DTC_0x04(897)" VALUE 0x001E4798 /* @ECU_Address@FCtl_DTC_0x04@0x024C4702@ */ ECIPP_ALIGNMENT_UWORD 65535 Compu_IDENTITY 0 65535 PHYS_UNIT "System ID + DTC" /end CHARACTERISTIC
/begin CHARACTERISTIC FCdc4_Pri10_open "FCtl_DTC_0x04(910)" VALUE 0x001E47B2 /* @ECU_Address@FCtl_DTC_0x04@0x024C471C@ */ ECIPP_ALIGNMENT_UWORD 65535 Compu_IDENTITY 0 65535 PHYS_UNIT "System ID + DTC" /end CHARACTERISTIC
/begin CHARACTERISTIC FCdc4_Pri10_short "FCtl_DTC_0x04(922)" VALUE 0x001E47CA /* @ECU_Address@FCtl_DTC_0x04@0x024C4734@ */ ECIPP_ALIGNMENT_UWORD 65535 Compu_IDENTITY 0 65535 PHYS_UNIT "System ID + DTC" /end CHARACTERISTIC
/begin CHARACTERISTIC FCdc4_Pri11_open "FCtl_DTC_0x04(911)" VALUE 0x001E47B4 /* @ECU_Address@FCtl_DTC_0x04@0x024C471E@ */ ECIPP_ALIGNMENT_UWORD 65535 Compu_IDENTITY 0 65535 PHYS_UNIT "System ID + DTC" /end CHARACTERISTIC
/begin CHARACTERISTIC FCdc4_Pri11_short "FCtl_DTC_0x04(923)" VALUE 0x001E47CC /* @ECU_Address@FCtl_DTC_0x04@0x024C4736@ */ ECIPP_ALIGNMENT_UWORD 65535 Compu_IDENTITY 0 65535 PHYS_UNIT "System ID + DTC" /end CHARACTERISTIC
/begin CHARACTERISTIC FCdc4_Pri12_open "FCtl_DTC_0x04(912)" VALUE 0x001E47B6 /* @ECU_Address@FCtl_DTC_0x04@0x024C4720@ */ ECIPP_ALIGNMENT_UWORD 65535 Compu_IDENTITY 0 65535 PHYS_UNIT "System ID + DTC" /end CHARACTERISTIC
/begin CHARACTERISTIC FCdc4_Pri12_short "FCtl_DTC_0x04(924)" VALUE 0x001E47CE /* @ECU_Address@FCtl_DTC_0x04@0x024C4738@ */ ECIPP_ALIGNMENT_UWORD 65535 Compu_IDENTITY 0 65535 PHYS_UNIT "System ID + DTC" /end CHARACTERISTIC
/begin CHARACTERISTIC FCdc4_Pri2_open "FCtl_DTC_0x04(902)" VALUE 0x001E47A2 /* @ECU_Address@FCtl_DTC_0x04@0x024C470C@ */ ECIPP_ALIGNMENT_UWORD 65535 Compu_IDENTITY 0 65535 PHYS_UNIT "System ID + DTC" /end CHARACTERISTIC
/begin CHARACTERISTIC FCdc4_Pri2_short "FCtl_DTC_0x04(914)" VALUE 0x001E47BA /* @ECU_Address@FCtl_DTC_0x04@0x024C4724@ */ ECIPP_ALIGNMENT_UWORD 65535 Compu_IDENTITY 0 65535 PHYS_UNIT "System ID + DTC" /end CHARACTERISTIC
/begin CHARACTERISTIC FCdc4_Pri3_open "FCtl_DTC_0x04(903)" VALUE 0x001E47A4 /* @ECU_Address@FCtl_DTC_0x04@0x024C470E@ */ ECIPP_ALIGNMENT_UWORD 65535 Compu_IDENTITY 0 65535 PHYS_UNIT "System ID + DTC" /end CHARACTERISTIC
/begin CHARACTERISTIC FCdc4_Pri3_short "FCtl_DTC_0x04(915)" VALUE 0x001E47BC /* @ECU_Address@FCtl_DTC_0x04@0x024C4726@ */ ECIPP_ALIGNMENT_UWORD 65535 Compu_IDENTITY 0 65535 PHYS_UNIT "System ID + DTC" /end CHARACTERISTIC
/begin CHARACTERISTIC FCdc4_Pri4_open "FCtl_DTC_0x04(904)" VALUE 0x001E47A6 /* @ECU_Address@FCtl_DTC_0x04@0x024C4710@ */ ECIPP_ALIGNMENT_UWORD 65535 Compu_IDENTITY 0 65535 PHYS_UNIT "System ID + DTC" /end CHARACTERISTIC
/begin CHARACTERISTIC FCdc4_Pri4_short "FCtl_DTC_0x04(916)" VALUE 0x001E47BE /* @ECU_Address@FCtl_DTC_0x04@0x024C4728@ */ ECIPP_ALIGNMENT_UWORD 65535 Compu_IDENTITY 0 65535 PHYS_UNIT "System ID + DTC" /end CHARACTERISTIC
/begin CHARACTERISTIC FCdc4_Pri5_open "FCtl_DTC_0x04(905)" VALUE 0x001E47A8 /* @ECU_Address@FCtl_DTC_0x04@0x024C4712@ */ ECIPP_ALIGNMENT_UWORD 65535 Compu_IDENTITY 0 65535 PHYS_UNIT "System ID + DTC" /end CHARACTERISTIC
/begin CHARACTERISTIC FCdc4_Pri5_short "FCtl_DTC_0x04(917)" VALUE 0x001E47C0 /* @ECU_Address@FCtl_DTC_0x04@0x024C472A@ */ ECIPP_ALIGNMENT_UWORD 65535 Compu_IDENTITY 0 65535 PHYS_UNIT "System ID + DTC" /end CHARACTERISTIC
/begin CHARACTERISTIC FCdc4_Pri6_open "FCtl_DTC_0x04(906)" VALUE 0x001E47AA /* @ECU_Address@FCtl_DTC_0x04@0x024C4714@ */ ECIPP_ALIGNMENT_UWORD 65535 Compu_IDENTITY 0 65535 PHYS_UNIT "System ID + DTC" /end CHARACTERISTIC
/begin CHARACTERISTIC FCdc4_Pri6_short "FCtl_DTC_0x04(918)" VALUE 0x001E47C2 /* @ECU_Address@FCtl_DTC_0x04@0x024C472C@ */ ECIPP_ALIGNMENT_UWORD 65535 Compu_IDENTITY 0 65535 PHYS_UNIT "System ID + DTC" /end CHARACTERISTIC
/begin CHARACTERISTIC FCdc4_Pri7_open "FCtl_DTC_0x04(907)" VALUE 0x001E47AC /* @ECU_Address@FCtl_DTC_0x04@0x024C4716@ */ ECIPP_ALIGNMENT_UWORD 65535 Compu_IDENTITY 0 65535 PHYS_UNIT "System ID + DTC" /end CHARACTERISTIC
/begin CHARACTERISTIC FCdc4_Pri7_short "FCtl_DTC_0x04(919)" VALUE 0x001E47C4 /* @ECU_Address@FCtl_DTC_0x04@0x024C472E@ */ ECIPP_ALIGNMENT_UWORD 65535 Compu_IDENTITY 0 65535 PHYS_UNIT "System ID + DTC" /end CHARACTERISTIC
/begin CHARACTERISTIC FCdc4_Pri8_open "FCtl_DTC_0x04(908)" VALUE 0x001E47AE /* @ECU_Address@FCtl_DTC_0x04@0x024C4718@ */ ECIPP_ALIGNMENT_UWORD 65535 Compu_IDENTITY 0 65535 PHYS_UNIT "System ID + DTC" /end CHARACTERISTIC
/begin CHARACTERISTIC FCdc4_Pri8_short "FCtl_DTC_0x04(920)" VALUE 0x001E47C6 /* @ECU_Address@FCtl_DTC_0x04@0x024C4730@ */ ECIPP_ALIGNMENT_UWORD 65535 Compu_IDENTITY 0 65535 PHYS_UNIT "System ID + DTC" /end CHARACTERISTIC
/begin CHARACTERISTIC FCdc4_Pri9_open "FCtl_DTC_0x04(909)" VALUE 0x001E47B0 /* @ECU_Address@FCtl_DTC_0x04@0x024C471A@ */ ECIPP_ALIGNMENT_UWORD 65535 Compu_IDENTITY 0 65535 PHYS_UNIT "System ID + DTC" /end CHARACTERISTIC
/begin CHARACTERISTIC FCdc4_Pri9_short "FCtl_DTC_0x04(921)" VALUE 0x001E47C8 /* @ECU_Address@FCtl_DTC_0x04@0x024C4732@ */ ECIPP_ALIGNMENT_UWORD 65535 Compu_IDENTITY 0 65535 PHYS_UNIT "System ID + DTC" /end CHARACTERISTIC
/begin CHARACTERISTIC FCdc4_Sec10_31KV_open "FCtl_DTC_0x04(958)" VALUE 0x001E4812 /* @ECU_Address@FCtl_DTC_0x04@0x024C477C@ */ ECIPP_ALIGNMENT_UWORD 65535 Compu_IDENTITY 0 65535 PHYS_UNIT "System ID + DTC" /end CHARACTERISTIC
/begin CHARACTERISTIC FCdc4_Sec10_low "FCtl_DTC_0x04(946)" VALUE 0x001E47FA /* @ECU_Address@FCtl_DTC_0x04@0x024C4764@ */ ECIPP_ALIGNMENT_UWORD 65535 Compu_IDENTITY 0 65535 PHYS_UNIT "System ID + DTC" /end CHARACTERISTIC
/begin CHARACTERISTIC FCdc4_Sec10_open "FCtl_DTC_0x04(934)" VALUE 0x001E47E2 /* @ECU_Address@FCtl_DTC_0x04@0x024C474C@ */ ECIPP_ALIGNMENT_UWORD 65535 Compu_IDENTITY 0 65535 PHYS_UNIT "System ID + DTC" /end CHARACTERISTIC
/begin CHARACTERISTIC FCdc4_Sec11_31KV_open "FCtl_DTC_0x04(959)" VALUE 0x001E4814 /* @ECU_Address@FCtl_DTC_0x04@0x024C477E@ */ ECIPP_ALIGNMENT_UWORD 65535 Compu_IDENTITY 0 65535 PHYS_UNIT "System ID + DTC" /end CHARACTERISTIC
/begin CHARACTERISTIC FCdc4_Sec11_low "FCtl_DTC_0x04(947)" VALUE 0x001E47FC /* @ECU_Address@FCtl_DTC_0x04@0x024C4766@ */ ECIPP_ALIGNMENT_UWORD 65535 Compu_IDENTITY 0 65535 PHYS_UNIT "System ID + DTC" /end CHARACTERISTIC
/begin CHARACTERISTIC FCdc4_Sec11_open "FCtl_DTC_0x04(935)" VALUE 0x001E47E4 /* @ECU_Address@FCtl_DTC_0x04@0x024C474E@ */ ECIPP_ALIGNMENT_UWORD 65535 Compu_IDENTITY 0 65535 PHYS_UNIT "System ID + DTC" /end CHARACTERISTIC
/begin CHARACTERISTIC FCdc4_Sec12_31KV_open "FCtl_DTC_0x04(960)" VALUE 0x001E4816 /* @ECU_Address@FCtl_DTC_0x04@0x024C4780@ */ ECIPP_ALIGNMENT_UWORD 65535 Compu_IDENTITY 0 65535 PHYS_UNIT "System ID + DTC" /end CHARACTERISTIC
/begin CHARACTERISTIC FCdc4_Sec12_low "FCtl_DTC_0x04(948)" VALUE 0x001E47FE /* @ECU_Address@FCtl_DTC_0x04@0x024C4768@ */ ECIPP_ALIGNMENT_UWORD 65535 Compu_IDENTITY 0 65535 PHYS_UNIT "System ID + DTC" /end CHARACTERISTIC
/begin CHARACTERISTIC FCdc4_Sec12_open "FCtl_DTC_0x04(936)" VALUE 0x001E47E6 /* @ECU_Address@FCtl_DTC_0x04@0x024C4750@ */ ECIPP_ALIGNMENT_UWORD 65535 Compu_IDENTITY 0 65535 PHYS_UNIT "System ID + DTC" /end CHARACTERISTIC
/begin CHARACTERISTIC FCdc4_Sec2_31KV_open "FCtl_DTC_0x04(950)" VALUE 0x001E4802 /* @ECU_Address@FCtl_DTC_0x04@0x024C476C@ */ ECIPP_ALIGNMENT_UWORD 65535 Compu_IDENTITY 0 65535 PHYS_UNIT "System ID + DTC" /end CHARACTERISTIC
/begin CHARACTERISTIC FCdc4_Sec2_low "FCtl_DTC_0x04(938)" VALUE 0x001E47EA /* @ECU_Address@FCtl_DTC_0x04@0x024C4754@ */ ECIPP_ALIGNMENT_UWORD 65535 Compu_IDENTITY 0 65535 PHYS_UNIT "System ID + DTC" /end CHARACTERISTIC
/begin CHARACTERISTIC FCdc4_Sec2_open "FCtl_DTC_0x04(926)" VALUE 0x001E47D2 /* @ECU_Address@FCtl_DTC_0x04@0x024C473C@ */ ECIPP_ALIGNMENT_UWORD 65535 Compu_IDENTITY 0 65535 PHYS_UNIT "System ID + DTC" /end CHARACTERISTIC
/begin CHARACTERISTIC FCdc4_Sec3_31KV_open "FCtl_DTC_0x04(951)" VALUE 0x001E4804 /* @ECU_Address@FCtl_DTC_0x04@0x024C476E@ */ ECIPP_ALIGNMENT_UWORD 65535 Compu_IDENTITY 0 65535 PHYS_UNIT "System ID + DTC" /end CHARACTERISTIC
/begin CHARACTERISTIC FCdc4_Sec3_low "FCtl_DTC_0x04(939)" VALUE 0x001E47EC /* @ECU_Address@FCtl_DTC_0x04@0x024C4756@ */ ECIPP_ALIGNMENT_UWORD 65535 Compu_IDENTITY 0 65535 PHYS_UNIT "System ID + DTC" /end CHARACTERISTIC
/begin CHARACTERISTIC FCdc4_Sec3_open "FCtl_DTC_0x04(927)" VALUE 0x001E47D4 /* @ECU_Address@FCtl_DTC_0x04@0x024C473E@ */ ECIPP_ALIGNMENT_UWORD 65535 Compu_IDENTITY 0 65535 PHYS_UNIT "System ID + DTC" /end CHARACTERISTIC
/begin CHARACTERISTIC FCdc4_Sec4_31KV_open "FCtl_DTC_0x04(952)" VALUE 0x001E4806 /* @ECU_Address@FCtl_DTC_0x04@0x024C4770@ */ ECIPP_ALIGNMENT_UWORD 65535 Compu_IDENTITY 0 65535 PHYS_UNIT "System ID + DTC" /end CHARACTERISTIC
/begin CHARACTERISTIC FCdc4_Sec4_low "FCtl_DTC_0x04(940)" VALUE 0x001E47EE /* @ECU_Address@FCtl_DTC_0x04@0x024C4758@ */ ECIPP_ALIGNMENT_UWORD 65535 Compu_IDENTITY 0 65535 PHYS_UNIT "System ID + DTC" /end CHARACTERISTIC
/begin CHARACTERISTIC FCdc4_Sec4_open "FCtl_DTC_0x04(928)" VALUE 0x001E47D6 /* @ECU_Address@FCtl_DTC_0x04@0x024C4740@ */ ECIPP_ALIGNMENT_UWORD 65535 Compu_IDENTITY 0 65535 PHYS_UNIT "System ID + DTC" /end CHARACTERISTIC
/begin CHARACTERISTIC FCdc4_Sec5_31KV_open "FCtl_DTC_0x04(953)" VALUE 0x001E4808 /* @ECU_Address@FCtl_DTC_0x04@0x024C4772@ */ ECIPP_ALIGNMENT_UWORD 65535 Compu_IDENTITY 0 65535 PHYS_UNIT "System ID + DTC" /end CHARACTERISTIC
/begin CHARACTERISTIC FCdc4_Sec5_low "FCtl_DTC_0x04(941)" VALUE 0x001E47F0 /* @ECU_Address@FCtl_DTC_0x04@0x024C475A@ */ ECIPP_ALIGNMENT_UWORD 65535 Compu_IDENTITY 0 65535 PHYS_UNIT "System ID + DTC" /end CHARACTERISTIC
/begin CHARACTERISTIC FCdc4_Sec5_open "FCtl_DTC_0x04(929)" VALUE 0x001E47D8 /* @ECU_Address@FCtl_DTC_0x04@0x024C4742@ */ ECIPP_ALIGNMENT_UWORD 65535 Compu_IDENTITY 0 65535 PHYS_UNIT "System ID + DTC" /end CHARACTERISTIC
/begin CHARACTERISTIC FCdc4_Sec6_31KV_open "FCtl_DTC_0x04(954)" VALUE 0x001E480A /* @ECU_Address@FCtl_DTC_0x04@0x024C4774@ */ ECIPP_ALIGNMENT_UWORD 65535 Compu_IDENTITY 0 65535 PHYS_UNIT "System ID + DTC" /end CHARACTERISTIC
/begin CHARACTERISTIC FCdc4_Sec6_low "FCtl_DTC_0x04(942)" VALUE 0x001E47F2 /* @ECU_Address@FCtl_DTC_0x04@0x024C475C@ */ ECIPP_ALIGNMENT_UWORD 65535 Compu_IDENTITY 0 65535 PHYS_UNIT "System ID + DTC" /end CHARACTERISTIC
/begin CHARACTERISTIC FCdc4_Sec6_open "FCtl_DTC_0x04(930)" VALUE 0x001E47DA /* @ECU_Address@FCtl_DTC_0x04@0x024C4744@ */ ECIPP_ALIGNMENT_UWORD 65535 Compu_IDENTITY 0 65535 PHYS_UNIT "System ID + DTC" /end CHARACTERISTIC
/begin CHARACTERISTIC FCdc4_Sec7_31KV_open "FCtl_DTC_0x04(955)" VALUE 0x001E480C /* @ECU_Address@FCtl_DTC_0x04@0x024C4776@ */ ECIPP_ALIGNMENT_UWORD 65535 Compu_IDENTITY 0 65535 PHYS_UNIT "System ID + DTC" /end CHARACTERISTIC
/begin CHARACTERISTIC FCdc4_Sec7_low "FCtl_DTC_0x04(943)" VALUE 0x001E47F4 /* @ECU_Address@FCtl_DTC_0x04@0x024C475E@ */ ECIPP_ALIGNMENT_UWORD 65535 Compu_IDENTITY 0 65535 PHYS_UNIT "System ID + DTC" /end CHARACTERISTIC
/begin CHARACTERISTIC FCdc4_Sec7_open "FCtl_DTC_0x04(931)" VALUE 0x001E47DC /* @ECU_Address@FCtl_DTC_0x04@0x024C4746@ */ ECIPP_ALIGNMENT_UWORD 65535 Compu_IDENTITY 0 65535 PHYS_UNIT "System ID + DTC" /end CHARACTERISTIC
/begin CHARACTERISTIC FCdc4_Sec8_31KV_open "FCtl_DTC_0x04(956)" VALUE 0x001E480E /* @ECU_Address@FCtl_DTC_0x04@0x024C4778@ */ ECIPP_ALIGNMENT_UWORD 65535 Compu_IDENTITY 0 65535 PHYS_UNIT "System ID + DTC" /end CHARACTERISTIC
/begin CHARACTERISTIC FCdc4_Sec8_low "FCtl_DTC_0x04(944)" VALUE 0x001E47F6 /* @ECU_Address@FCtl_DTC_0x04@0x024C4760@ */ ECIPP_ALIGNMENT_UWORD 65535 Compu_IDENTITY 0 65535 PHYS_UNIT "System ID + DTC" /end CHARACTERISTIC
/begin CHARACTERISTIC FCdc4_Sec8_open "FCtl_DTC_0x04(932)" VALUE 0x001E47DE /* @ECU_Address@FCtl_DTC_0x04@0x024C4748@ */ ECIPP_ALIGNMENT_UWORD 65535 Compu_IDENTITY 0 65535 PHYS_UNIT "System ID + DTC" /end CHARACTERISTIC
/begin CHARACTERISTIC FCdc4_Sec9_31KV_open "FCtl_DTC_0x04(957)" VALUE 0x001E4810 /* @ECU_Address@FCtl_DTC_0x04@0x024C477A@ */ ECIPP_ALIGNMENT_UWORD 65535 Compu_IDENTITY 0 65535 PHYS_UNIT "System ID + DTC" /end CHARACTERISTIC
/begin CHARACTERISTIC FCdc4_Sec9_low "FCtl_DTC_0x04(945)" VALUE 0x001E47F8 /* @ECU_Address@FCtl_DTC_0x04@0x024C4762@ */ ECIPP_ALIGNMENT_UWORD 65535 Compu_IDENTITY 0 65535 PHYS_UNIT "System ID + DTC" /end CHARACTERISTIC
/begin CHARACTERISTIC FCdc4_Sec9_open "FCtl_DTC_0x04(933)" VALUE 0x001E47E0 /* @ECU_Address@FCtl_DTC_0x04@0x024C474A@ */ ECIPP_ALIGNMENT_UWORD 65535 Compu_IDENTITY 0 65535 PHYS_UNIT "System ID + DTC" /end CHARACTERISTIC
/begin CHARACTERISTIC FCdc4_SPK10_IGBT_T "FCtl_DTC_0x04(518)" VALUE 0x001E44A2 /* @ECU_Address@FCtl_DTC_0x04@0x024C440C@ */ ECIPP_ALIGNMENT_UWORD 65535 Compu_IDENTITY 0 65535 PHYS_UNIT "System ID + DTC" /end CHARACTERISTIC
/begin CHARACTERISTIC FCdc4_SPK11_IGBT_T "FCtl_DTC_0x04(1021)" VALUE 0x001E4890 /* @ECU_Address@FCtl_DTC_0x04@0x024C47FA@ */ ECIPP_ALIGNMENT_UWORD 65535 Compu_IDENTITY 0 65535 PHYS_UNIT "System ID + DTC" /end CHARACTERISTIC
/begin CHARACTERISTIC FCdc4_SPK12_IGBT_T "FCtl_DTC_0x04(1022)" VALUE 0x001E4892 /* @ECU_Address@FCtl_DTC_0x04@0x024C47FC@ */ ECIPP_ALIGNMENT_UWORD 65535 Compu_IDENTITY 0 65535 PHYS_UNIT "System ID + DTC" /end CHARACTERISTIC
/begin CHARACTERISTIC FCdc4_SPK2_IGBT_T "FCtl_DTC_0x04(510)" VALUE 0x001E4492 /* @ECU_Address@FCtl_DTC_0x04@0x024C43FC@ */ ECIPP_ALIGNMENT_UWORD 65535 Compu_IDENTITY 0 65535 PHYS_UNIT "System ID + DTC" /end CHARACTERISTIC
/begin CHARACTERISTIC FCdc4_SPK3_IGBT_T "FCtl_DTC_0x04(511)" VALUE 0x001E4494 /* @ECU_Address@FCtl_DTC_0x04@0x024C43FE@ */ ECIPP_ALIGNMENT_UWORD 65535 Compu_IDENTITY 0 65535 PHYS_UNIT "System ID + DTC" /end CHARACTERISTIC
/begin CHARACTERISTIC FCdc4_SPK4_IGBT_T "FCtl_DTC_0x04(512)" VALUE 0x001E4496 /* @ECU_Address@FCtl_DTC_0x04@0x024C4400@ */ ECIPP_ALIGNMENT_UWORD 65535 Compu_IDENTITY 0 65535 PHYS_UNIT "System ID + DTC" /end CHARACTERISTIC
/begin CHARACTERISTIC FCdc4_SPK5_IGBT_T "FCtl_DTC_0x04(513)" VALUE 0x001E4498 /* @ECU_Address@FCtl_DTC_0x04@0x024C4402@ */ ECIPP_ALIGNMENT_UWORD 65535 Compu_IDENTITY 0 65535 PHYS_UNIT "System ID + DTC" /end CHARACTERISTIC
/begin CHARACTERISTIC FCdc4_SPK6_IGBT_T "FCtl_DTC_0x04(514)" VALUE 0x001E449A /* @ECU_Address@FCtl_DTC_0x04@0x024C4404@ */ ECIPP_ALIGNMENT_UWORD 65535 Compu_IDENTITY 0 65535 PHYS_UNIT "System ID + DTC" /end CHARACTERISTIC
/begin CHARACTERISTIC FCdc4_SPK7_IGBT_T "FCtl_DTC_0x04(515)" VALUE 0x001E449C /* @ECU_Address@FCtl_DTC_0x04@0x024C4406@ */ ECIPP_ALIGNMENT_UWORD 65535 Compu_IDENTITY 0 65535 PHYS_UNIT "System ID + DTC" /end CHARACTERISTIC
/begin CHARACTERISTIC FCdc4_SPK8_IGBT_T "FCtl_DTC_0x04(516)" VALUE 0x001E449E /* @ECU_Address@FCtl_DTC_0x04@0x024C4408@ */ ECIPP_ALIGNMENT_UWORD 65535 Compu_IDENTITY 0 65535 PHYS_UNIT "System ID + DTC" /end CHARACTERISTIC
/begin CHARACTERISTIC FCdc4_SPK9_IGBT_T "FCtl_DTC_0x04(517)" VALUE 0x001E44A0 /* @ECU_Address@FCtl_DTC_0x04@0x024C440A@ */ ECIPP_ALIGNMENT_UWORD 65535 Compu_IDENTITY 0 65535 PHYS_UNIT "System ID + DTC" /end CHARACTERISTIC
/begin CHARACTERISTIC FCdc4_SPKD10_coil_fail "FCtl_DTC_0x04(313)" VALUE 0x001E4308 /* @ECU_Address@FCtl_DTC_0x04@0x024C4272@ */ ECIPP_ALIGNMENT_UWORD 65535 Compu_IDENTITY 0 65535 PHYS_UNIT "System ID + DTC" /end CHARACTERISTIC
/begin CHARACTERISTIC FCdc4_SPKD10_dw_hi "FCtl_DTC_0x04(85)" VALUE 0x001E4140 /* @ECU_Address@FCtl_DTC_0x04@0x024C40AA@ */ ECIPP_ALIGNMENT_UWORD 65535 Compu_IDENTITY 0 65535 PHYS_UNIT "System ID + DTC" /end CHARACTERISTIC
/begin CHARACTERISTIC FCdc4_SPKD10_dw_lo "FCtl_DTC_0x04(75)" VALUE 0x001E412C /* @ECU_Address@FCtl_DTC_0x04@0x024C4096@ */ ECIPP_ALIGNMENT_UWORD 65535 Compu_IDENTITY 0 65535 PHYS_UNIT "System ID + DTC" /end CHARACTERISTIC
/begin CHARACTERISTIC FCdc4_SPKD11_coil_fail "FCtl_DTC_0x04(1027)" VALUE 0x001E489C /* @ECU_Address@FCtl_DTC_0x04@0x024C4806@ */ ECIPP_ALIGNMENT_UWORD 65535 Compu_IDENTITY 0 65535 PHYS_UNIT "System ID + DTC" /end CHARACTERISTIC
/begin CHARACTERISTIC FCdc4_SPKD11_dw_hi "FCtl_DTC_0x04(1025)" VALUE 0x001E4898 /* @ECU_Address@FCtl_DTC_0x04@0x024C4802@ */ ECIPP_ALIGNMENT_UWORD 65535 Compu_IDENTITY 0 65535 PHYS_UNIT "System ID + DTC" /end CHARACTERISTIC
/begin CHARACTERISTIC FCdc4_SPKD11_dw_lo "FCtl_DTC_0x04(1023)" VALUE 0x001E4894 /* @ECU_Address@FCtl_DTC_0x04@0x024C47FE@ */ ECIPP_ALIGNMENT_UWORD 65535 Compu_IDENTITY 0 65535 PHYS_UNIT "System ID + DTC" /end CHARACTERISTIC
/begin CHARACTERISTIC FCdc4_SPKD12_coil_fail "FCtl_DTC_0x04(1028)" VALUE 0x001E489E /* @ECU_Address@FCtl_DTC_0x04@0x024C4808@ */ ECIPP_ALIGNMENT_UWORD 65535 Compu_IDENTITY 0 65535 PHYS_UNIT "System ID + DTC" /end CHARACTERISTIC
/begin CHARACTERISTIC FCdc4_SPKD12_dw_hi "FCtl_DTC_0x04(1026)" VALUE 0x001E489A /* @ECU_Address@FCtl_DTC_0x04@0x024C4804@ */ ECIPP_ALIGNMENT_UWORD 65535 Compu_IDENTITY 0 65535 PHYS_UNIT "System ID + DTC" /end CHARACTERISTIC
/begin CHARACTERISTIC FCdc4_SPKD12_dw_lo "FCtl_DTC_0x04(1024)" VALUE 0x001E4896 /* @ECU_Address@FCtl_DTC_0x04@0x024C4800@ */ ECIPP_ALIGNMENT_UWORD 65535 Compu_IDENTITY 0 65535 PHYS_UNIT "System ID + DTC" /end CHARACTERISTIC
/begin CHARACTERISTIC FCdc4_SPKD2_coil_fail "FCtl_DTC_0x04(305)" VALUE 0x001E42F8 /* @ECU_Address@FCtl_DTC_0x04@0x024C4262@ */ ECIPP_ALIGNMENT_UWORD 65535 Compu_IDENTITY 0 65535 PHYS_UNIT "System ID + DTC" /end CHARACTERISTIC
/begin CHARACTERISTIC FCdc4_SPKD2_dw_hi "FCtl_DTC_0x04(77)" VALUE 0x001E4130 /* @ECU_Address@FCtl_DTC_0x04@0x024C409A@ */ ECIPP_ALIGNMENT_UWORD 65535 Compu_IDENTITY 0 65535 PHYS_UNIT "System ID + DTC" /end CHARACTERISTIC
/begin CHARACTERISTIC FCdc4_SPKD2_dw_lo "FCtl_DTC_0x04(67)" VALUE 0x001E411C /* @ECU_Address@FCtl_DTC_0x04@0x024C4086@ */ ECIPP_ALIGNMENT_UWORD 65535 Compu_IDENTITY 0 65535 PHYS_UNIT "System ID + DTC" /end CHARACTERISTIC
/begin CHARACTERISTIC FCdc4_SPKD3_coil_fail "FCtl_DTC_0x04(306)" VALUE 0x001E42FA /* @ECU_Address@FCtl_DTC_0x04@0x024C4264@ */ ECIPP_ALIGNMENT_UWORD 65535 Compu_IDENTITY 0 65535 PHYS_UNIT "System ID + DTC" /end CHARACTERISTIC
/begin CHARACTERISTIC FCdc4_SPKD3_dw_hi "FCtl_DTC_0x04(78)" VALUE 0x001E4132 /* @ECU_Address@FCtl_DTC_0x04@0x024C409C@ */ ECIPP_ALIGNMENT_UWORD 65535 Compu_IDENTITY 0 65535 PHYS_UNIT "System ID + DTC" /end CHARACTERISTIC
/begin CHARACTERISTIC FCdc4_SPKD3_dw_lo "FCtl_DTC_0x04(68)" VALUE 0x001E411E /* @ECU_Address@FCtl_DTC_0x04@0x024C4088@ */ ECIPP_ALIGNMENT_UWORD 65535 Compu_IDENTITY 0 65535 PHYS_UNIT "System ID + DTC" /end CHARACTERISTIC
/begin CHARACTERISTIC FCdc4_SPKD4_coil_fail "FCtl_DTC_0x04(307)" VALUE 0x001E42FC /* @ECU_Address@FCtl_DTC_0x04@0x024C4266@ */ ECIPP_ALIGNMENT_UWORD 65535 Compu_IDENTITY 0 65535 PHYS_UNIT "System ID + DTC" /end CHARACTERISTIC
/begin CHARACTERISTIC FCdc4_SPKD4_dw_hi "FCtl_DTC_0x04(79)" VALUE 0x001E4134 /* @ECU_Address@FCtl_DTC_0x04@0x024C409E@ */ ECIPP_ALIGNMENT_UWORD 65535 Compu_IDENTITY 0 65535 PHYS_UNIT "System ID + DTC" /end CHARACTERISTIC
/begin CHARACTERISTIC FCdc4_SPKD4_dw_lo "FCtl_DTC_0x04(69)" VALUE 0x001E4120 /* @ECU_Address@FCtl_DTC_0x04@0x024C408A@ */ ECIPP_ALIGNMENT_UWORD 65535 Compu_IDENTITY 0 65535 PHYS_UNIT "System ID + DTC" /end CHARACTERISTIC
/begin CHARACTERISTIC FCdc4_SPKD5_coil_fail "FCtl_DTC_0x04(308)" VALUE 0x001E42FE /* @ECU_Address@FCtl_DTC_0x04@0x024C4268@ */ ECIPP_ALIGNMENT_UWORD 65535 Compu_IDENTITY 0 65535 PHYS_UNIT "System ID + DTC" /end CHARACTERISTIC
/begin CHARACTERISTIC FCdc4_SPKD5_dw_hi "FCtl_DTC_0x04(80)" VALUE 0x001E4136 /* @ECU_Address@FCtl_DTC_0x04@0x024C40A0@ */ ECIPP_ALIGNMENT_UWORD 65535 Compu_IDENTITY 0 65535 PHYS_UNIT "System ID + DTC" /end CHARACTERISTIC
/begin CHARACTERISTIC FCdc4_SPKD5_dw_lo "FCtl_DTC_0x04(70)" VALUE 0x001E4122 /* @ECU_Address@FCtl_DTC_0x04@0x024C408C@ */ ECIPP_ALIGNMENT_UWORD 65535 Compu_IDENTITY 0 65535 PHYS_UNIT "System ID + DTC" /end CHARACTERISTIC
/begin CHARACTERISTIC FCdc4_SPKD6_coil_fail "FCtl_DTC_0x04(309)" VALUE 0x001E4300 /* @ECU_Address@FCtl_DTC_0x04@0x024C426A@ */ ECIPP_ALIGNMENT_UWORD 65535 Compu_IDENTITY 0 65535 PHYS_UNIT "System ID + DTC" /end CHARACTERISTIC
/begin CHARACTERISTIC FCdc4_SPKD6_dw_hi "FCtl_DTC_0x04(81)" VALUE 0x001E4138 /* @ECU_Address@FCtl_DTC_0x04@0x024C40A2@ */ ECIPP_ALIGNMENT_UWORD 65535 Compu_IDENTITY 0 65535 PHYS_UNIT "System ID + DTC" /end CHARACTERISTIC
/begin CHARACTERISTIC FCdc4_SPKD6_dw_lo "FCtl_DTC_0x04(71)" VALUE 0x001E4124 /* @ECU_Address@FCtl_DTC_0x04@0x024C408E@ */ ECIPP_ALIGNMENT_UWORD 65535 Compu_IDENTITY 0 65535 PHYS_UNIT "System ID + DTC" /end CHARACTERISTIC
/begin CHARACTERISTIC FCdc4_SPKD7_coil_fail "FCtl_DTC_0x04(310)" VALUE 0x001E4302 /* @ECU_Address@FCtl_DTC_0x04@0x024C426C@ */ ECIPP_ALIGNMENT_UWORD 65535 Compu_IDENTITY 0 65535 PHYS_UNIT "System ID + DTC" /end CHARACTERISTIC
/begin CHARACTERISTIC FCdc4_SPKD7_dw_hi "FCtl_DTC_0x04(82)" VALUE 0x001E413A /* @ECU_Address@FCtl_DTC_0x04@0x024C40A4@ */ ECIPP_ALIGNMENT_UWORD 65535 Compu_IDENTITY 0 65535 PHYS_UNIT "System ID + DTC" /end CHARACTERISTIC
/begin CHARACTERISTIC FCdc4_SPKD7_dw_lo "FCtl_DTC_0x04(72)" VALUE 0x001E4126 /* @ECU_Address@FCtl_DTC_0x04@0x024C4090@ */ ECIPP_ALIGNMENT_UWORD 65535 Compu_IDENTITY 0 65535 PHYS_UNIT "System ID + DTC" /end CHARACTERISTIC
/begin CHARACTERISTIC FCdc4_SPKD8_coil_fail "FCtl_DTC_0x04(311)" VALUE 0x001E4304 /* @ECU_Address@FCtl_DTC_0x04@0x024C426E@ */ ECIPP_ALIGNMENT_UWORD 65535 Compu_IDENTITY 0 65535 PHYS_UNIT "System ID + DTC" /end CHARACTERISTIC
/begin CHARACTERISTIC FCdc4_SPKD8_dw_hi "FCtl_DTC_0x04(83)" VALUE 0x001E413C /* @ECU_Address@FCtl_DTC_0x04@0x024C40A6@ */ ECIPP_ALIGNMENT_UWORD 65535 Compu_IDENTITY 0 65535 PHYS_UNIT "System ID + DTC" /end CHARACTERISTIC
/begin CHARACTERISTIC FCdc4_SPKD8_dw_lo "FCtl_DTC_0x04(73)" VALUE 0x001E4128 /* @ECU_Address@FCtl_DTC_0x04@0x024C4092@ */ ECIPP_ALIGNMENT_UWORD 65535 Compu_IDENTITY 0 65535 PHYS_UNIT "System ID + DTC" /end CHARACTERISTIC
/begin CHARACTERISTIC FCdc4_SPKD9_coil_fail "FCtl_DTC_0x04(312)" VALUE 0x001E4306 /* @ECU_Address@FCtl_DTC_0x04@0x024C4270@ */ ECIPP_ALIGNMENT_UWORD 65535 Compu_IDENTITY 0 65535 PHYS_UNIT "System ID + DTC" /end CHARACTERISTIC
/begin CHARACTERISTIC FCdc4_SPKD9_dw_hi "FCtl_DTC_0x04(84)" VALUE 0x001E413E /* @ECU_Address@FCtl_DTC_0x04@0x024C40A8@ */ ECIPP_ALIGNMENT_UWORD 65535 Compu_IDENTITY 0 65535 PHYS_UNIT "System ID + DTC" /end CHARACTERISTIC
/begin CHARACTERISTIC FCdc4_SPKD9_dw_lo "FCtl_DTC_0x04(74)" VALUE 0x001E412A /* @ECU_Address@FCtl_DTC_0x04@0x024C4094@ */ ECIPP_ALIGNMENT_UWORD 65535 Compu_IDENTITY 0 65535 PHYS_UNIT "System ID + DTC" /end CHARACTERISTIC
/begin CHARACTERISTIC FCdc4_TANK_2_V_maxv "FCtl_DTC_0x04(872)" VALUE 0x001E4766 /* @ECU_Address@FCtl_DTC_0x04@0x024C46D0@ */ ECIPP_ALIGNMENT_UWORD 65535 Compu_IDENTITY 0 65535 PHYS_UNIT "System ID + DTC" /end CHARACTERISTIC
/begin CHARACTERISTIC FCdc4_TANK_2_V_minv "FCtl_DTC_0x04(874)" VALUE 0x001E476A /* @ECU_Address@FCtl_DTC_0x04@0x024C46D4@ */ ECIPP_ALIGNMENT_UWORD 65535 Compu_IDENTITY 0 65535 PHYS_UNIT "System ID + DTC" /end CHARACTERISTIC
/begin CHARACTERISTIC FCdc4_TANK_2_V_slow "FCtl_DTC_0x04(876)" VALUE 0x001E476E /* @ECU_Address@FCtl_DTC_0x04@0x024C46D8@ */ ECIPP_ALIGNMENT_UWORD 65535 Compu_IDENTITY 0 65535 PHYS_UNIT "System ID + DTC" /end CHARACTERISTIC
/begin CHARACTERISTIC FCdc4_UGF_Hv_lo "FCtl_DTC_0x04(243)" VALUE 0x001E427C /* @ECU_Address@FCtl_DTC_0x04@0x024C41E6@ */ ECIPP_ALIGNMENT_UWORD 65535 Compu_IDENTITY 0 65535 PHYS_UNIT "System ID + DTC" /end CHARACTERISTIC
/begin CHARACTERISTIC FCdc4_UGF1_PR_hi "FCtl_DTC_0x04(257)" VALUE 0x001E4298 /* @ECU_Address@FCtl_DTC_0x04@0x024C4202@ */ ECIPP_ALIGNMENT_UWORD 65535 Compu_IDENTITY 0 65535 PHYS_UNIT "System ID + DTC" /end CHARACTERISTIC
/begin CHARACTERISTIC FCdc4_UGF1_PR_lo "FCtl_DTC_0x04(258)" VALUE 0x001E429A /* @ECU_Address@FCtl_DTC_0x04@0x024C4204@ */ ECIPP_ALIGNMENT_UWORD 65535 Compu_IDENTITY 0 65535 PHYS_UNIT "System ID + DTC" /end CHARACTERISTIC
/begin CHARACTERISTIC FCdc4_UGF1_PR_slow "FCtl_DTC_0x04(255)" VALUE 0x001E4294 /* @ECU_Address@FCtl_DTC_0x04@0x024C41FE@ */ ECIPP_ALIGNMENT_UWORD 65535 Compu_IDENTITY 0 65535 PHYS_UNIT "System ID + DTC" /end CHARACTERISTIC
/begin CHARACTERISTIC FCdc4_UGF1_Pv_hi "FCtl_DTC_0x04(252)" VALUE 0x001E428E /* @ECU_Address@FCtl_DTC_0x04@0x024C41F8@ */ ECIPP_ALIGNMENT_UWORD 65535 Compu_IDENTITY 0 65535 PHYS_UNIT "System ID + DTC" /end CHARACTERISTIC
/begin CHARACTERISTIC FCdc4_UGF1_Pv_lo "FCtl_DTC_0x04(253)" VALUE 0x001E4290 /* @ECU_Address@FCtl_DTC_0x04@0x024C41FA@ */ ECIPP_ALIGNMENT_UWORD 65535 Compu_IDENTITY 0 65535 PHYS_UNIT "System ID + DTC" /end CHARACTERISTIC
/begin CHARACTERISTIC FCdc4_UGF1_PvFB_hi "FCtl_DTC_0x04(248)" VALUE 0x001E4286 /* @ECU_Address@FCtl_DTC_0x04@0x024C41F0@ */ ECIPP_ALIGNMENT_UWORD 65535 Compu_IDENTITY 0 65535 PHYS_UNIT "System ID + DTC" /end CHARACTERISTIC
/begin CHARACTERISTIC FCdc4_UGF1_PvFB_lo "FCtl_DTC_0x04(249)" VALUE 0x001E4288 /* @ECU_Address@FCtl_DTC_0x04@0x024C41F2@ */ ECIPP_ALIGNMENT_UWORD 65535 Compu_IDENTITY 0 65535 PHYS_UNIT "System ID + DTC" /end CHARACTERISTIC
/begin CHARACTERISTIC FCdc4_UGF1_R_lo "FCtl_DTC_0x04(245)" VALUE 0x001E4280 /* @ECU_Address@FCtl_DTC_0x04@0x024C41EA@ */ ECIPP_ALIGNMENT_UWORD 65535 Compu_IDENTITY 0 65535 PHYS_UNIT "System ID + DTC" /end CHARACTERISTIC
/begin CHARACTERISTIC FCdc4_UGF1_rtn_hi "FCtl_DTC_0x04(246)" VALUE 0x001E4282 /* @ECU_Address@FCtl_DTC_0x04@0x024C41EC@ */ ECIPP_ALIGNMENT_UWORD 65535 Compu_IDENTITY 0 65535 PHYS_UNIT "System ID + DTC" /end CHARACTERISTIC
/begin CHARACTERISTIC FCdc4_UGF1_rtn_lo "FCtl_DTC_0x04(247)" VALUE 0x001E4284 /* @ECU_Address@FCtl_DTC_0x04@0x024C41EE@ */ ECIPP_ALIGNMENT_UWORD 65535 Compu_IDENTITY 0 65535 PHYS_UNIT "System ID + DTC" /end CHARACTERISTIC
/begin CHARACTERISTIC FCdc4_UGF1_Sv_lo "FCtl_DTC_0x04(251)" VALUE 0x001E428C /* @ECU_Address@FCtl_DTC_0x04@0x024C41F6@ */ ECIPP_ALIGNMENT_UWORD 65535 Compu_IDENTITY 0 65535 PHYS_UNIT "System ID + DTC" /end CHARACTERISTIC
/begin CHARACTERISTIC FCdc4_UGF2_Hv_lo "FCtl_DTC_0x04(410)" VALUE 0x001E43CA /* @ECU_Address@FCtl_DTC_0x04@0x024C4334@ */ ECIPP_ALIGNMENT_UWORD 65535 Compu_IDENTITY 0 65535 PHYS_UNIT "System ID + DTC" /end CHARACTERISTIC
/begin CHARACTERISTIC FCdc4_UGF2_PR_hi "FCtl_DTC_0x04(424)" VALUE 0x001E43E6 /* @ECU_Address@FCtl_DTC_0x04@0x024C4350@ */ ECIPP_ALIGNMENT_UWORD 65535 Compu_IDENTITY 0 65535 PHYS_UNIT "System ID + DTC" /end CHARACTERISTIC
/begin CHARACTERISTIC FCdc4_UGF2_PR_lo "FCtl_DTC_0x04(425)" VALUE 0x001E43E8 /* @ECU_Address@FCtl_DTC_0x04@0x024C4352@ */ ECIPP_ALIGNMENT_UWORD 65535 Compu_IDENTITY 0 65535 PHYS_UNIT "System ID + DTC" /end CHARACTERISTIC
/begin CHARACTERISTIC FCdc4_UGF2_PR_slow "FCtl_DTC_0x04(422)" VALUE 0x001E43E2 /* @ECU_Address@FCtl_DTC_0x04@0x024C434C@ */ ECIPP_ALIGNMENT_UWORD 65535 Compu_IDENTITY 0 65535 PHYS_UNIT "System ID + DTC" /end CHARACTERISTIC
/begin CHARACTERISTIC FCdc4_UGF2_Pv_hi "FCtl_DTC_0x04(419)" VALUE 0x001E43DC /* @ECU_Address@FCtl_DTC_0x04@0x024C4346@ */ ECIPP_ALIGNMENT_UWORD 65535 Compu_IDENTITY 0 65535 PHYS_UNIT "System ID + DTC" /end CHARACTERISTIC
/begin CHARACTERISTIC FCdc4_UGF2_Pv_lo "FCtl_DTC_0x04(420)" VALUE 0x001E43DE /* @ECU_Address@FCtl_DTC_0x04@0x024C4348@ */ ECIPP_ALIGNMENT_UWORD 65535 Compu_IDENTITY 0 65535 PHYS_UNIT "System ID + DTC" /end CHARACTERISTIC
/begin CHARACTERISTIC FCdc4_UGF2_PvFB_hi "FCtl_DTC_0x04(415)" VALUE 0x001E43D4 /* @ECU_Address@FCtl_DTC_0x04@0x024C433E@ */ ECIPP_ALIGNMENT_UWORD 65535 Compu_IDENTITY 0 65535 PHYS_UNIT "System ID + DTC" /end CHARACTERISTIC
/begin CHARACTERISTIC FCdc4_UGF2_PvFB_lo "FCtl_DTC_0x04(416)" VALUE 0x001E43D6 /* @ECU_Address@FCtl_DTC_0x04@0x024C4340@ */ ECIPP_ALIGNMENT_UWORD 65535 Compu_IDENTITY 0 65535 PHYS_UNIT "System ID + DTC" /end CHARACTERISTIC
/begin CHARACTERISTIC FCdc4_UGF2_R_lo "FCtl_DTC_0x04(412)" VALUE 0x001E43CE /* @ECU_Address@FCtl_DTC_0x04@0x024C4338@ */ ECIPP_ALIGNMENT_UWORD 65535 Compu_IDENTITY 0 65535 PHYS_UNIT "System ID + DTC" /end CHARACTERISTIC
/begin CHARACTERISTIC FCdc4_UGF2_rtn_hi "FCtl_DTC_0x04(413)" VALUE 0x001E43D0 /* @ECU_Address@FCtl_DTC_0x04@0x024C433A@ */ ECIPP_ALIGNMENT_UWORD 65535 Compu_IDENTITY 0 65535 PHYS_UNIT "System ID + DTC" /end CHARACTERISTIC
/begin CHARACTERISTIC FCdc4_UGF2_rtn_lo "FCtl_DTC_0x04(414)" VALUE 0x001E43D2 /* @ECU_Address@FCtl_DTC_0x04@0x024C433C@ */ ECIPP_ALIGNMENT_UWORD 65535 Compu_IDENTITY 0 65535 PHYS_UNIT "System ID + DTC" /end CHARACTERISTIC
/begin CHARACTERISTIC FCdc4_UGF2_Sv_lo "FCtl_DTC_0x04(418)" VALUE 0x001E43DA /* @ECU_Address@FCtl_DTC_0x04@0x024C4344@ */ ECIPP_ALIGNMENT_UWORD 65535 Compu_IDENTITY 0 65535 PHYS_UNIT "System ID + DTC" /end CHARACTERISTIC
/begin CHARACTERISTIC FCdc4_UGF3_Hv_lo "FCtl_DTC_0x04(606)" VALUE 0x001E4552 /* @ECU_Address@FCtl_DTC_0x04@0x024C44BC@ */ ECIPP_ALIGNMENT_UWORD 65535 Compu_IDENTITY 0 65535 PHYS_UNIT "System ID + DTC" /end CHARACTERISTIC
/begin CHARACTERISTIC FCdc4_UGF3_PR_hi "FCtl_DTC_0x04(620)" VALUE 0x001E456E /* @ECU_Address@FCtl_DTC_0x04@0x024C44D8@ */ ECIPP_ALIGNMENT_UWORD 65535 Compu_IDENTITY 0 65535 PHYS_UNIT "System ID + DTC" /end CHARACTERISTIC
/begin CHARACTERISTIC FCdc4_UGF3_PR_lo "FCtl_DTC_0x04(621)" VALUE 0x001E4570 /* @ECU_Address@FCtl_DTC_0x04@0x024C44DA@ */ ECIPP_ALIGNMENT_UWORD 65535 Compu_IDENTITY 0 65535 PHYS_UNIT "System ID + DTC" /end CHARACTERISTIC
/begin CHARACTERISTIC FCdc4_UGF3_PR_slow "FCtl_DTC_0x04(618)" VALUE 0x001E456A /* @ECU_Address@FCtl_DTC_0x04@0x024C44D4@ */ ECIPP_ALIGNMENT_UWORD 65535 Compu_IDENTITY 0 65535 PHYS_UNIT "System ID + DTC" /end CHARACTERISTIC
/begin CHARACTERISTIC FCdc4_UGF3_Pv_hi "FCtl_DTC_0x04(615)" VALUE 0x001E4564 /* @ECU_Address@FCtl_DTC_0x04@0x024C44CE@ */ ECIPP_ALIGNMENT_UWORD 65535 Compu_IDENTITY 0 65535 PHYS_UNIT "System ID + DTC" /end CHARACTERISTIC
/begin CHARACTERISTIC FCdc4_UGF3_Pv_lo "FCtl_DTC_0x04(616)" VALUE 0x001E4566 /* @ECU_Address@FCtl_DTC_0x04@0x024C44D0@ */ ECIPP_ALIGNMENT_UWORD 65535 Compu_IDENTITY 0 65535 PHYS_UNIT "System ID + DTC" /end CHARACTERISTIC
/begin CHARACTERISTIC FCdc4_UGF3_PvFB_hi "FCtl_DTC_0x04(611)" VALUE 0x001E455C /* @ECU_Address@FCtl_DTC_0x04@0x024C44C6@ */ ECIPP_ALIGNMENT_UWORD 65535 Compu_IDENTITY 0 65535 PHYS_UNIT "System ID + DTC" /end CHARACTERISTIC
/begin CHARACTERISTIC FCdc4_UGF3_PvFB_lo "FCtl_DTC_0x04(612)" VALUE 0x001E455E /* @ECU_Address@FCtl_DTC_0x04@0x024C44C8@ */ ECIPP_ALIGNMENT_UWORD 65535 Compu_IDENTITY 0 65535 PHYS_UNIT "System ID + DTC" /end CHARACTERISTIC
/begin CHARACTERISTIC FCdc4_UGF3_R_lo "FCtl_DTC_0x04(608)" VALUE 0x001E4556 /* @ECU_Address@FCtl_DTC_0x04@0x024C44C0@ */ ECIPP_ALIGNMENT_UWORD 65535 Compu_IDENTITY 0 65535 PHYS_UNIT "System ID + DTC" /end CHARACTERISTIC
/begin CHARACTERISTIC FCdc4_UGF3_rtn_hi "FCtl_DTC_0x04(609)" VALUE 0x001E4558 /* @ECU_Address@FCtl_DTC_0x04@0x024C44C2@ */ ECIPP_ALIGNMENT_UWORD 65535 Compu_IDENTITY 0 65535 PHYS_UNIT "System ID + DTC" /end CHARACTERISTIC
/begin CHARACTERISTIC FCdc4_UGF3_rtn_lo "FCtl_DTC_0x04(610)" VALUE 0x001E455A /* @ECU_Address@FCtl_DTC_0x04@0x024C44C4@ */ ECIPP_ALIGNMENT_UWORD 65535 Compu_IDENTITY 0 65535 PHYS_UNIT "System ID + DTC" /end CHARACTERISTIC
/begin CHARACTERISTIC FCdc4_UGF3_Sv_lo "FCtl_DTC_0x04(614)" VALUE 0x001E4562 /* @ECU_Address@FCtl_DTC_0x04@0x024C44CC@ */ ECIPP_ALIGNMENT_UWORD 65535 Compu_IDENTITY 0 65535 PHYS_UNIT "System ID + DTC" /end CHARACTERISTIC
/begin CHARACTERISTIC FCdc4_UGF4_Hv_lo "FCtl_DTC_0x04(629)" VALUE 0x001E4580 /* @ECU_Address@FCtl_DTC_0x04@0x024C44EA@ */ ECIPP_ALIGNMENT_UWORD 65535 Compu_IDENTITY 0 65535 PHYS_UNIT "System ID + DTC" /end CHARACTERISTIC
/begin CHARACTERISTIC FCdc4_UGF4_PR_hi "FCtl_DTC_0x04(643)" VALUE 0x001E459C /* @ECU_Address@FCtl_DTC_0x04@0x024C4506@ */ ECIPP_ALIGNMENT_UWORD 65535 Compu_IDENTITY 0 65535 PHYS_UNIT "System ID + DTC" /end CHARACTERISTIC
/begin CHARACTERISTIC FCdc4_UGF4_PR_lo "FCtl_DTC_0x04(644)" VALUE 0x001E459E /* @ECU_Address@FCtl_DTC_0x04@0x024C4508@ */ ECIPP_ALIGNMENT_UWORD 65535 Compu_IDENTITY 0 65535 PHYS_UNIT "System ID + DTC" /end CHARACTERISTIC
/begin CHARACTERISTIC FCdc4_UGF4_PR_slow "FCtl_DTC_0x04(641)" VALUE 0x001E4598 /* @ECU_Address@FCtl_DTC_0x04@0x024C4502@ */ ECIPP_ALIGNMENT_UWORD 65535 Compu_IDENTITY 0 65535 PHYS_UNIT "System ID + DTC" /end CHARACTERISTIC
/begin CHARACTERISTIC FCdc4_UGF4_Pv_hi "FCtl_DTC_0x04(638)" VALUE 0x001E4592 /* @ECU_Address@FCtl_DTC_0x04@0x024C44FC@ */ ECIPP_ALIGNMENT_UWORD 65535 Compu_IDENTITY 0 65535 PHYS_UNIT "System ID + DTC" /end CHARACTERISTIC
/begin CHARACTERISTIC FCdc4_UGF4_Pv_lo "FCtl_DTC_0x04(639)" VALUE 0x001E4594 /* @ECU_Address@FCtl_DTC_0x04@0x024C44FE@ */ ECIPP_ALIGNMENT_UWORD 65535 Compu_IDENTITY 0 65535 PHYS_UNIT "System ID + DTC" /end CHARACTERISTIC
/begin CHARACTERISTIC FCdc4_UGF4_PvFB_hi "FCtl_DTC_0x04(634)" VALUE 0x001E458A /* @ECU_Address@FCtl_DTC_0x04@0x024C44F4@ */ ECIPP_ALIGNMENT_UWORD 65535 Compu_IDENTITY 0 65535 PHYS_UNIT "System ID + DTC" /end CHARACTERISTIC
/begin CHARACTERISTIC FCdc4_UGF4_PvFB_lo "FCtl_DTC_0x04(635)" VALUE 0x001E458C /* @ECU_Address@FCtl_DTC_0x04@0x024C44F6@ */ ECIPP_ALIGNMENT_UWORD 65535 Compu_IDENTITY 0 65535 PHYS_UNIT "System ID + DTC" /end CHARACTERISTIC
/begin CHARACTERISTIC FCdc4_UGF4_R_lo "FCtl_DTC_0x04(631)" VALUE 0x001E4584 /* @ECU_Address@FCtl_DTC_0x04@0x024C44EE@ */ ECIPP_ALIGNMENT_UWORD 65535 Compu_IDENTITY 0 65535 PHYS_UNIT "System ID + DTC" /end CHARACTERISTIC
/begin CHARACTERISTIC FCdc4_UGF4_rtn_hi "FCtl_DTC_0x04(632)" VALUE 0x001E4586 /* @ECU_Address@FCtl_DTC_0x04@0x024C44F0@ */ ECIPP_ALIGNMENT_UWORD 65535 Compu_IDENTITY 0 65535 PHYS_UNIT "System ID + DTC" /end CHARACTERISTIC
/begin CHARACTERISTIC FCdc4_UGF4_rtn_lo "FCtl_DTC_0x04(633)" VALUE 0x001E4588 /* @ECU_Address@FCtl_DTC_0x04@0x024C44F2@ */ ECIPP_ALIGNMENT_UWORD 65535 Compu_IDENTITY 0 65535 PHYS_UNIT "System ID + DTC" /end CHARACTERISTIC
/begin CHARACTERISTIC FCdc4_UGF4_Sv_lo "FCtl_DTC_0x04(637)" VALUE 0x001E4590 /* @ECU_Address@FCtl_DTC_0x04@0x024C44FA@ */ ECIPP_ALIGNMENT_UWORD 65535 Compu_IDENTITY 0 65535 PHYS_UNIT "System ID + DTC" /end CHARACTERISTIC
/begin CHARACTERISTIC FCdtc_AL2_hi "FCtl_DTC(40)" VALUE 0x001E38BA /* @ECU_Address@FCtl_DTC@0x021B5050@ */ ECIPP_ALIGNMENT_UWORD 65535 Compu_IDENTITY 0 65535 PHYS_UNIT "DTC" /end CHARACTERISTIC
/begin CHARACTERISTIC FCdtc_AL2_lo "FCtl_DTC(41)" VALUE 0x001E38BC /* @ECU_Address@FCtl_DTC@0x021B5052@ */ ECIPP_ALIGNMENT_UWORD 65535 Compu_IDENTITY 0 65535 PHYS_UNIT "DTC" /end CHARACTERISTIC
/begin CHARACTERISTIC FCdtc_CD_MF10 "FCtl_DTC(994)" VALUE 0x001E402E /* @ECU_Address@FCtl_DTC@0x021B57C4@ */ ECIPP_ALIGNMENT_UWORD 65535 Compu_IDENTITY 0 65535 PHYS_UNIT "DTC" /end CHARACTERISTIC
/begin CHARACTERISTIC FCdtc_CD_MF11 "FCtl_DTC(995)" VALUE 0x001E4030 /* @ECU_Address@FCtl_DTC@0x021B57C6@ */ ECIPP_ALIGNMENT_UWORD 65535 Compu_IDENTITY 0 65535 PHYS_UNIT "DTC" /end CHARACTERISTIC
/begin CHARACTERISTIC FCdtc_CD_MF12 "FCtl_DTC(996)" VALUE 0x001E4032 /* @ECU_Address@FCtl_DTC@0x021B57C8@ */ ECIPP_ALIGNMENT_UWORD 65535 Compu_IDENTITY 0 65535 PHYS_UNIT "DTC" /end CHARACTERISTIC
/begin CHARACTERISTIC FCdtc_CD_MF2 "FCtl_DTC(986)" VALUE 0x001E401E /* @ECU_Address@FCtl_DTC@0x021B57B4@ */ ECIPP_ALIGNMENT_UWORD 65535 Compu_IDENTITY 0 65535 PHYS_UNIT "DTC" /end CHARACTERISTIC
/begin CHARACTERISTIC FCdtc_CD_MF3 "FCtl_DTC(987)" VALUE 0x001E4020 /* @ECU_Address@FCtl_DTC@0x021B57B6@ */ ECIPP_ALIGNMENT_UWORD 65535 Compu_IDENTITY 0 65535 PHYS_UNIT "DTC" /end CHARACTERISTIC
/begin CHARACTERISTIC FCdtc_CD_MF4 "FCtl_DTC(988)" VALUE 0x001E4022 /* @ECU_Address@FCtl_DTC@0x021B57B8@ */ ECIPP_ALIGNMENT_UWORD 65535 Compu_IDENTITY 0 65535 PHYS_UNIT "DTC" /end CHARACTERISTIC
/begin CHARACTERISTIC FCdtc_CD_MF5 "FCtl_DTC(989)" VALUE 0x001E4024 /* @ECU_Address@FCtl_DTC@0x021B57BA@ */ ECIPP_ALIGNMENT_UWORD 65535 Compu_IDENTITY 0 65535 PHYS_UNIT "DTC" /end CHARACTERISTIC
/begin CHARACTERISTIC FCdtc_CD_MF6 "FCtl_DTC(990)" VALUE 0x001E4026 /* @ECU_Address@FCtl_DTC@0x021B57BC@ */ ECIPP_ALIGNMENT_UWORD 65535 Compu_IDENTITY 0 65535 PHYS_UNIT "DTC" /end CHARACTERISTIC
/begin CHARACTERISTIC FCdtc_CD_MF7 "FCtl_DTC(991)" VALUE 0x001E4028 /* @ECU_Address@FCtl_DTC@0x021B57BE@ */ ECIPP_ALIGNMENT_UWORD 65535 Compu_IDENTITY 0 65535 PHYS_UNIT "DTC" /end CHARACTERISTIC
/begin CHARACTERISTIC FCdtc_CD_MF8 "FCtl_DTC(992)" VALUE 0x001E402A /* @ECU_Address@FCtl_DTC@0x021B57C0@ */ ECIPP_ALIGNMENT_UWORD 65535 Compu_IDENTITY 0 65535 PHYS_UNIT "DTC" /end CHARACTERISTIC
/begin CHARACTERISTIC FCdtc_CD_MF9 "FCtl_DTC(993)" VALUE 0x001E402C /* @ECU_Address@FCtl_DTC@0x021B57C2@ */ ECIPP_ALIGNMENT_UWORD 65535 Compu_IDENTITY 0 65535 PHYS_UNIT "DTC" /end CHARACTERISTIC
/begin CHARACTERISTIC FCdtc_CFVxminFT "FCtl_DTC(533)" VALUE 0x001E3C94 /* @ECU_Address@FCtl_DTC@0x021B542A@ */ ECIPP_ALIGNMENT_UWORD 65535 Compu_IDENTITY 0 65535 PHYS_UNIT "DTC" /end CHARACTERISTIC
/begin CHARACTERISTIC FCdtc_CL2_hi "FCtl_DTC(34)" VALUE 0x001E38AE /* @ECU_Address@FCtl_DTC@0x021B5044@ */ ECIPP_ALIGNMENT_UWORD 65535 Compu_IDENTITY 0 65535 PHYS_UNIT "DTC" /end CHARACTERISTIC
/begin CHARACTERISTIC FCdtc_CL2_lo "FCtl_DTC(35)" VALUE 0x001E38B0 /* @ECU_Address@FCtl_DTC@0x021B5046@ */ ECIPP_ALIGNMENT_UWORD 65535 Compu_IDENTITY 0 65535 PHYS_UNIT "DTC" /end CHARACTERISTIC
/begin CHARACTERISTIC FCdtc_CM2_unresp "FCtl_DTC(800)" VALUE 0x001E3EAA /* @ECU_Address@FCtl_DTC@0x021B5640@ */ ECIPP_ALIGNMENT_UWORD 65535 Compu_IDENTITY 0 65535 PHYS_UNIT "DTC" /end CHARACTERISTIC
/begin CHARACTERISTIC FCdtc_CM2gsln_inact "FCtl_DTC(199)" VALUE 0x001E39F8 /* @ECU_Address@FCtl_DTC@0x021B518E@ */ ECIPP_ALIGNMENT_UWORD 65535 Compu_IDENTITY 0 65535 PHYS_UNIT "DTC" /end CHARACTERISTIC
/begin CHARACTERISTIC FCdtc_EGO4_open "FCtl_DTC(200)" VALUE 0x001E39FA /* @ECU_Address@FCtl_DTC@0x021B5190@ */ ECIPP_ALIGNMENT_UWORD 65535 Compu_IDENTITY 0 65535 PHYS_UNIT "DTC" /end CHARACTERISTIC
/begin CHARACTERISTIC FCdtc_EMWT2_HiExp1 "FCtl_DTC(226)" VALUE 0x001E3A2E /* @ECU_Address@FCtl_DTC@0x021B51C4@ */ ECIPP_ALIGNMENT_UWORD 65535 Compu_IDENTITY 0 65535 PHYS_UNIT "DTC" /end CHARACTERISTIC
/begin CHARACTERISTIC FCdtc_EMWT2_HiExp2 "FCtl_DTC(228)" VALUE 0x001E3A32 /* @ECU_Address@FCtl_DTC@0x021B51C8@ */ ECIPP_ALIGNMENT_UWORD 65535 Compu_IDENTITY 0 65535 PHYS_UNIT "DTC" /end CHARACTERISTIC
/begin CHARACTERISTIC FCdtc_EMWT2_maxv "FCtl_DTC(222)" VALUE 0x001E3A26 /* @ECU_Address@FCtl_DTC@0x021B51BC@ */ ECIPP_ALIGNMENT_UWORD 65535 Compu_IDENTITY 0 65535 PHYS_UNIT "DTC" /end CHARACTERISTIC
/begin CHARACTERISTIC FCdtc_EMWT2_minv "FCtl_DTC(224)" VALUE 0x001E3A2A /* @ECU_Address@FCtl_DTC@0x021B51C0@ */ ECIPP_ALIGNMENT_UWORD 65535 Compu_IDENTITY 0 65535 PHYS_UNIT "DTC" /end CHARACTERISTIC
/begin CHARACTERISTIC FCdtc_ERWT2_HiExp1 "FCtl_DTC(238)" VALUE 0x001E3A46 /* @ECU_Address@FCtl_DTC@0x021B51DC@ */ ECIPP_ALIGNMENT_UWORD 65535 Compu_IDENTITY 0 65535 PHYS_UNIT "DTC" /end CHARACTERISTIC
/begin CHARACTERISTIC FCdtc_ERWT2_HiExp2 "FCtl_DTC(240)" VALUE 0x001E3A4A /* @ECU_Address@FCtl_DTC@0x021B51E0@ */ ECIPP_ALIGNMENT_UWORD 65535 Compu_IDENTITY 0 65535 PHYS_UNIT "DTC" /end CHARACTERISTIC
/begin CHARACTERISTIC FCdtc_ERWT2_maxv "FCtl_DTC(234)" VALUE 0x001E3A3E /* @ECU_Address@FCtl_DTC@0x021B51D4@ */ ECIPP_ALIGNMENT_UWORD 65535 Compu_IDENTITY 0 65535 PHYS_UNIT "DTC" /end CHARACTERISTIC
/begin CHARACTERISTIC FCdtc_ERWT2_minv "FCtl_DTC(236)" VALUE 0x001E3A42 /* @ECU_Address@FCtl_DTC@0x021B51D8@ */ ECIPP_ALIGNMENT_UWORD 65535 Compu_IDENTITY 0 65535 PHYS_UNIT "DTC" /end CHARACTERISTIC
/begin CHARACTERISTIC FCdtc_GLOW10_open "FCtl_DTC(492)" VALUE 0x001E3C42 /* @ECU_Address@FCtl_DTC@0x021B53D8@ */ ECIPP_ALIGNMENT_UWORD 65535 Compu_IDENTITY 0 65535 PHYS_UNIT "DTC" /end CHARACTERISTIC
/begin CHARACTERISTIC FCdtc_GLOW10_short "FCtl_DTC(502)" VALUE 0x001E3C56 /* @ECU_Address@FCtl_DTC@0x021B53EC@ */ ECIPP_ALIGNMENT_UWORD 65535 Compu_IDENTITY 0 65535 PHYS_UNIT "DTC" /end CHARACTERISTIC
/begin CHARACTERISTIC FCdtc_GLOW11_open "FCtl_DTC(1033)" VALUE 0x001E407C /* @ECU_Address@FCtl_DTC@0x021B5812@ */ ECIPP_ALIGNMENT_UWORD 65535 Compu_IDENTITY 0 65535 PHYS_UNIT "DTC" /end CHARACTERISTIC
/begin CHARACTERISTIC FCdtc_GLOW11_short "FCtl_DTC(1035)" VALUE 0x001E4080 /* @ECU_Address@FCtl_DTC@0x021B5816@ */ ECIPP_ALIGNMENT_UWORD 65535 Compu_IDENTITY 0 65535 PHYS_UNIT "DTC" /end CHARACTERISTIC
/begin CHARACTERISTIC FCdtc_GLOW12_open "FCtl_DTC(1034)" VALUE 0x001E407E /* @ECU_Address@FCtl_DTC@0x021B5814@ */ ECIPP_ALIGNMENT_UWORD 65535 Compu_IDENTITY 0 65535 PHYS_UNIT "DTC" /end CHARACTERISTIC
/begin CHARACTERISTIC FCdtc_GLOW12_short "FCtl_DTC(1036)" VALUE 0x001E4082 /* @ECU_Address@FCtl_DTC@0x021B5818@ */ ECIPP_ALIGNMENT_UWORD 65535 Compu_IDENTITY 0 65535 PHYS_UNIT "DTC" /end CHARACTERISTIC
/begin CHARACTERISTIC FCdtc_GLOW2_open "FCtl_DTC(484)" VALUE 0x001E3C32 /* @ECU_Address@FCtl_DTC@0x021B53C8@ */ ECIPP_ALIGNMENT_UWORD 65535 Compu_IDENTITY 0 65535 PHYS_UNIT "DTC" /end CHARACTERISTIC
/begin CHARACTERISTIC FCdtc_GLOW2_short "FCtl_DTC(494)" VALUE 0x001E3C46 /* @ECU_Address@FCtl_DTC@0x021B53DC@ */ ECIPP_ALIGNMENT_UWORD 65535 Compu_IDENTITY 0 65535 PHYS_UNIT "DTC" /end CHARACTERISTIC
/begin CHARACTERISTIC FCdtc_GLOW3_open "FCtl_DTC(485)" VALUE 0x001E3C34 /* @ECU_Address@FCtl_DTC@0x021B53CA@ */ ECIPP_ALIGNMENT_UWORD 65535 Compu_IDENTITY 0 65535 PHYS_UNIT "DTC" /end CHARACTERISTIC
/begin CHARACTERISTIC FCdtc_GLOW3_short "FCtl_DTC(495)" VALUE 0x001E3C48 /* @ECU_Address@FCtl_DTC@0x021B53DE@ */ ECIPP_ALIGNMENT_UWORD 65535 Compu_IDENTITY 0 65535 PHYS_UNIT "DTC" /end CHARACTERISTIC
/begin CHARACTERISTIC FCdtc_GLOW4_open "FCtl_DTC(486)" VALUE 0x001E3C36 /* @ECU_Address@FCtl_DTC@0x021B53CC@ */ ECIPP_ALIGNMENT_UWORD 65535 Compu_IDENTITY 0 65535 PHYS_UNIT "DTC" /end CHARACTERISTIC
/begin CHARACTERISTIC FCdtc_GLOW4_short "FCtl_DTC(496)" VALUE 0x001E3C4A /* @ECU_Address@FCtl_DTC@0x021B53E0@ */ ECIPP_ALIGNMENT_UWORD 65535 Compu_IDENTITY 0 65535 PHYS_UNIT "DTC" /end CHARACTERISTIC
/begin CHARACTERISTIC FCdtc_GLOW5_open "FCtl_DTC(487)" VALUE 0x001E3C38 /* @ECU_Address@FCtl_DTC@0x021B53CE@ */ ECIPP_ALIGNMENT_UWORD 65535 Compu_IDENTITY 0 65535 PHYS_UNIT "DTC" /end CHARACTERISTIC
/begin CHARACTERISTIC FCdtc_GLOW5_short "FCtl_DTC(497)" VALUE 0x001E3C4C /* @ECU_Address@FCtl_DTC@0x021B53E2@ */ ECIPP_ALIGNMENT_UWORD 65535 Compu_IDENTITY 0 65535 PHYS_UNIT "DTC" /end CHARACTERISTIC
/begin CHARACTERISTIC FCdtc_GLOW6_open "FCtl_DTC(488)" VALUE 0x001E3C3A /* @ECU_Address@FCtl_DTC@0x021B53D0@ */ ECIPP_ALIGNMENT_UWORD 65535 Compu_IDENTITY 0 65535 PHYS_UNIT "DTC" /end CHARACTERISTIC
/begin CHARACTERISTIC FCdtc_GLOW6_short "FCtl_DTC(498)" VALUE 0x001E3C4E /* @ECU_Address@FCtl_DTC@0x021B53E4@ */ ECIPP_ALIGNMENT_UWORD 65535 Compu_IDENTITY 0 65535 PHYS_UNIT "DTC" /end CHARACTERISTIC
/begin CHARACTERISTIC FCdtc_GLOW7_open "FCtl_DTC(489)" VALUE 0x001E3C3C /* @ECU_Address@FCtl_DTC@0x021B53D2@ */ ECIPP_ALIGNMENT_UWORD 65535 Compu_IDENTITY 0 65535 PHYS_UNIT "DTC" /end CHARACTERISTIC
/begin CHARACTERISTIC FCdtc_GLOW7_short "FCtl_DTC(499)" VALUE 0x001E3C50 /* @ECU_Address@FCtl_DTC@0x021B53E6@ */ ECIPP_ALIGNMENT_UWORD 65535 Compu_IDENTITY 0 65535 PHYS_UNIT "DTC" /end CHARACTERISTIC
/begin CHARACTERISTIC FCdtc_GLOW8_open "FCtl_DTC(490)" VALUE 0x001E3C3E /* @ECU_Address@FCtl_DTC@0x021B53D4@ */ ECIPP_ALIGNMENT_UWORD 65535 Compu_IDENTITY 0 65535 PHYS_UNIT "DTC" /end CHARACTERISTIC
/begin CHARACTERISTIC FCdtc_GLOW8_short "FCtl_DTC(500)" VALUE 0x001E3C52 /* @ECU_Address@FCtl_DTC@0x021B53E8@ */ ECIPP_ALIGNMENT_UWORD 65535 Compu_IDENTITY 0 65535 PHYS_UNIT "DTC" /end CHARACTERISTIC
/begin CHARACTERISTIC FCdtc_GLOW9_open "FCtl_DTC(491)" VALUE 0x001E3C40 /* @ECU_Address@FCtl_DTC@0x021B53D6@ */ ECIPP_ALIGNMENT_UWORD 65535 Compu_IDENTITY 0 65535 PHYS_UNIT "DTC" /end CHARACTERISTIC
/begin CHARACTERISTIC FCdtc_GLOW9_short "FCtl_DTC(501)" VALUE 0x001E3C54 /* @ECU_Address@FCtl_DTC@0x021B53EA@ */ ECIPP_ALIGNMENT_UWORD 65535 Compu_IDENTITY 0 65535 PHYS_UNIT "DTC" /end CHARACTERISTIC
/begin CHARACTERISTIC FCdtc_ICAVD10_mis "FCtl_DTC(315)" VALUE 0x001E3AE0 /* @ECU_Address@FCtl_DTC@0x021B5276@ */ ECIPP_ALIGNMENT_UWORD 65535 Compu_IDENTITY 0 65535 PHYS_UNIT "DTC" /end CHARACTERISTIC
/begin CHARACTERISTIC FCdtc_ICAVD10_miscat "FCtl_DTC(317)" VALUE 0x001E3AE4 /* @ECU_Address@FCtl_DTC@0x021B527A@ */ ECIPP_ALIGNMENT_UWORD 65535 Compu_IDENTITY 0 65535 PHYS_UNIT "DTC" /end CHARACTERISTIC
/begin CHARACTERISTIC FCdtc_ICAVD11_mis "FCtl_DTC(1029)" VALUE 0x001E4074 /* @ECU_Address@FCtl_DTC@0x021B580A@ */ ECIPP_ALIGNMENT_UWORD 65535 Compu_IDENTITY 0 65535 PHYS_UNIT "DTC" /end CHARACTERISTIC
/begin CHARACTERISTIC FCdtc_ICAVD11_miscat "FCtl_DTC(1031)" VALUE 0x001E4078 /* @ECU_Address@FCtl_DTC@0x021B580E@ */ ECIPP_ALIGNMENT_UWORD 65535 Compu_IDENTITY 0 65535 PHYS_UNIT "DTC" /end CHARACTERISTIC
/begin CHARACTERISTIC FCdtc_ICAVD12_mis "FCtl_DTC(1030)" VALUE 0x001E4076 /* @ECU_Address@FCtl_DTC@0x021B580C@ */ ECIPP_ALIGNMENT_UWORD 65535 Compu_IDENTITY 0 65535 PHYS_UNIT "DTC" /end CHARACTERISTIC
/begin CHARACTERISTIC FCdtc_ICAVD12_miscat "FCtl_DTC(1032)" VALUE 0x001E407A /* @ECU_Address@FCtl_DTC@0x021B5810@ */ ECIPP_ALIGNMENT_UWORD 65535 Compu_IDENTITY 0 65535 PHYS_UNIT "DTC" /end CHARACTERISTIC
/begin CHARACTERISTIC FCdtc_ICAVD2_mis "FCtl_DTC(260)" VALUE 0x001E3A72 /* @ECU_Address@FCtl_DTC@0x021B5208@ */ ECIPP_ALIGNMENT_UWORD 65535 Compu_IDENTITY 0 65535 PHYS_UNIT "DTC" /end CHARACTERISTIC
/begin CHARACTERISTIC FCdtc_ICAVD2_miscat "FCtl_DTC(268)" VALUE 0x001E3A82 /* @ECU_Address@FCtl_DTC@0x021B5218@ */ ECIPP_ALIGNMENT_UWORD 65535 Compu_IDENTITY 0 65535 PHYS_UNIT "DTC" /end CHARACTERISTIC
/begin CHARACTERISTIC FCdtc_ICAVD3_mis "FCtl_DTC(261)" VALUE 0x001E3A74 /* @ECU_Address@FCtl_DTC@0x021B520A@ */ ECIPP_ALIGNMENT_UWORD 65535 Compu_IDENTITY 0 65535 PHYS_UNIT "DTC" /end CHARACTERISTIC
/begin CHARACTERISTIC FCdtc_ICAVD3_miscat "FCtl_DTC(269)" VALUE 0x001E3A84 /* @ECU_Address@FCtl_DTC@0x021B521A@ */ ECIPP_ALIGNMENT_UWORD 65535 Compu_IDENTITY 0 65535 PHYS_UNIT "DTC" /end CHARACTERISTIC
/begin CHARACTERISTIC FCdtc_ICAVD4_mis "FCtl_DTC(262)" VALUE 0x001E3A76 /* @ECU_Address@FCtl_DTC@0x021B520C@ */ ECIPP_ALIGNMENT_UWORD 65535 Compu_IDENTITY 0 65535 PHYS_UNIT "DTC" /end CHARACTERISTIC
/begin CHARACTERISTIC FCdtc_ICAVD4_miscat "FCtl_DTC(270)" VALUE 0x001E3A86 /* @ECU_Address@FCtl_DTC@0x021B521C@ */ ECIPP_ALIGNMENT_UWORD 65535 Compu_IDENTITY 0 65535 PHYS_UNIT "DTC" /end CHARACTERISTIC
/begin CHARACTERISTIC FCdtc_ICAVD5_mis "FCtl_DTC(263)" VALUE 0x001E3A78 /* @ECU_Address@FCtl_DTC@0x021B520E@ */ ECIPP_ALIGNMENT_UWORD 65535 Compu_IDENTITY 0 65535 PHYS_UNIT "DTC" /end CHARACTERISTIC
/begin CHARACTERISTIC FCdtc_ICAVD5_miscat "FCtl_DTC(271)" VALUE 0x001E3A88 /* @ECU_Address@FCtl_DTC@0x021B521E@ */ ECIPP_ALIGNMENT_UWORD 65535 Compu_IDENTITY 0 65535 PHYS_UNIT "DTC" /end CHARACTERISTIC
/begin CHARACTERISTIC FCdtc_ICAVD6_mis "FCtl_DTC(264)" VALUE 0x001E3A7A /* @ECU_Address@FCtl_DTC@0x021B5210@ */ ECIPP_ALIGNMENT_UWORD 65535 Compu_IDENTITY 0 65535 PHYS_UNIT "DTC" /end CHARACTERISTIC
/begin CHARACTERISTIC FCdtc_ICAVD6_miscat "FCtl_DTC(272)" VALUE 0x001E3A8A /* @ECU_Address@FCtl_DTC@0x021B5220@ */ ECIPP_ALIGNMENT_UWORD 65535 Compu_IDENTITY 0 65535 PHYS_UNIT "DTC" /end CHARACTERISTIC
/begin CHARACTERISTIC FCdtc_ICAVD7_mis "FCtl_DTC(265)" VALUE 0x001E3A7C /* @ECU_Address@FCtl_DTC@0x021B5212@ */ ECIPP_ALIGNMENT_UWORD 65535 Compu_IDENTITY 0 65535 PHYS_UNIT "DTC" /end CHARACTERISTIC
/begin CHARACTERISTIC FCdtc_ICAVD7_miscat "FCtl_DTC(273)" VALUE 0x001E3A8C /* @ECU_Address@FCtl_DTC@0x021B5222@ */ ECIPP_ALIGNMENT_UWORD 65535 Compu_IDENTITY 0 65535 PHYS_UNIT "DTC" /end CHARACTERISTIC
/begin CHARACTERISTIC FCdtc_ICAVD8_mis "FCtl_DTC(266)" VALUE 0x001E3A7E /* @ECU_Address@FCtl_DTC@0x021B5214@ */ ECIPP_ALIGNMENT_UWORD 65535 Compu_IDENTITY 0 65535 PHYS_UNIT "DTC" /end CHARACTERISTIC
/begin CHARACTERISTIC FCdtc_ICAVD8_miscat "FCtl_DTC(274)" VALUE 0x001E3A8E /* @ECU_Address@FCtl_DTC@0x021B5224@ */ ECIPP_ALIGNMENT_UWORD 65535 Compu_IDENTITY 0 65535 PHYS_UNIT "DTC" /end CHARACTERISTIC
/begin CHARACTERISTIC FCdtc_ICAVD9_mis "FCtl_DTC(314)" VALUE 0x001E3ADE /* @ECU_Address@FCtl_DTC@0x021B5274@ */ ECIPP_ALIGNMENT_UWORD 65535 Compu_IDENTITY 0 65535 PHYS_UNIT "DTC" /end CHARACTERISTIC
/begin CHARACTERISTIC FCdtc_ICAVD9_miscat "FCtl_DTC(316)" VALUE 0x001E3AE2 /* @ECU_Address@FCtl_DTC@0x021B5278@ */ ECIPP_ALIGNMENT_UWORD 65535 Compu_IDENTITY 0 65535 PHYS_UNIT "DTC" /end CHARACTERISTIC
/begin CHARACTERISTIC FCdtc_INJD10_off_lo "FCtl_DTC(55)" VALUE 0x001E38D8 /* @ECU_Address@FCtl_DTC@0x021B506E@ */ ECIPP_ALIGNMENT_UWORD 65535 Compu_IDENTITY 0 65535 PHYS_UNIT "DTC" /end CHARACTERISTIC
/begin CHARACTERISTIC FCdtc_INJD10_on_hi "FCtl_DTC(65)" VALUE 0x001E38EC /* @ECU_Address@FCtl_DTC@0x021B5082@ */ ECIPP_ALIGNMENT_UWORD 65535 Compu_IDENTITY 0 65535 PHYS_UNIT "DTC" /end CHARACTERISTIC
/begin CHARACTERISTIC FCdtc_INJD11_off_lo "FCtl_DTC(1017)" VALUE 0x001E405C /* @ECU_Address@FCtl_DTC@0x021B57F2@ */ ECIPP_ALIGNMENT_UWORD 65535 Compu_IDENTITY 0 65535 PHYS_UNIT "DTC" /end CHARACTERISTIC
/begin CHARACTERISTIC FCdtc_INJD11_on_hi "FCtl_DTC(1019)" VALUE 0x001E4060 /* @ECU_Address@FCtl_DTC@0x021B57F6@ */ ECIPP_ALIGNMENT_UWORD 65535 Compu_IDENTITY 0 65535 PHYS_UNIT "DTC" /end CHARACTERISTIC
/begin CHARACTERISTIC FCdtc_INJD12_off_lo "FCtl_DTC(1018)" VALUE 0x001E405E /* @ECU_Address@FCtl_DTC@0x021B57F4@ */ ECIPP_ALIGNMENT_UWORD 65535 Compu_IDENTITY 0 65535 PHYS_UNIT "DTC" /end CHARACTERISTIC
/begin CHARACTERISTIC FCdtc_INJD12_on_hi "FCtl_DTC(1020)" VALUE 0x001E4062 /* @ECU_Address@FCtl_DTC@0x021B57F8@ */ ECIPP_ALIGNMENT_UWORD 65535 Compu_IDENTITY 0 65535 PHYS_UNIT "DTC" /end CHARACTERISTIC
/begin CHARACTERISTIC FCdtc_INJD2_boost_lo "FCtl_DTC(579)" VALUE 0x001E3CF0 /* @ECU_Address@FCtl_DTC@0x021B5486@ */ ECIPP_ALIGNMENT_UWORD 65535 Compu_IDENTITY 0 65535 PHYS_UNIT "DTC" /end CHARACTERISTIC
/begin CHARACTERISTIC FCdtc_INJD2_HS_Ihi "FCtl_DTC(563)" VALUE 0x001E3CD0 /* @ECU_Address@FCtl_DTC@0x021B5466@ */ ECIPP_ALIGNMENT_UWORD 65535 Compu_IDENTITY 0 65535 PHYS_UNIT "DTC" /end CHARACTERISTIC
/begin CHARACTERISTIC FCdtc_INJD2_HW_int "FCtl_DTC(581)" VALUE 0x001E3CF4 /* @ECU_Address@FCtl_DTC@0x021B548A@ */ ECIPP_ALIGNMENT_UWORD 65535 Compu_IDENTITY 0 65535 PHYS_UNIT "DTC" /end CHARACTERISTIC
/begin CHARACTERISTIC FCdtc_INJD2_LS_Ihi "FCtl_DTC(571)" VALUE 0x001E3CE0 /* @ECU_Address@FCtl_DTC@0x021B5476@ */ ECIPP_ALIGNMENT_UWORD 65535 Compu_IDENTITY 0 65535 PHYS_UNIT "DTC" /end CHARACTERISTIC
/begin CHARACTERISTIC FCdtc_INJD2_off_lo "FCtl_DTC(47)" VALUE 0x001E38C8 /* @ECU_Address@FCtl_DTC@0x021B505E@ */ ECIPP_ALIGNMENT_UWORD 65535 Compu_IDENTITY 0 65535 PHYS_UNIT "DTC" /end CHARACTERISTIC
/begin CHARACTERISTIC FCdtc_INJD2_on_hi "FCtl_DTC(57)" VALUE 0x001E38DC /* @ECU_Address@FCtl_DTC@0x021B5072@ */ ECIPP_ALIGNMENT_UWORD 65535 Compu_IDENTITY 0 65535 PHYS_UNIT "DTC" /end CHARACTERISTIC
/begin CHARACTERISTIC FCdtc_INJD3_HS_Ihi "FCtl_DTC(564)" VALUE 0x001E3CD2 /* @ECU_Address@FCtl_DTC@0x021B5468@ */ ECIPP_ALIGNMENT_UWORD 65535 Compu_IDENTITY 0 65535 PHYS_UNIT "DTC" /end CHARACTERISTIC
/begin CHARACTERISTIC FCdtc_INJD3_LS_Ihi "FCtl_DTC(572)" VALUE 0x001E3CE2 /* @ECU_Address@FCtl_DTC@0x021B5478@ */ ECIPP_ALIGNMENT_UWORD 65535 Compu_IDENTITY 0 65535 PHYS_UNIT "DTC" /end CHARACTERISTIC
/begin CHARACTERISTIC FCdtc_INJD3_off_lo "FCtl_DTC(48)" VALUE 0x001E38CA /* @ECU_Address@FCtl_DTC@0x021B5060@ */ ECIPP_ALIGNMENT_UWORD 65535 Compu_IDENTITY 0 65535 PHYS_UNIT "DTC" /end CHARACTERISTIC
/begin CHARACTERISTIC FCdtc_INJD3_on_hi "FCtl_DTC(58)" VALUE 0x001E38DE /* @ECU_Address@FCtl_DTC@0x021B5074@ */ ECIPP_ALIGNMENT_UWORD 65535 Compu_IDENTITY 0 65535 PHYS_UNIT "DTC" /end CHARACTERISTIC
/begin CHARACTERISTIC FCdtc_INJD4_HS_Ihi "FCtl_DTC(565)" VALUE 0x001E3CD4 /* @ECU_Address@FCtl_DTC@0x021B546A@ */ ECIPP_ALIGNMENT_UWORD 65535 Compu_IDENTITY 0 65535 PHYS_UNIT "DTC" /end CHARACTERISTIC
/begin CHARACTERISTIC FCdtc_INJD4_LS_Ihi "FCtl_DTC(573)" VALUE 0x001E3CE4 /* @ECU_Address@FCtl_DTC@0x021B547A@ */ ECIPP_ALIGNMENT_UWORD 65535 Compu_IDENTITY 0 65535 PHYS_UNIT "DTC" /end CHARACTERISTIC
/begin CHARACTERISTIC FCdtc_INJD4_off_lo "FCtl_DTC(49)" VALUE 0x001E38CC /* @ECU_Address@FCtl_DTC@0x021B5062@ */ ECIPP_ALIGNMENT_UWORD 65535 Compu_IDENTITY 0 65535 PHYS_UNIT "DTC" /end CHARACTERISTIC
/begin CHARACTERISTIC FCdtc_INJD4_on_hi "FCtl_DTC(59)" VALUE 0x001E38E0 /* @ECU_Address@FCtl_DTC@0x021B5076@ */ ECIPP_ALIGNMENT_UWORD 65535 Compu_IDENTITY 0 65535 PHYS_UNIT "DTC" /end CHARACTERISTIC
/begin CHARACTERISTIC FCdtc_INJD5_HS_Ihi "FCtl_DTC(566)" VALUE 0x001E3CD6 /* @ECU_Address@FCtl_DTC@0x021B546C@ */ ECIPP_ALIGNMENT_UWORD 65535 Compu_IDENTITY 0 65535 PHYS_UNIT "DTC" /end CHARACTERISTIC
/begin CHARACTERISTIC FCdtc_INJD5_LS_Ihi "FCtl_DTC(574)" VALUE 0x001E3CE6 /* @ECU_Address@FCtl_DTC@0x021B547C@ */ ECIPP_ALIGNMENT_UWORD 65535 Compu_IDENTITY 0 65535 PHYS_UNIT "DTC" /end CHARACTERISTIC
/begin CHARACTERISTIC FCdtc_INJD5_off_lo "FCtl_DTC(50)" VALUE 0x001E38CE /* @ECU_Address@FCtl_DTC@0x021B5064@ */ ECIPP_ALIGNMENT_UWORD 65535 Compu_IDENTITY 0 65535 PHYS_UNIT "DTC" /end CHARACTERISTIC
/begin CHARACTERISTIC FCdtc_INJD5_on_hi "FCtl_DTC(60)" VALUE 0x001E38E2 /* @ECU_Address@FCtl_DTC@0x021B5078@ */ ECIPP_ALIGNMENT_UWORD 65535 Compu_IDENTITY 0 65535 PHYS_UNIT "DTC" /end CHARACTERISTIC
/begin CHARACTERISTIC FCdtc_INJD6_HS_Ihi "FCtl_DTC(567)" VALUE 0x001E3CD8 /* @ECU_Address@FCtl_DTC@0x021B546E@ */ ECIPP_ALIGNMENT_UWORD 65535 Compu_IDENTITY 0 65535 PHYS_UNIT "DTC" /end CHARACTERISTIC
/begin CHARACTERISTIC FCdtc_INJD6_LS_Ihi "FCtl_DTC(575)" VALUE 0x001E3CE8 /* @ECU_Address@FCtl_DTC@0x021B547E@ */ ECIPP_ALIGNMENT_UWORD 65535 Compu_IDENTITY 0 65535 PHYS_UNIT "DTC" /end CHARACTERISTIC
/begin CHARACTERISTIC FCdtc_INJD6_off_lo "FCtl_DTC(51)" VALUE 0x001E38D0 /* @ECU_Address@FCtl_DTC@0x021B5066@ */ ECIPP_ALIGNMENT_UWORD 65535 Compu_IDENTITY 0 65535 PHYS_UNIT "DTC" /end CHARACTERISTIC
/begin CHARACTERISTIC FCdtc_INJD6_on_hi "FCtl_DTC(61)" VALUE 0x001E38E4 /* @ECU_Address@FCtl_DTC@0x021B507A@ */ ECIPP_ALIGNMENT_UWORD 65535 Compu_IDENTITY 0 65535 PHYS_UNIT "DTC" /end CHARACTERISTIC
/begin CHARACTERISTIC FCdtc_INJD7_HS_Ihi "FCtl_DTC(568)" VALUE 0x001E3CDA /* @ECU_Address@FCtl_DTC@0x021B5470@ */ ECIPP_ALIGNMENT_UWORD 65535 Compu_IDENTITY 0 65535 PHYS_UNIT "DTC" /end CHARACTERISTIC
/begin CHARACTERISTIC FCdtc_INJD7_LS_Ihi "FCtl_DTC(576)" VALUE 0x001E3CEA /* @ECU_Address@FCtl_DTC@0x021B5480@ */ ECIPP_ALIGNMENT_UWORD 65535 Compu_IDENTITY 0 65535 PHYS_UNIT "DTC" /end CHARACTERISTIC
/begin CHARACTERISTIC FCdtc_INJD7_off_lo "FCtl_DTC(52)" VALUE 0x001E38D2 /* @ECU_Address@FCtl_DTC@0x021B5068@ */ ECIPP_ALIGNMENT_UWORD 65535 Compu_IDENTITY 0 65535 PHYS_UNIT "DTC" /end CHARACTERISTIC
/begin CHARACTERISTIC FCdtc_INJD7_on_hi "FCtl_DTC(62)" VALUE 0x001E38E6 /* @ECU_Address@FCtl_DTC@0x021B507C@ */ ECIPP_ALIGNMENT_UWORD 65535 Compu_IDENTITY 0 65535 PHYS_UNIT "DTC" /end CHARACTERISTIC
/begin CHARACTERISTIC FCdtc_INJD8_HS_Ihi "FCtl_DTC(569)" VALUE 0x001E3CDC /* @ECU_Address@FCtl_DTC@0x021B5472@ */ ECIPP_ALIGNMENT_UWORD 65535 Compu_IDENTITY 0 65535 PHYS_UNIT "DTC" /end CHARACTERISTIC
/begin CHARACTERISTIC FCdtc_INJD8_LS_Ihi "FCtl_DTC(577)" VALUE 0x001E3CEC /* @ECU_Address@FCtl_DTC@0x021B5482@ */ ECIPP_ALIGNMENT_UWORD 65535 Compu_IDENTITY 0 65535 PHYS_UNIT "DTC" /end CHARACTERISTIC
/begin CHARACTERISTIC FCdtc_INJD8_off_lo "FCtl_DTC(53)" VALUE 0x001E38D4 /* @ECU_Address@FCtl_DTC@0x021B506A@ */ ECIPP_ALIGNMENT_UWORD 65535 Compu_IDENTITY 0 65535 PHYS_UNIT "DTC" /end CHARACTERISTIC
/begin CHARACTERISTIC FCdtc_INJD8_on_hi "FCtl_DTC(63)" VALUE 0x001E38E8 /* @ECU_Address@FCtl_DTC@0x021B507E@ */ ECIPP_ALIGNMENT_UWORD 65535 Compu_IDENTITY 0 65535 PHYS_UNIT "DTC" /end CHARACTERISTIC
/begin CHARACTERISTIC FCdtc_INJD9_off_lo "FCtl_DTC(54)" VALUE 0x001E38D6 /* @ECU_Address@FCtl_DTC@0x021B506C@ */ ECIPP_ALIGNMENT_UWORD 65535 Compu_IDENTITY 0 65535 PHYS_UNIT "DTC" /end CHARACTERISTIC
/begin CHARACTERISTIC FCdtc_INJD9_on_hi "FCtl_DTC(64)" VALUE 0x001E38EA /* @ECU_Address@FCtl_DTC@0x021B5080@ */ ECIPP_ALIGNMENT_UWORD 65535 Compu_IDENTITY 0 65535 PHYS_UNIT "DTC" /end CHARACTERISTIC
/begin CHARACTERISTIC FCdtc_KNK10_max "FCtl_DTC(1012)" VALUE 0x001E4052 /* @ECU_Address@FCtl_DTC@0x021B57E8@ */ ECIPP_ALIGNMENT_UWORD 65535 Compu_IDENTITY 0 65535 PHYS_UNIT "DTC" /end CHARACTERISTIC
/begin CHARACTERISTIC FCdtc_KNK10_min "FCtl_DTC(1003)" VALUE 0x001E4040 /* @ECU_Address@FCtl_DTC@0x021B57D6@ */ ECIPP_ALIGNMENT_UWORD 65535 Compu_IDENTITY 0 65535 PHYS_UNIT "DTC" /end CHARACTERISTIC
/begin CHARACTERISTIC FCdtc_KNK11_max "FCtl_DTC(1013)" VALUE 0x001E4054 /* @ECU_Address@FCtl_DTC@0x021B57EA@ */ ECIPP_ALIGNMENT_UWORD 65535 Compu_IDENTITY 0 65535 PHYS_UNIT "DTC" /end CHARACTERISTIC
/begin CHARACTERISTIC FCdtc_KNK11_min "FCtl_DTC(1004)" VALUE 0x001E4042 /* @ECU_Address@FCtl_DTC@0x021B57D8@ */ ECIPP_ALIGNMENT_UWORD 65535 Compu_IDENTITY 0 65535 PHYS_UNIT "DTC" /end CHARACTERISTIC
/begin CHARACTERISTIC FCdtc_KNK12_max "FCtl_DTC(1014)" VALUE 0x001E4056 /* @ECU_Address@FCtl_DTC@0x021B57EC@ */ ECIPP_ALIGNMENT_UWORD 65535 Compu_IDENTITY 0 65535 PHYS_UNIT "DTC" /end CHARACTERISTIC
/begin CHARACTERISTIC FCdtc_KNK12_min "FCtl_DTC(1005)" VALUE 0x001E4044 /* @ECU_Address@FCtl_DTC@0x021B57DA@ */ ECIPP_ALIGNMENT_UWORD 65535 Compu_IDENTITY 0 65535 PHYS_UNIT "DTC" /end CHARACTERISTIC
/begin CHARACTERISTIC FCdtc_KNK2_max "FCtl_DTC(185)" VALUE 0x001E39DC /* @ECU_Address@FCtl_DTC@0x021B5172@ */ ECIPP_ALIGNMENT_UWORD 65535 Compu_IDENTITY 0 65535 PHYS_UNIT "DTC" /end CHARACTERISTIC
/begin CHARACTERISTIC FCdtc_KNK2_min "FCtl_DTC(184)" VALUE 0x001E39DA /* @ECU_Address@FCtl_DTC@0x021B5170@ */ ECIPP_ALIGNMENT_UWORD 65535 Compu_IDENTITY 0 65535 PHYS_UNIT "DTC" /end CHARACTERISTIC
/begin CHARACTERISTIC FCdtc_KNK3_max "FCtl_DTC(806)" VALUE 0x001E3EB6 /* @ECU_Address@FCtl_DTC@0x021B564C@ */ ECIPP_ALIGNMENT_UWORD 65535 Compu_IDENTITY 0 65535 PHYS_UNIT "DTC" /end CHARACTERISTIC
/begin CHARACTERISTIC FCdtc_KNK3_min "FCtl_DTC(805)" VALUE 0x001E3EB4 /* @ECU_Address@FCtl_DTC@0x021B564A@ */ ECIPP_ALIGNMENT_UWORD 65535 Compu_IDENTITY 0 65535 PHYS_UNIT "DTC" /end CHARACTERISTIC
/begin CHARACTERISTIC FCdtc_KNK4_max "FCtl_DTC(1006)" VALUE 0x001E4046 /* @ECU_Address@FCtl_DTC@0x021B57DC@ */ ECIPP_ALIGNMENT_UWORD 65535 Compu_IDENTITY 0 65535 PHYS_UNIT "DTC" /end CHARACTERISTIC
/begin CHARACTERISTIC FCdtc_KNK4_min "FCtl_DTC(997)" VALUE 0x001E4034 /* @ECU_Address@FCtl_DTC@0x021B57CA@ */ ECIPP_ALIGNMENT_UWORD 65535 Compu_IDENTITY 0 65535 PHYS_UNIT "DTC" /end CHARACTERISTIC
/begin CHARACTERISTIC FCdtc_KNK5_max "FCtl_DTC(1007)" VALUE 0x001E4048 /* @ECU_Address@FCtl_DTC@0x021B57DE@ */ ECIPP_ALIGNMENT_UWORD 65535 Compu_IDENTITY 0 65535 PHYS_UNIT "DTC" /end CHARACTERISTIC
/begin CHARACTERISTIC FCdtc_KNK5_min "FCtl_DTC(998)" VALUE 0x001E4036 /* @ECU_Address@FCtl_DTC@0x021B57CC@ */ ECIPP_ALIGNMENT_UWORD 65535 Compu_IDENTITY 0 65535 PHYS_UNIT "DTC" /end CHARACTERISTIC
/begin CHARACTERISTIC FCdtc_KNK6_max "FCtl_DTC(1008)" VALUE 0x001E404A /* @ECU_Address@FCtl_DTC@0x021B57E0@ */ ECIPP_ALIGNMENT_UWORD 65535 Compu_IDENTITY 0 65535 PHYS_UNIT "DTC" /end CHARACTERISTIC
/begin CHARACTERISTIC FCdtc_KNK6_min "FCtl_DTC(999)" VALUE 0x001E4038 /* @ECU_Address@FCtl_DTC@0x021B57CE@ */ ECIPP_ALIGNMENT_UWORD 65535 Compu_IDENTITY 0 65535 PHYS_UNIT "DTC" /end CHARACTERISTIC
/begin CHARACTERISTIC FCdtc_KNK7_max "FCtl_DTC(1009)" VALUE 0x001E404C /* @ECU_Address@FCtl_DTC@0x021B57E2@ */ ECIPP_ALIGNMENT_UWORD 65535 Compu_IDENTITY 0 65535 PHYS_UNIT "DTC" /end CHARACTERISTIC
/begin CHARACTERISTIC FCdtc_KNK7_min "FCtl_DTC(1000)" VALUE 0x001E403A /* @ECU_Address@FCtl_DTC@0x021B57D0@ */ ECIPP_ALIGNMENT_UWORD 65535 Compu_IDENTITY 0 65535 PHYS_UNIT "DTC" /end CHARACTERISTIC
/begin CHARACTERISTIC FCdtc_KNK8_max "FCtl_DTC(1010)" VALUE 0x001E404E /* @ECU_Address@FCtl_DTC@0x021B57E4@ */ ECIPP_ALIGNMENT_UWORD 65535 Compu_IDENTITY 0 65535 PHYS_UNIT "DTC" /end CHARACTERISTIC
/begin CHARACTERISTIC FCdtc_KNK8_min "FCtl_DTC(1001)" VALUE 0x001E403C /* @ECU_Address@FCtl_DTC@0x021B57D2@ */ ECIPP_ALIGNMENT_UWORD 65535 Compu_IDENTITY 0 65535 PHYS_UNIT "DTC" /end CHARACTERISTIC
/begin CHARACTERISTIC FCdtc_KNK9_max "FCtl_DTC(1011)" VALUE 0x001E4050 /* @ECU_Address@FCtl_DTC@0x021B57E6@ */ ECIPP_ALIGNMENT_UWORD 65535 Compu_IDENTITY 0 65535 PHYS_UNIT "DTC" /end CHARACTERISTIC
/begin CHARACTERISTIC FCdtc_KNK9_min "FCtl_DTC(1002)" VALUE 0x001E403E /* @ECU_Address@FCtl_DTC@0x021B57D4@ */ ECIPP_ALIGNMENT_UWORD 65535 Compu_IDENTITY 0 65535 PHYS_UNIT "DTC" /end CHARACTERISTIC
/begin CHARACTERISTIC FCdtc_KV10_deltaHi "FCtl_DTC(970)" VALUE 0x001E3FFE /* @ECU_Address@FCtl_DTC@0x021B5794@ */ ECIPP_ALIGNMENT_UWORD 65535 Compu_IDENTITY 0 65535 PHYS_UNIT "DTC" /end CHARACTERISTIC
/begin CHARACTERISTIC FCdtc_KV10_deltaLo "FCtl_DTC(982)" VALUE 0x001E4016 /* @ECU_Address@FCtl_DTC@0x021B57AC@ */ ECIPP_ALIGNMENT_UWORD 65535 Compu_IDENTITY 0 65535 PHYS_UNIT "DTC" /end CHARACTERISTIC
/begin CHARACTERISTIC FCdtc_KV10_high "FCtl_DTC(886)" VALUE 0x001E3F56 /* @ECU_Address@FCtl_DTC@0x021B56EC@ */ ECIPP_ALIGNMENT_UWORD 65535 Compu_IDENTITY 0 65535 PHYS_UNIT "DTC" /end CHARACTERISTIC
/begin CHARACTERISTIC FCdtc_KV10_low "FCtl_DTC(898)" VALUE 0x001E3F6E /* @ECU_Address@FCtl_DTC@0x021B5704@ */ ECIPP_ALIGNMENT_UWORD 65535 Compu_IDENTITY 0 65535 PHYS_UNIT "DTC" /end CHARACTERISTIC
/begin CHARACTERISTIC FCdtc_KV11_deltaHi "FCtl_DTC(971)" VALUE 0x001E4000 /* @ECU_Address@FCtl_DTC@0x021B5796@ */ ECIPP_ALIGNMENT_UWORD 65535 Compu_IDENTITY 0 65535 PHYS_UNIT "DTC" /end CHARACTERISTIC
/begin CHARACTERISTIC FCdtc_KV11_deltaLo "FCtl_DTC(983)" VALUE 0x001E4018 /* @ECU_Address@FCtl_DTC@0x021B57AE@ */ ECIPP_ALIGNMENT_UWORD 65535 Compu_IDENTITY 0 65535 PHYS_UNIT "DTC" /end CHARACTERISTIC
/begin CHARACTERISTIC FCdtc_KV11_high "FCtl_DTC(887)" VALUE 0x001E3F58 /* @ECU_Address@FCtl_DTC@0x021B56EE@ */ ECIPP_ALIGNMENT_UWORD 65535 Compu_IDENTITY 0 65535 PHYS_UNIT "DTC" /end CHARACTERISTIC
/begin CHARACTERISTIC FCdtc_KV11_low "FCtl_DTC(899)" VALUE 0x001E3F70 /* @ECU_Address@FCtl_DTC@0x021B5706@ */ ECIPP_ALIGNMENT_UWORD 65535 Compu_IDENTITY 0 65535 PHYS_UNIT "DTC" /end CHARACTERISTIC
/begin CHARACTERISTIC FCdtc_KV12_deltaHi "FCtl_DTC(972)" VALUE 0x001E4002 /* @ECU_Address@FCtl_DTC@0x021B5798@ */ ECIPP_ALIGNMENT_UWORD 65535 Compu_IDENTITY 0 65535 PHYS_UNIT "DTC" /end CHARACTERISTIC
/begin CHARACTERISTIC FCdtc_KV12_deltaLo "FCtl_DTC(984)" VALUE 0x001E401A /* @ECU_Address@FCtl_DTC@0x021B57B0@ */ ECIPP_ALIGNMENT_UWORD 65535 Compu_IDENTITY 0 65535 PHYS_UNIT "DTC" /end CHARACTERISTIC
/begin CHARACTERISTIC FCdtc_KV12_high "FCtl_DTC(888)" VALUE 0x001E3F5A /* @ECU_Address@FCtl_DTC@0x021B56F0@ */ ECIPP_ALIGNMENT_UWORD 65535 Compu_IDENTITY 0 65535 PHYS_UNIT "DTC" /end CHARACTERISTIC
/begin CHARACTERISTIC FCdtc_KV12_low "FCtl_DTC(900)" VALUE 0x001E3F72 /* @ECU_Address@FCtl_DTC@0x021B5708@ */ ECIPP_ALIGNMENT_UWORD 65535 Compu_IDENTITY 0 65535 PHYS_UNIT "DTC" /end CHARACTERISTIC
/begin CHARACTERISTIC FCdtc_KV2_deltaHi "FCtl_DTC(962)" VALUE 0x001E3FEE /* @ECU_Address@FCtl_DTC@0x021B5784@ */ ECIPP_ALIGNMENT_UWORD 65535 Compu_IDENTITY 0 65535 PHYS_UNIT "DTC" /end CHARACTERISTIC
/begin CHARACTERISTIC FCdtc_KV2_deltaLo "FCtl_DTC(974)" VALUE 0x001E4006 /* @ECU_Address@FCtl_DTC@0x021B579C@ */ ECIPP_ALIGNMENT_UWORD 65535 Compu_IDENTITY 0 65535 PHYS_UNIT "DTC" /end CHARACTERISTIC
/begin CHARACTERISTIC FCdtc_KV2_high "FCtl_DTC(878)" VALUE 0x001E3F46 /* @ECU_Address@FCtl_DTC@0x021B56DC@ */ ECIPP_ALIGNMENT_UWORD 65535 Compu_IDENTITY 0 65535 PHYS_UNIT "DTC" /end CHARACTERISTIC
/begin CHARACTERISTIC FCdtc_KV2_low "FCtl_DTC(890)" VALUE 0x001E3F5E /* @ECU_Address@FCtl_DTC@0x021B56F4@ */ ECIPP_ALIGNMENT_UWORD 65535 Compu_IDENTITY 0 65535 PHYS_UNIT "DTC" /end CHARACTERISTIC
/begin CHARACTERISTIC FCdtc_KV3_deltaHi "FCtl_DTC(963)" VALUE 0x001E3FF0 /* @ECU_Address@FCtl_DTC@0x021B5786@ */ ECIPP_ALIGNMENT_UWORD 65535 Compu_IDENTITY 0 65535 PHYS_UNIT "DTC" /end CHARACTERISTIC
/begin CHARACTERISTIC FCdtc_KV3_deltaLo "FCtl_DTC(975)" VALUE 0x001E4008 /* @ECU_Address@FCtl_DTC@0x021B579E@ */ ECIPP_ALIGNMENT_UWORD 65535 Compu_IDENTITY 0 65535 PHYS_UNIT "DTC" /end CHARACTERISTIC
/begin CHARACTERISTIC FCdtc_KV3_high "FCtl_DTC(879)" VALUE 0x001E3F48 /* @ECU_Address@FCtl_DTC@0x021B56DE@ */ ECIPP_ALIGNMENT_UWORD 65535 Compu_IDENTITY 0 65535 PHYS_UNIT "DTC" /end CHARACTERISTIC
/begin CHARACTERISTIC FCdtc_KV3_low "FCtl_DTC(891)" VALUE 0x001E3F60 /* @ECU_Address@FCtl_DTC@0x021B56F6@ */ ECIPP_ALIGNMENT_UWORD 65535 Compu_IDENTITY 0 65535 PHYS_UNIT "DTC" /end CHARACTERISTIC
/begin CHARACTERISTIC FCdtc_KV4_deltaHi "FCtl_DTC(964)" VALUE 0x001E3FF2 /* @ECU_Address@FCtl_DTC@0x021B5788@ */ ECIPP_ALIGNMENT_UWORD 65535 Compu_IDENTITY 0 65535 PHYS_UNIT "DTC" /end CHARACTERISTIC
/begin CHARACTERISTIC FCdtc_KV4_deltaLo "FCtl_DTC(976)" VALUE 0x001E400A /* @ECU_Address@FCtl_DTC@0x021B57A0@ */ ECIPP_ALIGNMENT_UWORD 65535 Compu_IDENTITY 0 65535 PHYS_UNIT "DTC" /end CHARACTERISTIC
/begin CHARACTERISTIC FCdtc_KV4_high "FCtl_DTC(880)" VALUE 0x001E3F4A /* @ECU_Address@FCtl_DTC@0x021B56E0@ */ ECIPP_ALIGNMENT_UWORD 65535 Compu_IDENTITY 0 65535 PHYS_UNIT "DTC" /end CHARACTERISTIC
/begin CHARACTERISTIC FCdtc_KV4_low "FCtl_DTC(892)" VALUE 0x001E3F62 /* @ECU_Address@FCtl_DTC@0x021B56F8@ */ ECIPP_ALIGNMENT_UWORD 65535 Compu_IDENTITY 0 65535 PHYS_UNIT "DTC" /end CHARACTERISTIC
/begin CHARACTERISTIC FCdtc_KV5_deltaHi "FCtl_DTC(965)" VALUE 0x001E3FF4 /* @ECU_Address@FCtl_DTC@0x021B578A@ */ ECIPP_ALIGNMENT_UWORD 65535 Compu_IDENTITY 0 65535 PHYS_UNIT "DTC" /end CHARACTERISTIC
/begin CHARACTERISTIC FCdtc_KV5_deltaLo "FCtl_DTC(977)" VALUE 0x001E400C /* @ECU_Address@FCtl_DTC@0x021B57A2@ */ ECIPP_ALIGNMENT_UWORD 65535 Compu_IDENTITY 0 65535 PHYS_UNIT "DTC" /end CHARACTERISTIC
/begin CHARACTERISTIC FCdtc_KV5_high "FCtl_DTC(881)" VALUE 0x001E3F4C /* @ECU_Address@FCtl_DTC@0x021B56E2@ */ ECIPP_ALIGNMENT_UWORD 65535 Compu_IDENTITY 0 65535 PHYS_UNIT "DTC" /end CHARACTERISTIC
/begin CHARACTERISTIC FCdtc_KV5_low "FCtl_DTC(893)" VALUE 0x001E3F64 /* @ECU_Address@FCtl_DTC@0x021B56FA@ */ ECIPP_ALIGNMENT_UWORD 65535 Compu_IDENTITY 0 65535 PHYS_UNIT "DTC" /end CHARACTERISTIC
/begin CHARACTERISTIC FCdtc_KV6_deltaHi "FCtl_DTC(966)" VALUE 0x001E3FF6 /* @ECU_Address@FCtl_DTC@0x021B578C@ */ ECIPP_ALIGNMENT_UWORD 65535 Compu_IDENTITY 0 65535 PHYS_UNIT "DTC" /end CHARACTERISTIC
/begin CHARACTERISTIC FCdtc_KV6_deltaLo "FCtl_DTC(978)" VALUE 0x001E400E /* @ECU_Address@FCtl_DTC@0x021B57A4@ */ ECIPP_ALIGNMENT_UWORD 65535 Compu_IDENTITY 0 65535 PHYS_UNIT "DTC" /end CHARACTERISTIC
/begin CHARACTERISTIC FCdtc_KV6_high "FCtl_DTC(882)" VALUE 0x001E3F4E /* @ECU_Address@FCtl_DTC@0x021B56E4@ */ ECIPP_ALIGNMENT_UWORD 65535 Compu_IDENTITY 0 65535 PHYS_UNIT "DTC" /end CHARACTERISTIC
/begin CHARACTERISTIC FCdtc_KV6_low "FCtl_DTC(894)" VALUE 0x001E3F66 /* @ECU_Address@FCtl_DTC@0x021B56FC@ */ ECIPP_ALIGNMENT_UWORD 65535 Compu_IDENTITY 0 65535 PHYS_UNIT "DTC" /end CHARACTERISTIC
/begin CHARACTERISTIC FCdtc_KV7_deltaHi "FCtl_DTC(967)" VALUE 0x001E3FF8 /* @ECU_Address@FCtl_DTC@0x021B578E@ */ ECIPP_ALIGNMENT_UWORD 65535 Compu_IDENTITY 0 65535 PHYS_UNIT "DTC" /end CHARACTERISTIC
/begin CHARACTERISTIC FCdtc_KV7_deltaLo "FCtl_DTC(979)" VALUE 0x001E4010 /* @ECU_Address@FCtl_DTC@0x021B57A6@ */ ECIPP_ALIGNMENT_UWORD 65535 Compu_IDENTITY 0 65535 PHYS_UNIT "DTC" /end CHARACTERISTIC
/begin CHARACTERISTIC FCdtc_KV7_high "FCtl_DTC(883)" VALUE 0x001E3F50 /* @ECU_Address@FCtl_DTC@0x021B56E6@ */ ECIPP_ALIGNMENT_UWORD 65535 Compu_IDENTITY 0 65535 PHYS_UNIT "DTC" /end CHARACTERISTIC
/begin CHARACTERISTIC FCdtc_KV7_low "FCtl_DTC(895)" VALUE 0x001E3F68 /* @ECU_Address@FCtl_DTC@0x021B56FE@ */ ECIPP_ALIGNMENT_UWORD 65535 Compu_IDENTITY 0 65535 PHYS_UNIT "DTC" /end CHARACTERISTIC
/begin CHARACTERISTIC FCdtc_KV8_deltaHi "FCtl_DTC(968)" VALUE 0x001E3FFA /* @ECU_Address@FCtl_DTC@0x021B5790@ */ ECIPP_ALIGNMENT_UWORD 65535 Compu_IDENTITY 0 65535 PHYS_UNIT "DTC" /end CHARACTERISTIC
/begin CHARACTERISTIC FCdtc_KV8_deltaLo "FCtl_DTC(980)" VALUE 0x001E4012 /* @ECU_Address@FCtl_DTC@0x021B57A8@ */ ECIPP_ALIGNMENT_UWORD 65535 Compu_IDENTITY 0 65535 PHYS_UNIT "DTC" /end CHARACTERISTIC
/begin CHARACTERISTIC FCdtc_KV8_high "FCtl_DTC(884)" VALUE 0x001E3F52 /* @ECU_Address@FCtl_DTC@0x021B56E8@ */ ECIPP_ALIGNMENT_UWORD 65535 Compu_IDENTITY 0 65535 PHYS_UNIT "DTC" /end CHARACTERISTIC
/begin CHARACTERISTIC FCdtc_KV8_low "FCtl_DTC(896)" VALUE 0x001E3F6A /* @ECU_Address@FCtl_DTC@0x021B5700@ */ ECIPP_ALIGNMENT_UWORD 65535 Compu_IDENTITY 0 65535 PHYS_UNIT "DTC" /end CHARACTERISTIC
/begin CHARACTERISTIC FCdtc_KV9_deltaHi "FCtl_DTC(969)" VALUE 0x001E3FFC /* @ECU_Address@FCtl_DTC@0x021B5792@ */ ECIPP_ALIGNMENT_UWORD 65535 Compu_IDENTITY 0 65535 PHYS_UNIT "DTC" /end CHARACTERISTIC
/begin CHARACTERISTIC FCdtc_KV9_deltaLo "FCtl_DTC(981)" VALUE 0x001E4014 /* @ECU_Address@FCtl_DTC@0x021B57AA@ */ ECIPP_ALIGNMENT_UWORD 65535 Compu_IDENTITY 0 65535 PHYS_UNIT "DTC" /end CHARACTERISTIC
/begin CHARACTERISTIC FCdtc_KV9_high "FCtl_DTC(885)" VALUE 0x001E3F54 /* @ECU_Address@FCtl_DTC@0x021B56EA@ */ ECIPP_ALIGNMENT_UWORD 65535 Compu_IDENTITY 0 65535 PHYS_UNIT "DTC" /end CHARACTERISTIC
/begin CHARACTERISTIC FCdtc_KV9_low "FCtl_DTC(897)" VALUE 0x001E3F6C /* @ECU_Address@FCtl_DTC@0x021B5702@ */ ECIPP_ALIGNMENT_UWORD 65535 Compu_IDENTITY 0 65535 PHYS_UNIT "DTC" /end CHARACTERISTIC
/begin CHARACTERISTIC FCdtc_Pri10_open "FCtl_DTC(910)" VALUE 0x001E3F86 /* @ECU_Address@FCtl_DTC@0x021B571C@ */ ECIPP_ALIGNMENT_UWORD 65535 Compu_IDENTITY 0 65535 PHYS_UNIT "DTC" /end CHARACTERISTIC
/begin CHARACTERISTIC FCdtc_Pri10_short "FCtl_DTC(922)" VALUE 0x001E3F9E /* @ECU_Address@FCtl_DTC@0x021B5734@ */ ECIPP_ALIGNMENT_UWORD 65535 Compu_IDENTITY 0 65535 PHYS_UNIT "DTC" /end CHARACTERISTIC
/begin CHARACTERISTIC FCdtc_Pri11_open "FCtl_DTC(911)" VALUE 0x001E3F88 /* @ECU_Address@FCtl_DTC@0x021B571E@ */ ECIPP_ALIGNMENT_UWORD 65535 Compu_IDENTITY 0 65535 PHYS_UNIT "DTC" /end CHARACTERISTIC
/begin CHARACTERISTIC FCdtc_Pri11_short "FCtl_DTC(923)" VALUE 0x001E3FA0 /* @ECU_Address@FCtl_DTC@0x021B5736@ */ ECIPP_ALIGNMENT_UWORD 65535 Compu_IDENTITY 0 65535 PHYS_UNIT "DTC" /end CHARACTERISTIC
/begin CHARACTERISTIC FCdtc_Pri12_open "FCtl_DTC(912)" VALUE 0x001E3F8A /* @ECU_Address@FCtl_DTC@0x021B5720@ */ ECIPP_ALIGNMENT_UWORD 65535 Compu_IDENTITY 0 65535 PHYS_UNIT "DTC" /end CHARACTERISTIC
/begin CHARACTERISTIC FCdtc_Pri12_short "FCtl_DTC(924)" VALUE 0x001E3FA2 /* @ECU_Address@FCtl_DTC@0x021B5738@ */ ECIPP_ALIGNMENT_UWORD 65535 Compu_IDENTITY 0 65535 PHYS_UNIT "DTC" /end CHARACTERISTIC
/begin CHARACTERISTIC FCdtc_Pri2_open "FCtl_DTC(902)" VALUE 0x001E3F76 /* @ECU_Address@FCtl_DTC@0x021B570C@ */ ECIPP_ALIGNMENT_UWORD 65535 Compu_IDENTITY 0 65535 PHYS_UNIT "DTC" /end CHARACTERISTIC
/begin CHARACTERISTIC FCdtc_Pri2_short "FCtl_DTC(914)" VALUE 0x001E3F8E /* @ECU_Address@FCtl_DTC@0x021B5724@ */ ECIPP_ALIGNMENT_UWORD 65535 Compu_IDENTITY 0 65535 PHYS_UNIT "DTC" /end CHARACTERISTIC
/begin CHARACTERISTIC FCdtc_Pri3_open "FCtl_DTC(903)" VALUE 0x001E3F78 /* @ECU_Address@FCtl_DTC@0x021B570E@ */ ECIPP_ALIGNMENT_UWORD 65535 Compu_IDENTITY 0 65535 PHYS_UNIT "DTC" /end CHARACTERISTIC
/begin CHARACTERISTIC FCdtc_Pri3_short "FCtl_DTC(915)" VALUE 0x001E3F90 /* @ECU_Address@FCtl_DTC@0x021B5726@ */ ECIPP_ALIGNMENT_UWORD 65535 Compu_IDENTITY 0 65535 PHYS_UNIT "DTC" /end CHARACTERISTIC
/begin CHARACTERISTIC FCdtc_Pri4_open "FCtl_DTC(904)" VALUE 0x001E3F7A /* @ECU_Address@FCtl_DTC@0x021B5710@ */ ECIPP_ALIGNMENT_UWORD 65535 Compu_IDENTITY 0 65535 PHYS_UNIT "DTC" /end CHARACTERISTIC
/begin CHARACTERISTIC FCdtc_Pri4_short "FCtl_DTC(916)" VALUE 0x001E3F92 /* @ECU_Address@FCtl_DTC@0x021B5728@ */ ECIPP_ALIGNMENT_UWORD 65535 Compu_IDENTITY 0 65535 PHYS_UNIT "DTC" /end CHARACTERISTIC
/begin CHARACTERISTIC FCdtc_Pri5_open "FCtl_DTC(905)" VALUE 0x001E3F7C /* @ECU_Address@FCtl_DTC@0x021B5712@ */ ECIPP_ALIGNMENT_UWORD 65535 Compu_IDENTITY 0 65535 PHYS_UNIT "DTC" /end CHARACTERISTIC
/begin CHARACTERISTIC FCdtc_Pri5_short "FCtl_DTC(917)" VALUE 0x001E3F94 /* @ECU_Address@FCtl_DTC@0x021B572A@ */ ECIPP_ALIGNMENT_UWORD 65535 Compu_IDENTITY 0 65535 PHYS_UNIT "DTC" /end CHARACTERISTIC
/begin CHARACTERISTIC FCdtc_Pri6_open "FCtl_DTC(906)" VALUE 0x001E3F7E /* @ECU_Address@FCtl_DTC@0x021B5714@ */ ECIPP_ALIGNMENT_UWORD 65535 Compu_IDENTITY 0 65535 PHYS_UNIT "DTC" /end CHARACTERISTIC
/begin CHARACTERISTIC FCdtc_Pri6_short "FCtl_DTC(918)" VALUE 0x001E3F96 /* @ECU_Address@FCtl_DTC@0x021B572C@ */ ECIPP_ALIGNMENT_UWORD 65535 Compu_IDENTITY 0 65535 PHYS_UNIT "DTC" /end CHARACTERISTIC
/begin CHARACTERISTIC FCdtc_Pri7_open "FCtl_DTC(907)" VALUE 0x001E3F80 /* @ECU_Address@FCtl_DTC@0x021B5716@ */ ECIPP_ALIGNMENT_UWORD 65535 Compu_IDENTITY 0 65535 PHYS_UNIT "DTC" /end CHARACTERISTIC
/begin CHARACTERISTIC FCdtc_Pri7_short "FCtl_DTC(919)" VALUE 0x001E3F98 /* @ECU_Address@FCtl_DTC@0x021B572E@ */ ECIPP_ALIGNMENT_UWORD 65535 Compu_IDENTITY 0 65535 PHYS_UNIT "DTC" /end CHARACTERISTIC
/begin CHARACTERISTIC FCdtc_Pri8_open "FCtl_DTC(908)" VALUE 0x001E3F82 /* @ECU_Address@FCtl_DTC@0x021B5718@ */ ECIPP_ALIGNMENT_UWORD 65535 Compu_IDENTITY 0 65535 PHYS_UNIT "DTC" /end CHARACTERISTIC
/begin CHARACTERISTIC FCdtc_Pri8_short "FCtl_DTC(920)" VALUE 0x001E3F9A /* @ECU_Address@FCtl_DTC@0x021B5730@ */ ECIPP_ALIGNMENT_UWORD 65535 Compu_IDENTITY 0 65535 PHYS_UNIT "DTC" /end CHARACTERISTIC
/begin CHARACTERISTIC FCdtc_Pri9_open "FCtl_DTC(909)" VALUE 0x001E3F84 /* @ECU_Address@FCtl_DTC@0x021B571A@ */ ECIPP_ALIGNMENT_UWORD 65535 Compu_IDENTITY 0 65535 PHYS_UNIT "DTC" /end CHARACTERISTIC
/begin CHARACTERISTIC FCdtc_Pri9_short "FCtl_DTC(921)" VALUE 0x001E3F9C /* @ECU_Address@FCtl_DTC@0x021B5732@ */ ECIPP_ALIGNMENT_UWORD 65535 Compu_IDENTITY 0 65535 PHYS_UNIT "DTC" /end CHARACTERISTIC
/begin CHARACTERISTIC FCdtc_Sec10_31KV_open "FCtl_DTC(958)" VALUE 0x001E3FE6 /* @ECU_Address@FCtl_DTC@0x021B577C@ */ ECIPP_ALIGNMENT_UWORD 65535 Compu_IDENTITY 0 65535 PHYS_UNIT "DTC" /end CHARACTERISTIC
/begin CHARACTERISTIC FCdtc_Sec10_low "FCtl_DTC(946)" VALUE 0x001E3FCE /* @ECU_Address@FCtl_DTC@0x021B5764@ */ ECIPP_ALIGNMENT_UWORD 65535 Compu_IDENTITY 0 65535 PHYS_UNIT "DTC" /end CHARACTERISTIC
/begin CHARACTERISTIC FCdtc_Sec10_open "FCtl_DTC(934)" VALUE 0x001E3FB6 /* @ECU_Address@FCtl_DTC@0x021B574C@ */ ECIPP_ALIGNMENT_UWORD 65535 Compu_IDENTITY 0 65535 PHYS_UNIT "DTC" /end CHARACTERISTIC
/begin CHARACTERISTIC FCdtc_Sec11_31KV_open "FCtl_DTC(959)" VALUE 0x001E3FE8 /* @ECU_Address@FCtl_DTC@0x021B577E@ */ ECIPP_ALIGNMENT_UWORD 65535 Compu_IDENTITY 0 65535 PHYS_UNIT "DTC" /end CHARACTERISTIC
/begin CHARACTERISTIC FCdtc_Sec11_low "FCtl_DTC(947)" VALUE 0x001E3FD0 /* @ECU_Address@FCtl_DTC@0x021B5766@ */ ECIPP_ALIGNMENT_UWORD 65535 Compu_IDENTITY 0 65535 PHYS_UNIT "DTC" /end CHARACTERISTIC
/begin CHARACTERISTIC FCdtc_Sec11_open "FCtl_DTC(935)" VALUE 0x001E3FB8 /* @ECU_Address@FCtl_DTC@0x021B574E@ */ ECIPP_ALIGNMENT_UWORD 65535 Compu_IDENTITY 0 65535 PHYS_UNIT "DTC" /end CHARACTERISTIC
/begin CHARACTERISTIC FCdtc_Sec12_31KV_open "FCtl_DTC(960)" VALUE 0x001E3FEA /* @ECU_Address@FCtl_DTC@0x021B5780@ */ ECIPP_ALIGNMENT_UWORD 65535 Compu_IDENTITY 0 65535 PHYS_UNIT "DTC" /end CHARACTERISTIC
/begin CHARACTERISTIC FCdtc_Sec12_low "FCtl_DTC(948)" VALUE 0x001E3FD2 /* @ECU_Address@FCtl_DTC@0x021B5768@ */ ECIPP_ALIGNMENT_UWORD 65535 Compu_IDENTITY 0 65535 PHYS_UNIT "DTC" /end CHARACTERISTIC
/begin CHARACTERISTIC FCdtc_Sec12_open "FCtl_DTC(936)" VALUE 0x001E3FBA /* @ECU_Address@FCtl_DTC@0x021B5750@ */ ECIPP_ALIGNMENT_UWORD 65535 Compu_IDENTITY 0 65535 PHYS_UNIT "DTC" /end CHARACTERISTIC
/begin CHARACTERISTIC FCdtc_Sec2_31KV_open "FCtl_DTC(950)" VALUE 0x001E3FD6 /* @ECU_Address@FCtl_DTC@0x021B576C@ */ ECIPP_ALIGNMENT_UWORD 65535 Compu_IDENTITY 0 65535 PHYS_UNIT "DTC" /end CHARACTERISTIC
/begin CHARACTERISTIC FCdtc_Sec2_low "FCtl_DTC(938)" VALUE 0x001E3FBE /* @ECU_Address@FCtl_DTC@0x021B5754@ */ ECIPP_ALIGNMENT_UWORD 65535 Compu_IDENTITY 0 65535 PHYS_UNIT "DTC" /end CHARACTERISTIC
/begin CHARACTERISTIC FCdtc_Sec2_open "FCtl_DTC(926)" VALUE 0x001E3FA6 /* @ECU_Address@FCtl_DTC@0x021B573C@ */ ECIPP_ALIGNMENT_UWORD 65535 Compu_IDENTITY 0 65535 PHYS_UNIT "DTC" /end CHARACTERISTIC
/begin CHARACTERISTIC FCdtc_Sec3_31KV_open "FCtl_DTC(951)" VALUE 0x001E3FD8 /* @ECU_Address@FCtl_DTC@0x021B576E@ */ ECIPP_ALIGNMENT_UWORD 65535 Compu_IDENTITY 0 65535 PHYS_UNIT "DTC" /end CHARACTERISTIC
/begin CHARACTERISTIC FCdtc_Sec3_low "FCtl_DTC(939)" VALUE 0x001E3FC0 /* @ECU_Address@FCtl_DTC@0x021B5756@ */ ECIPP_ALIGNMENT_UWORD 65535 Compu_IDENTITY 0 65535 PHYS_UNIT "DTC" /end CHARACTERISTIC
/begin CHARACTERISTIC FCdtc_Sec3_open "FCtl_DTC(927)" VALUE 0x001E3FA8 /* @ECU_Address@FCtl_DTC@0x021B573E@ */ ECIPP_ALIGNMENT_UWORD 65535 Compu_IDENTITY 0 65535 PHYS_UNIT "DTC" /end CHARACTERISTIC
/begin CHARACTERISTIC FCdtc_Sec4_31KV_open "FCtl_DTC(952)" VALUE 0x001E3FDA /* @ECU_Address@FCtl_DTC@0x021B5770@ */ ECIPP_ALIGNMENT_UWORD 65535 Compu_IDENTITY 0 65535 PHYS_UNIT "DTC" /end CHARACTERISTIC
/begin CHARACTERISTIC FCdtc_Sec4_low "FCtl_DTC(940)" VALUE 0x001E3FC2 /* @ECU_Address@FCtl_DTC@0x021B5758@ */ ECIPP_ALIGNMENT_UWORD 65535 Compu_IDENTITY 0 65535 PHYS_UNIT "DTC" /end CHARACTERISTIC
/begin CHARACTERISTIC FCdtc_Sec4_open "FCtl_DTC(928)" VALUE 0x001E3FAA /* @ECU_Address@FCtl_DTC@0x021B5740@ */ ECIPP_ALIGNMENT_UWORD 65535 Compu_IDENTITY 0 65535 PHYS_UNIT "DTC" /end CHARACTERISTIC
/begin CHARACTERISTIC FCdtc_Sec5_31KV_open "FCtl_DTC(953)" VALUE 0x001E3FDC /* @ECU_Address@FCtl_DTC@0x021B5772@ */ ECIPP_ALIGNMENT_UWORD 65535 Compu_IDENTITY 0 65535 PHYS_UNIT "DTC" /end CHARACTERISTIC
/begin CHARACTERISTIC FCdtc_Sec5_low "FCtl_DTC(941)" VALUE 0x001E3FC4 /* @ECU_Address@FCtl_DTC@0x021B575A@ */ ECIPP_ALIGNMENT_UWORD 65535 Compu_IDENTITY 0 65535 PHYS_UNIT "DTC" /end CHARACTERISTIC
/begin CHARACTERISTIC FCdtc_Sec5_open "FCtl_DTC(929)" VALUE 0x001E3FAC /* @ECU_Address@FCtl_DTC@0x021B5742@ */ ECIPP_ALIGNMENT_UWORD 65535 Compu_IDENTITY 0 65535 PHYS_UNIT "DTC" /end CHARACTERISTIC
/begin CHARACTERISTIC FCdtc_Sec6_31KV_open "FCtl_DTC(954)" VALUE 0x001E3FDE /* @ECU_Address@FCtl_DTC@0x021B5774@ */ ECIPP_ALIGNMENT_UWORD 65535 Compu_IDENTITY 0 65535 PHYS_UNIT "DTC" /end CHARACTERISTIC
/begin CHARACTERISTIC FCdtc_Sec6_low "FCtl_DTC(942)" VALUE 0x001E3FC6 /* @ECU_Address@FCtl_DTC@0x021B575C@ */ ECIPP_ALIGNMENT_UWORD 65535 Compu_IDENTITY 0 65535 PHYS_UNIT "DTC" /end CHARACTERISTIC
/begin CHARACTERISTIC FCdtc_Sec6_open "FCtl_DTC(930)" VALUE 0x001E3FAE /* @ECU_Address@FCtl_DTC@0x021B5744@ */ ECIPP_ALIGNMENT_UWORD 65535 Compu_IDENTITY 0 65535 PHYS_UNIT "DTC" /end CHARACTERISTIC
/begin CHARACTERISTIC FCdtc_Sec7_31KV_open "FCtl_DTC(955)" VALUE 0x001E3FE0 /* @ECU_Address@FCtl_DTC@0x021B5776@ */ ECIPP_ALIGNMENT_UWORD 65535 Compu_IDENTITY 0 65535 PHYS_UNIT "DTC" /end CHARACTERISTIC
/begin CHARACTERISTIC FCdtc_Sec7_low "FCtl_DTC(943)" VALUE 0x001E3FC8 /* @ECU_Address@FCtl_DTC@0x021B575E@ */ ECIPP_ALIGNMENT_UWORD 65535 Compu_IDENTITY 0 65535 PHYS_UNIT "DTC" /end CHARACTERISTIC
/begin CHARACTERISTIC FCdtc_Sec7_open "FCtl_DTC(931)" VALUE 0x001E3FB0 /* @ECU_Address@FCtl_DTC@0x021B5746@ */ ECIPP_ALIGNMENT_UWORD 65535 Compu_IDENTITY 0 65535 PHYS_UNIT "DTC" /end CHARACTERISTIC
/begin CHARACTERISTIC FCdtc_Sec8_31KV_open "FCtl_DTC(956)" VALUE 0x001E3FE2 /* @ECU_Address@FCtl_DTC@0x021B5778@ */ ECIPP_ALIGNMENT_UWORD 65535 Compu_IDENTITY 0 65535 PHYS_UNIT "DTC" /end CHARACTERISTIC
/begin CHARACTERISTIC FCdtc_Sec8_low "FCtl_DTC(944)" VALUE 0x001E3FCA /* @ECU_Address@FCtl_DTC@0x021B5760@ */ ECIPP_ALIGNMENT_UWORD 65535 Compu_IDENTITY 0 65535 PHYS_UNIT "DTC" /end CHARACTERISTIC
/begin CHARACTERISTIC FCdtc_Sec8_open "FCtl_DTC(932)" VALUE 0x001E3FB2 /* @ECU_Address@FCtl_DTC@0x021B5748@ */ ECIPP_ALIGNMENT_UWORD 65535 Compu_IDENTITY 0 65535 PHYS_UNIT "DTC" /end CHARACTERISTIC
/begin CHARACTERISTIC FCdtc_Sec9_31KV_open "FCtl_DTC(957)" VALUE 0x001E3FE4 /* @ECU_Address@FCtl_DTC@0x021B577A@ */ ECIPP_ALIGNMENT_UWORD 65535 Compu_IDENTITY 0 65535 PHYS_UNIT "DTC" /end CHARACTERISTIC
/begin CHARACTERISTIC FCdtc_Sec9_low "FCtl_DTC(945)" VALUE 0x001E3FCC /* @ECU_Address@FCtl_DTC@0x021B5762@ */ ECIPP_ALIGNMENT_UWORD 65535 Compu_IDENTITY 0 65535 PHYS_UNIT "DTC" /end CHARACTERISTIC
/begin CHARACTERISTIC FCdtc_Sec9_open "FCtl_DTC(933)" VALUE 0x001E3FB4 /* @ECU_Address@FCtl_DTC@0x021B574A@ */ ECIPP_ALIGNMENT_UWORD 65535 Compu_IDENTITY 0 65535 PHYS_UNIT "DTC" /end CHARACTERISTIC
/begin CHARACTERISTIC FCdtc_SPK10_IGBT_T "FCtl_DTC(518)" VALUE 0x001E3C76 /* @ECU_Address@FCtl_DTC@0x021B540C@ */ ECIPP_ALIGNMENT_UWORD 65535 Compu_IDENTITY 0 65535 PHYS_UNIT "DTC" /end CHARACTERISTIC
/begin CHARACTERISTIC FCdtc_SPK11_IGBT_T "FCtl_DTC(1021)" VALUE 0x001E4064 /* @ECU_Address@FCtl_DTC@0x021B57FA@ */ ECIPP_ALIGNMENT_UWORD 65535 Compu_IDENTITY 0 65535 PHYS_UNIT "DTC" /end CHARACTERISTIC
/begin CHARACTERISTIC FCdtc_SPK12_IGBT_T "FCtl_DTC(1022)" VALUE 0x001E4066 /* @ECU_Address@FCtl_DTC@0x021B57FC@ */ ECIPP_ALIGNMENT_UWORD 65535 Compu_IDENTITY 0 65535 PHYS_UNIT "DTC" /end CHARACTERISTIC
/begin CHARACTERISTIC FCdtc_SPK2_IGBT_T "FCtl_DTC(510)" VALUE 0x001E3C66 /* @ECU_Address@FCtl_DTC@0x021B53FC@ */ ECIPP_ALIGNMENT_UWORD 65535 Compu_IDENTITY 0 65535 PHYS_UNIT "DTC" /end CHARACTERISTIC
/begin CHARACTERISTIC FCdtc_SPK3_IGBT_T "FCtl_DTC(511)" VALUE 0x001E3C68 /* @ECU_Address@FCtl_DTC@0x021B53FE@ */ ECIPP_ALIGNMENT_UWORD 65535 Compu_IDENTITY 0 65535 PHYS_UNIT "DTC" /end CHARACTERISTIC
/begin CHARACTERISTIC FCdtc_SPK4_IGBT_T "FCtl_DTC(512)" VALUE 0x001E3C6A /* @ECU_Address@FCtl_DTC@0x021B5400@ */ ECIPP_ALIGNMENT_UWORD 65535 Compu_IDENTITY 0 65535 PHYS_UNIT "DTC" /end CHARACTERISTIC
/begin CHARACTERISTIC FCdtc_SPK5_IGBT_T "FCtl_DTC(513)" VALUE 0x001E3C6C /* @ECU_Address@FCtl_DTC@0x021B5402@ */ ECIPP_ALIGNMENT_UWORD 65535 Compu_IDENTITY 0 65535 PHYS_UNIT "DTC" /end CHARACTERISTIC
/begin CHARACTERISTIC FCdtc_SPK6_IGBT_T "FCtl_DTC(514)" VALUE 0x001E3C6E /* @ECU_Address@FCtl_DTC@0x021B5404@ */ ECIPP_ALIGNMENT_UWORD 65535 Compu_IDENTITY 0 65535 PHYS_UNIT "DTC" /end CHARACTERISTIC
/begin CHARACTERISTIC FCdtc_SPK7_IGBT_T "FCtl_DTC(515)" VALUE 0x001E3C70 /* @ECU_Address@FCtl_DTC@0x021B5406@ */ ECIPP_ALIGNMENT_UWORD 65535 Compu_IDENTITY 0 65535 PHYS_UNIT "DTC" /end CHARACTERISTIC
/begin CHARACTERISTIC FCdtc_SPK8_IGBT_T "FCtl_DTC(516)" VALUE 0x001E3C72 /* @ECU_Address@FCtl_DTC@0x021B5408@ */ ECIPP_ALIGNMENT_UWORD 65535 Compu_IDENTITY 0 65535 PHYS_UNIT "DTC" /end CHARACTERISTIC
/begin CHARACTERISTIC FCdtc_SPK9_IGBT_T "FCtl_DTC(517)" VALUE 0x001E3C74 /* @ECU_Address@FCtl_DTC@0x021B540A@ */ ECIPP_ALIGNMENT_UWORD 65535 Compu_IDENTITY 0 65535 PHYS_UNIT "DTC" /end CHARACTERISTIC
/begin CHARACTERISTIC FCdtc_SPKD10_coil_fail "FCtl_DTC(313)" VALUE 0x001E3ADC /* @ECU_Address@FCtl_DTC@0x021B5272@ */ ECIPP_ALIGNMENT_UWORD 65535 Compu_IDENTITY 0 65535 PHYS_UNIT "DTC" /end CHARACTERISTIC
/begin CHARACTERISTIC FCdtc_SPKD10_dw_hi "FCtl_DTC(85)" VALUE 0x001E3914 /* @ECU_Address@FCtl_DTC@0x021B50AA@ */ ECIPP_ALIGNMENT_UWORD 65535 Compu_IDENTITY 0 65535 PHYS_UNIT "DTC" /end CHARACTERISTIC
/begin CHARACTERISTIC FCdtc_SPKD10_dw_lo "FCtl_DTC(75)" VALUE 0x001E3900 /* @ECU_Address@FCtl_DTC@0x021B5096@ */ ECIPP_ALIGNMENT_UWORD 65535 Compu_IDENTITY 0 65535 PHYS_UNIT "DTC" /end CHARACTERISTIC
/begin CHARACTERISTIC FCdtc_SPKD11_coil_fail "FCtl_DTC(1027)" VALUE 0x001E4070 /* @ECU_Address@FCtl_DTC@0x021B5806@ */ ECIPP_ALIGNMENT_UWORD 65535 Compu_IDENTITY 0 65535 PHYS_UNIT "DTC" /end CHARACTERISTIC
/begin CHARACTERISTIC FCdtc_SPKD11_dw_hi "FCtl_DTC(1025)" VALUE 0x001E406C /* @ECU_Address@FCtl_DTC@0x021B5802@ */ ECIPP_ALIGNMENT_UWORD 65535 Compu_IDENTITY 0 65535 PHYS_UNIT "DTC" /end CHARACTERISTIC
/begin CHARACTERISTIC FCdtc_SPKD11_dw_lo "FCtl_DTC(1023)" VALUE 0x001E4068 /* @ECU_Address@FCtl_DTC@0x021B57FE@ */ ECIPP_ALIGNMENT_UWORD 65535 Compu_IDENTITY 0 65535 PHYS_UNIT "DTC" /end CHARACTERISTIC
/begin CHARACTERISTIC FCdtc_SPKD12_coil_fail "FCtl_DTC(1028)" VALUE 0x001E4072 /* @ECU_Address@FCtl_DTC@0x021B5808@ */ ECIPP_ALIGNMENT_UWORD 65535 Compu_IDENTITY 0 65535 PHYS_UNIT "DTC" /end CHARACTERISTIC
/begin CHARACTERISTIC FCdtc_SPKD12_dw_hi "FCtl_DTC(1026)" VALUE 0x001E406E /* @ECU_Address@FCtl_DTC@0x021B5804@ */ ECIPP_ALIGNMENT_UWORD 65535 Compu_IDENTITY 0 65535 PHYS_UNIT "DTC" /end CHARACTERISTIC
/begin CHARACTERISTIC FCdtc_SPKD12_dw_lo "FCtl_DTC(1024)" VALUE 0x001E406A /* @ECU_Address@FCtl_DTC@0x021B5800@ */ ECIPP_ALIGNMENT_UWORD 65535 Compu_IDENTITY 0 65535 PHYS_UNIT "DTC" /end CHARACTERISTIC
/begin CHARACTERISTIC FCdtc_SPKD2_coil_fail "FCtl_DTC(305)" VALUE 0x001E3ACC /* @ECU_Address@FCtl_DTC@0x021B5262@ */ ECIPP_ALIGNMENT_UWORD 65535 Compu_IDENTITY 0 65535 PHYS_UNIT "DTC" /end CHARACTERISTIC
/begin CHARACTERISTIC FCdtc_SPKD2_dw_hi "FCtl_DTC(77)" VALUE 0x001E3904 /* @ECU_Address@FCtl_DTC@0x021B509A@ */ ECIPP_ALIGNMENT_UWORD 65535 Compu_IDENTITY 0 65535 PHYS_UNIT "DTC" /end CHARACTERISTIC
/begin CHARACTERISTIC FCdtc_SPKD2_dw_lo "FCtl_DTC(67)" VALUE 0x001E38F0 /* @ECU_Address@FCtl_DTC@0x021B5086@ */ ECIPP_ALIGNMENT_UWORD 65535 Compu_IDENTITY 0 65535 PHYS_UNIT "DTC" /end CHARACTERISTIC
/begin CHARACTERISTIC FCdtc_SPKD3_coil_fail "FCtl_DTC(306)" VALUE 0x001E3ACE /* @ECU_Address@FCtl_DTC@0x021B5264@ */ ECIPP_ALIGNMENT_UWORD 65535 Compu_IDENTITY 0 65535 PHYS_UNIT "DTC" /end CHARACTERISTIC
/begin CHARACTERISTIC FCdtc_SPKD3_dw_hi "FCtl_DTC(78)" VALUE 0x001E3906 /* @ECU_Address@FCtl_DTC@0x021B509C@ */ ECIPP_ALIGNMENT_UWORD 65535 Compu_IDENTITY 0 65535 PHYS_UNIT "DTC" /end CHARACTERISTIC
/begin CHARACTERISTIC FCdtc_SPKD3_dw_lo "FCtl_DTC(68)" VALUE 0x001E38F2 /* @ECU_Address@FCtl_DTC@0x021B5088@ */ ECIPP_ALIGNMENT_UWORD 65535 Compu_IDENTITY 0 65535 PHYS_UNIT "DTC" /end CHARACTERISTIC
/begin CHARACTERISTIC FCdtc_SPKD4_coil_fail "FCtl_DTC(307)" VALUE 0x001E3AD0 /* @ECU_Address@FCtl_DTC@0x021B5266@ */ ECIPP_ALIGNMENT_UWORD 65535 Compu_IDENTITY 0 65535 PHYS_UNIT "DTC" /end CHARACTERISTIC
/begin CHARACTERISTIC FCdtc_SPKD4_dw_hi "FCtl_DTC(79)" VALUE 0x001E3908 /* @ECU_Address@FCtl_DTC@0x021B509E@ */ ECIPP_ALIGNMENT_UWORD 65535 Compu_IDENTITY 0 65535 PHYS_UNIT "DTC" /end CHARACTERISTIC
/begin CHARACTERISTIC FCdtc_SPKD4_dw_lo "FCtl_DTC(69)" VALUE 0x001E38F4 /* @ECU_Address@FCtl_DTC@0x021B508A@ */ ECIPP_ALIGNMENT_UWORD 65535 Compu_IDENTITY 0 65535 PHYS_UNIT "DTC" /end CHARACTERISTIC
/begin CHARACTERISTIC FCdtc_SPKD5_coil_fail "FCtl_DTC(308)" VALUE 0x001E3AD2 /* @ECU_Address@FCtl_DTC@0x021B5268@ */ ECIPP_ALIGNMENT_UWORD 65535 Compu_IDENTITY 0 65535 PHYS_UNIT "DTC" /end CHARACTERISTIC
/begin CHARACTERISTIC FCdtc_SPKD5_dw_hi "FCtl_DTC(80)" VALUE 0x001E390A /* @ECU_Address@FCtl_DTC@0x021B50A0@ */ ECIPP_ALIGNMENT_UWORD 65535 Compu_IDENTITY 0 65535 PHYS_UNIT "DTC" /end CHARACTERISTIC
/begin CHARACTERISTIC FCdtc_SPKD5_dw_lo "FCtl_DTC(70)" VALUE 0x001E38F6 /* @ECU_Address@FCtl_DTC@0x021B508C@ */ ECIPP_ALIGNMENT_UWORD 65535 Compu_IDENTITY 0 65535 PHYS_UNIT "DTC" /end CHARACTERISTIC
/begin CHARACTERISTIC FCdtc_SPKD6_coil_fail "FCtl_DTC(309)" VALUE 0x001E3AD4 /* @ECU_Address@FCtl_DTC@0x021B526A@ */ ECIPP_ALIGNMENT_UWORD 65535 Compu_IDENTITY 0 65535 PHYS_UNIT "DTC" /end CHARACTERISTIC
/begin CHARACTERISTIC FCdtc_SPKD6_dw_hi "FCtl_DTC(81)" VALUE 0x001E390C /* @ECU_Address@FCtl_DTC@0x021B50A2@ */ ECIPP_ALIGNMENT_UWORD 65535 Compu_IDENTITY 0 65535 PHYS_UNIT "DTC" /end CHARACTERISTIC
/begin CHARACTERISTIC FCdtc_SPKD6_dw_lo "FCtl_DTC(71)" VALUE 0x001E38F8 /* @ECU_Address@FCtl_DTC@0x021B508E@ */ ECIPP_ALIGNMENT_UWORD 65535 Compu_IDENTITY 0 65535 PHYS_UNIT "DTC" /end CHARACTERISTIC
/begin CHARACTERISTIC FCdtc_SPKD7_coil_fail "FCtl_DTC(310)" VALUE 0x001E3AD6 /* @ECU_Address@FCtl_DTC@0x021B526C@ */ ECIPP_ALIGNMENT_UWORD 65535 Compu_IDENTITY 0 65535 PHYS_UNIT "DTC" /end CHARACTERISTIC
/begin CHARACTERISTIC FCdtc_SPKD7_dw_hi "FCtl_DTC(82)" VALUE 0x001E390E /* @ECU_Address@FCtl_DTC@0x021B50A4@ */ ECIPP_ALIGNMENT_UWORD 65535 Compu_IDENTITY 0 65535 PHYS_UNIT "DTC" /end CHARACTERISTIC
/begin CHARACTERISTIC FCdtc_SPKD7_dw_lo "FCtl_DTC(72)" VALUE 0x001E38FA /* @ECU_Address@FCtl_DTC@0x021B5090@ */ ECIPP_ALIGNMENT_UWORD 65535 Compu_IDENTITY 0 65535 PHYS_UNIT "DTC" /end CHARACTERISTIC
/begin CHARACTERISTIC FCdtc_SPKD8_coil_fail "FCtl_DTC(311)" VALUE 0x001E3AD8 /* @ECU_Address@FCtl_DTC@0x021B526E@ */ ECIPP_ALIGNMENT_UWORD 65535 Compu_IDENTITY 0 65535 PHYS_UNIT "DTC" /end CHARACTERISTIC
/begin CHARACTERISTIC FCdtc_SPKD8_dw_hi "FCtl_DTC(83)" VALUE 0x001E3910 /* @ECU_Address@FCtl_DTC@0x021B50A6@ */ ECIPP_ALIGNMENT_UWORD 65535 Compu_IDENTITY 0 65535 PHYS_UNIT "DTC" /end CHARACTERISTIC
/begin CHARACTERISTIC FCdtc_SPKD8_dw_lo "FCtl_DTC(73)" VALUE 0x001E38FC /* @ECU_Address@FCtl_DTC@0x021B5092@ */ ECIPP_ALIGNMENT_UWORD 65535 Compu_IDENTITY 0 65535 PHYS_UNIT "DTC" /end CHARACTERISTIC
/begin CHARACTERISTIC FCdtc_SPKD9_coil_fail "FCtl_DTC(312)" VALUE 0x001E3ADA /* @ECU_Address@FCtl_DTC@0x021B5270@ */ ECIPP_ALIGNMENT_UWORD 65535 Compu_IDENTITY 0 65535 PHYS_UNIT "DTC" /end CHARACTERISTIC
/begin CHARACTERISTIC FCdtc_SPKD9_dw_hi "FCtl_DTC(84)" VALUE 0x001E3912 /* @ECU_Address@FCtl_DTC@0x021B50A8@ */ ECIPP_ALIGNMENT_UWORD 65535 Compu_IDENTITY 0 65535 PHYS_UNIT "DTC" /end CHARACTERISTIC
/begin CHARACTERISTIC FCdtc_SPKD9_dw_lo "FCtl_DTC(74)" VALUE 0x001E38FE /* @ECU_Address@FCtl_DTC@0x021B5094@ */ ECIPP_ALIGNMENT_UWORD 65535 Compu_IDENTITY 0 65535 PHYS_UNIT "DTC" /end CHARACTERISTIC
/begin CHARACTERISTIC FCdtc_TANK_2_V_maxv "FCtl_DTC(872)" VALUE 0x001E3F3A /* @ECU_Address@FCtl_DTC@0x021B56D0@ */ ECIPP_ALIGNMENT_UWORD 65535 Compu_IDENTITY 0 65535 PHYS_UNIT "DTC" /end CHARACTERISTIC
/begin CHARACTERISTIC FCdtc_TANK_2_V_minv "FCtl_DTC(874)" VALUE 0x001E3F3E /* @ECU_Address@FCtl_DTC@0x021B56D4@ */ ECIPP_ALIGNMENT_UWORD 65535 Compu_IDENTITY 0 65535 PHYS_UNIT "DTC" /end CHARACTERISTIC
/begin CHARACTERISTIC FCdtc_TANK_2_V_slow "FCtl_DTC(876)" VALUE 0x001E3F42 /* @ECU_Address@FCtl_DTC@0x021B56D8@ */ ECIPP_ALIGNMENT_UWORD 65535 Compu_IDENTITY 0 65535 PHYS_UNIT "DTC" /end CHARACTERISTIC
/begin CHARACTERISTIC FCdtc_UGF_Hv_lo "FCtl_DTC(243)" VALUE 0x001E3A50 /* @ECU_Address@FCtl_DTC@0x021B51E6@ */ ECIPP_ALIGNMENT_UWORD 65535 Compu_IDENTITY 0 65535 PHYS_UNIT "DTC" /end CHARACTERISTIC
/begin CHARACTERISTIC FCdtc_UGF1_PR_hi "FCtl_DTC(257)" VALUE 0x001E3A6C /* @ECU_Address@FCtl_DTC@0x021B5202@ */ ECIPP_ALIGNMENT_UWORD 65535 Compu_IDENTITY 0 65535 PHYS_UNIT "DTC" /end CHARACTERISTIC
/begin CHARACTERISTIC FCdtc_UGF1_PR_lo "FCtl_DTC(258)" VALUE 0x001E3A6E /* @ECU_Address@FCtl_DTC@0x021B5204@ */ ECIPP_ALIGNMENT_UWORD 65535 Compu_IDENTITY 0 65535 PHYS_UNIT "DTC" /end CHARACTERISTIC
/begin CHARACTERISTIC FCdtc_UGF1_PR_slow "FCtl_DTC(255)" VALUE 0x001E3A68 /* @ECU_Address@FCtl_DTC@0x021B51FE@ */ ECIPP_ALIGNMENT_UWORD 65535 Compu_IDENTITY 0 65535 PHYS_UNIT "DTC" /end CHARACTERISTIC
/begin CHARACTERISTIC FCdtc_UGF1_Pv_hi "FCtl_DTC(252)" VALUE 0x001E3A62 /* @ECU_Address@FCtl_DTC@0x021B51F8@ */ ECIPP_ALIGNMENT_UWORD 65535 Compu_IDENTITY 0 65535 PHYS_UNIT "DTC" /end CHARACTERISTIC
/begin CHARACTERISTIC FCdtc_UGF1_Pv_lo "FCtl_DTC(253)" VALUE 0x001E3A64 /* @ECU_Address@FCtl_DTC@0x021B51FA@ */ ECIPP_ALIGNMENT_UWORD 65535 Compu_IDENTITY 0 65535 PHYS_UNIT "DTC" /end CHARACTERISTIC
/begin CHARACTERISTIC FCdtc_UGF1_PvFB_hi "FCtl_DTC(248)" VALUE 0x001E3A5A /* @ECU_Address@FCtl_DTC@0x021B51F0@ */ ECIPP_ALIGNMENT_UWORD 65535 Compu_IDENTITY 0 65535 PHYS_UNIT "DTC" /end CHARACTERISTIC
/begin CHARACTERISTIC FCdtc_UGF1_PvFB_lo "FCtl_DTC(249)" VALUE 0x001E3A5C /* @ECU_Address@FCtl_DTC@0x021B51F2@ */ ECIPP_ALIGNMENT_UWORD 65535 Compu_IDENTITY 0 65535 PHYS_UNIT "DTC" /end CHARACTERISTIC
/begin CHARACTERISTIC FCdtc_UGF1_R_lo "FCtl_DTC(245)" VALUE 0x001E3A54 /* @ECU_Address@FCtl_DTC@0x021B51EA@ */ ECIPP_ALIGNMENT_UWORD 65535 Compu_IDENTITY 0 65535 PHYS_UNIT "DTC" /end CHARACTERISTIC
/begin CHARACTERISTIC FCdtc_UGF1_rtn_hi "FCtl_DTC(246)" VALUE 0x001E3A56 /* @ECU_Address@FCtl_DTC@0x021B51EC@ */ ECIPP_ALIGNMENT_UWORD 65535 Compu_IDENTITY 0 65535 PHYS_UNIT "DTC" /end CHARACTERISTIC
/begin CHARACTERISTIC FCdtc_UGF1_rtn_lo "FCtl_DTC(247)" VALUE 0x001E3A58 /* @ECU_Address@FCtl_DTC@0x021B51EE@ */ ECIPP_ALIGNMENT_UWORD 65535 Compu_IDENTITY 0 65535 PHYS_UNIT "DTC" /end CHARACTERISTIC
/begin CHARACTERISTIC FCdtc_UGF1_Sv_lo "FCtl_DTC(251)" VALUE 0x001E3A60 /* @ECU_Address@FCtl_DTC@0x021B51F6@ */ ECIPP_ALIGNMENT_UWORD 65535 Compu_IDENTITY 0 65535 PHYS_UNIT "DTC" /end CHARACTERISTIC
/begin CHARACTERISTIC FCdtc_UGF2_Hv_lo "FCtl_DTC(410)" VALUE 0x001E3B9E /* @ECU_Address@FCtl_DTC@0x021B5334@ */ ECIPP_ALIGNMENT_UWORD 65535 Compu_IDENTITY 0 65535 PHYS_UNIT "DTC" /end CHARACTERISTIC
/begin CHARACTERISTIC FCdtc_UGF2_PR_hi "FCtl_DTC(424)" VALUE 0x001E3BBA /* @ECU_Address@FCtl_DTC@0x021B5350@ */ ECIPP_ALIGNMENT_UWORD 65535 Compu_IDENTITY 0 65535 PHYS_UNIT "DTC" /end CHARACTERISTIC
/begin CHARACTERISTIC FCdtc_UGF2_PR_lo "FCtl_DTC(425)" VALUE 0x001E3BBC /* @ECU_Address@FCtl_DTC@0x021B5352@ */ ECIPP_ALIGNMENT_UWORD 65535 Compu_IDENTITY 0 65535 PHYS_UNIT "DTC" /end CHARACTERISTIC
/begin CHARACTERISTIC FCdtc_UGF2_PR_slow "FCtl_DTC(422)" VALUE 0x001E3BB6 /* @ECU_Address@FCtl_DTC@0x021B534C@ */ ECIPP_ALIGNMENT_UWORD 65535 Compu_IDENTITY 0 65535 PHYS_UNIT "DTC" /end CHARACTERISTIC
/begin CHARACTERISTIC FCdtc_UGF2_Pv_hi "FCtl_DTC(419)" VALUE 0x001E3BB0 /* @ECU_Address@FCtl_DTC@0x021B5346@ */ ECIPP_ALIGNMENT_UWORD 65535 Compu_IDENTITY 0 65535 PHYS_UNIT "DTC" /end CHARACTERISTIC
/begin CHARACTERISTIC FCdtc_UGF2_Pv_lo "FCtl_DTC(420)" VALUE 0x001E3BB2 /* @ECU_Address@FCtl_DTC@0x021B5348@ */ ECIPP_ALIGNMENT_UWORD 65535 Compu_IDENTITY 0 65535 PHYS_UNIT "DTC" /end CHARACTERISTIC
/begin CHARACTERISTIC FCdtc_UGF2_PvFB_hi "FCtl_DTC(415)" VALUE 0x001E3BA8 /* @ECU_Address@FCtl_DTC@0x021B533E@ */ ECIPP_ALIGNMENT_UWORD 65535 Compu_IDENTITY 0 65535 PHYS_UNIT "DTC" /end CHARACTERISTIC
/begin CHARACTERISTIC FCdtc_UGF2_PvFB_lo "FCtl_DTC(416)" VALUE 0x001E3BAA /* @ECU_Address@FCtl_DTC@0x021B5340@ */ ECIPP_ALIGNMENT_UWORD 65535 Compu_IDENTITY 0 65535 PHYS_UNIT "DTC" /end CHARACTERISTIC
/begin CHARACTERISTIC FCdtc_UGF2_R_lo "FCtl_DTC(412)" VALUE 0x001E3BA2 /* @ECU_Address@FCtl_DTC@0x021B5338@ */ ECIPP_ALIGNMENT_UWORD 65535 Compu_IDENTITY 0 65535 PHYS_UNIT "DTC" /end CHARACTERISTIC
/begin CHARACTERISTIC FCdtc_UGF2_rtn_hi "FCtl_DTC(413)" VALUE 0x001E3BA4 /* @ECU_Address@FCtl_DTC@0x021B533A@ */ ECIPP_ALIGNMENT_UWORD 65535 Compu_IDENTITY 0 65535 PHYS_UNIT "DTC" /end CHARACTERISTIC
/begin CHARACTERISTIC FCdtc_UGF2_rtn_lo "FCtl_DTC(414)" VALUE 0x001E3BA6 /* @ECU_Address@FCtl_DTC@0x021B533C@ */ ECIPP_ALIGNMENT_UWORD 65535 Compu_IDENTITY 0 65535 PHYS_UNIT "DTC" /end CHARACTERISTIC
/begin CHARACTERISTIC FCdtc_UGF2_Sv_lo "FCtl_DTC(418)" VALUE 0x001E3BAE /* @ECU_Address@FCtl_DTC@0x021B5344@ */ ECIPP_ALIGNMENT_UWORD 65535 Compu_IDENTITY 0 65535 PHYS_UNIT "DTC" /end CHARACTERISTIC
/begin CHARACTERISTIC FCdtc_UGF3_Hv_lo "FCtl_DTC(606)" VALUE 0x001E3D26 /* @ECU_Address@FCtl_DTC@0x021B54BC@ */ ECIPP_ALIGNMENT_UWORD 65535 Compu_IDENTITY 0 65535 PHYS_UNIT "DTC" /end CHARACTERISTIC
/begin CHARACTERISTIC FCdtc_UGF3_PR_hi "FCtl_DTC(620)" VALUE 0x001E3D42 /* @ECU_Address@FCtl_DTC@0x021B54D8@ */ ECIPP_ALIGNMENT_UWORD 65535 Compu_IDENTITY 0 65535 PHYS_UNIT "DTC" /end CHARACTERISTIC
/begin CHARACTERISTIC FCdtc_UGF3_PR_lo "FCtl_DTC(621)" VALUE 0x001E3D44 /* @ECU_Address@FCtl_DTC@0x021B54DA@ */ ECIPP_ALIGNMENT_UWORD 65535 Compu_IDENTITY 0 65535 PHYS_UNIT "DTC" /end CHARACTERISTIC
/begin CHARACTERISTIC FCdtc_UGF3_PR_slow "FCtl_DTC(618)" VALUE 0x001E3D3E /* @ECU_Address@FCtl_DTC@0x021B54D4@ */ ECIPP_ALIGNMENT_UWORD 65535 Compu_IDENTITY 0 65535 PHYS_UNIT "DTC" /end CHARACTERISTIC
/begin CHARACTERISTIC FCdtc_UGF3_Pv_hi "FCtl_DTC(615)" VALUE 0x001E3D38 /* @ECU_Address@FCtl_DTC@0x021B54CE@ */ ECIPP_ALIGNMENT_UWORD 65535 Compu_IDENTITY 0 65535 PHYS_UNIT "DTC" /end CHARACTERISTIC
/begin CHARACTERISTIC FCdtc_UGF3_Pv_lo "FCtl_DTC(616)" VALUE 0x001E3D3A /* @ECU_Address@FCtl_DTC@0x021B54D0@ */ ECIPP_ALIGNMENT_UWORD 65535 Compu_IDENTITY 0 65535 PHYS_UNIT "DTC" /end CHARACTERISTIC
/begin CHARACTERISTIC FCdtc_UGF3_PvFB_hi "FCtl_DTC(611)" VALUE 0x001E3D30 /* @ECU_Address@FCtl_DTC@0x021B54C6@ */ ECIPP_ALIGNMENT_UWORD 65535 Compu_IDENTITY 0 65535 PHYS_UNIT "DTC" /end CHARACTERISTIC
/begin CHARACTERISTIC FCdtc_UGF3_PvFB_lo "FCtl_DTC(612)" VALUE 0x001E3D32 /* @ECU_Address@FCtl_DTC@0x021B54C8@ */ ECIPP_ALIGNMENT_UWORD 65535 Compu_IDENTITY 0 65535 PHYS_UNIT "DTC" /end CHARACTERISTIC
/begin CHARACTERISTIC FCdtc_UGF3_R_lo "FCtl_DTC(608)" VALUE 0x001E3D2A /* @ECU_Address@FCtl_DTC@0x021B54C0@ */ ECIPP_ALIGNMENT_UWORD 65535 Compu_IDENTITY 0 65535 PHYS_UNIT "DTC" /end CHARACTERISTIC
/begin CHARACTERISTIC FCdtc_UGF3_rtn_hi "FCtl_DTC(609)" VALUE 0x001E3D2C /* @ECU_Address@FCtl_DTC@0x021B54C2@ */ ECIPP_ALIGNMENT_UWORD 65535 Compu_IDENTITY 0 65535 PHYS_UNIT "DTC" /end CHARACTERISTIC
/begin CHARACTERISTIC FCdtc_UGF3_rtn_lo "FCtl_DTC(610)" VALUE 0x001E3D2E /* @ECU_Address@FCtl_DTC@0x021B54C4@ */ ECIPP_ALIGNMENT_UWORD 65535 Compu_IDENTITY 0 65535 PHYS_UNIT "DTC" /end CHARACTERISTIC
/begin CHARACTERISTIC FCdtc_UGF3_Sv_lo "FCtl_DTC(614)" VALUE 0x001E3D36 /* @ECU_Address@FCtl_DTC@0x021B54CC@ */ ECIPP_ALIGNMENT_UWORD 65535 Compu_IDENTITY 0 65535 PHYS_UNIT "DTC" /end CHARACTERISTIC
/begin CHARACTERISTIC FCdtc_UGF4_Hv_lo "FCtl_DTC(629)" VALUE 0x001E3D54 /* @ECU_Address@FCtl_DTC@0x021B54EA@ */ ECIPP_ALIGNMENT_UWORD 65535 Compu_IDENTITY 0 65535 PHYS_UNIT "DTC" /end CHARACTERISTIC
/begin CHARACTERISTIC FCdtc_UGF4_PR_hi "FCtl_DTC(643)" VALUE 0x001E3D70 /* @ECU_Address@FCtl_DTC@0x021B5506@ */ ECIPP_ALIGNMENT_UWORD 65535 Compu_IDENTITY 0 65535 PHYS_UNIT "DTC" /end CHARACTERISTIC
/begin CHARACTERISTIC FCdtc_UGF4_PR_lo "FCtl_DTC(644)" VALUE 0x001E3D72 /* @ECU_Address@FCtl_DTC@0x021B5508@ */ ECIPP_ALIGNMENT_UWORD 65535 Compu_IDENTITY 0 65535 PHYS_UNIT "DTC" /end CHARACTERISTIC
/begin CHARACTERISTIC FCdtc_UGF4_PR_slow "FCtl_DTC(641)" VALUE 0x001E3D6C /* @ECU_Address@FCtl_DTC@0x021B5502@ */ ECIPP_ALIGNMENT_UWORD 65535 Compu_IDENTITY 0 65535 PHYS_UNIT "DTC" /end CHARACTERISTIC
/begin CHARACTERISTIC FCdtc_UGF4_Pv_hi "FCtl_DTC(638)" VALUE 0x001E3D66 /* @ECU_Address@FCtl_DTC@0x021B54FC@ */ ECIPP_ALIGNMENT_UWORD 65535 Compu_IDENTITY 0 65535 PHYS_UNIT "DTC" /end CHARACTERISTIC
/begin CHARACTERISTIC FCdtc_UGF4_Pv_lo "FCtl_DTC(639)" VALUE 0x001E3D68 /* @ECU_Address@FCtl_DTC@0x021B54FE@ */ ECIPP_ALIGNMENT_UWORD 65535 Compu_IDENTITY 0 65535 PHYS_UNIT "DTC" /end CHARACTERISTIC
/begin CHARACTERISTIC FCdtc_UGF4_PvFB_hi "FCtl_DTC(634)" VALUE 0x001E3D5E /* @ECU_Address@FCtl_DTC@0x021B54F4@ */ ECIPP_ALIGNMENT_UWORD 65535 Compu_IDENTITY 0 65535 PHYS_UNIT "DTC" /end CHARACTERISTIC
/begin CHARACTERISTIC FCdtc_UGF4_PvFB_lo "FCtl_DTC(635)" VALUE 0x001E3D60 /* @ECU_Address@FCtl_DTC@0x021B54F6@ */ ECIPP_ALIGNMENT_UWORD 65535 Compu_IDENTITY 0 65535 PHYS_UNIT "DTC" /end CHARACTERISTIC
/begin CHARACTERISTIC FCdtc_UGF4_R_lo "FCtl_DTC(631)" VALUE 0x001E3D58 /* @ECU_Address@FCtl_DTC@0x021B54EE@ */ ECIPP_ALIGNMENT_UWORD 65535 Compu_IDENTITY 0 65535 PHYS_UNIT "DTC" /end CHARACTERISTIC
/begin CHARACTERISTIC FCdtc_UGF4_rtn_hi "FCtl_DTC(632)" VALUE 0x001E3D5A /* @ECU_Address@FCtl_DTC@0x021B54F0@ */ ECIPP_ALIGNMENT_UWORD 65535 Compu_IDENTITY 0 65535 PHYS_UNIT "DTC" /end CHARACTERISTIC
/begin CHARACTERISTIC FCdtc_UGF4_rtn_lo "FCtl_DTC(633)" VALUE 0x001E3D5C /* @ECU_Address@FCtl_DTC@0x021B54F2@ */ ECIPP_ALIGNMENT_UWORD 65535 Compu_IDENTITY 0 65535 PHYS_UNIT "DTC" /end CHARACTERISTIC
/begin CHARACTERISTIC FCdtc_UGF4_Sv_lo "FCtl_DTC(637)" VALUE 0x001E3D64 /* @ECU_Address@FCtl_DTC@0x021B54FA@ */ ECIPP_ALIGNMENT_UWORD 65535 Compu_IDENTITY 0 65535 PHYS_UNIT "DTC" /end CHARACTERISTIC
/begin CHARACTERISTIC FCfmi_AL2_hi "FCtl_FMI(40)" VALUE 0x001E5929 /* @ECU_Address@FCtl_FMI@0x021B7028@ */ ECIPP_ALIGNMENT_UBYTE 255 Compu_IDENTITY 0 255 PHYS_UNIT "FMI" /end CHARACTERISTIC
/begin CHARACTERISTIC FCfmi_AL2_lo "FCtl_FMI(41)" VALUE 0x001E592A /* @ECU_Address@FCtl_FMI@0x021B7029@ */ ECIPP_ALIGNMENT_UBYTE 255 Compu_IDENTITY 0 255 PHYS_UNIT "FMI" /end CHARACTERISTIC
/begin CHARACTERISTIC FCfmi_CD_MF10 "FCtl_FMI(994)" VALUE 0x001E5CE3 /* @ECU_Address@FCtl_FMI@0x021B73E2@ */ ECIPP_ALIGNMENT_UBYTE 255 Compu_IDENTITY 0 255 PHYS_UNIT "FMI" /end CHARACTERISTIC
/begin CHARACTERISTIC FCfmi_CD_MF11 "FCtl_FMI(995)" VALUE 0x001E5CE4 /* @ECU_Address@FCtl_FMI@0x021B73E3@ */ ECIPP_ALIGNMENT_UBYTE 255 Compu_IDENTITY 0 255 PHYS_UNIT "FMI" /end CHARACTERISTIC
/begin CHARACTERISTIC FCfmi_CD_MF12 "FCtl_FMI(996)" VALUE 0x001E5CE5 /* @ECU_Address@FCtl_FMI@0x021B73E4@ */ ECIPP_ALIGNMENT_UBYTE 255 Compu_IDENTITY 0 255 PHYS_UNIT "FMI" /end CHARACTERISTIC
/begin CHARACTERISTIC FCfmi_CD_MF2 "FCtl_FMI(986)" VALUE 0x001E5CDB /* @ECU_Address@FCtl_FMI@0x021B73DA@ */ ECIPP_ALIGNMENT_UBYTE 255 Compu_IDENTITY 0 255 PHYS_UNIT "FMI" /end CHARACTERISTIC
/begin CHARACTERISTIC FCfmi_CD_MF3 "FCtl_FMI(987)" VALUE 0x001E5CDC /* @ECU_Address@FCtl_FMI@0x021B73DB@ */ ECIPP_ALIGNMENT_UBYTE 255 Compu_IDENTITY 0 255 PHYS_UNIT "FMI" /end CHARACTERISTIC
/begin CHARACTERISTIC FCfmi_CD_MF4 "FCtl_FMI(988)" VALUE 0x001E5CDD /* @ECU_Address@FCtl_FMI@0x021B73DC@ */ ECIPP_ALIGNMENT_UBYTE 255 Compu_IDENTITY 0 255 PHYS_UNIT "FMI" /end CHARACTERISTIC
/begin CHARACTERISTIC FCfmi_CD_MF5 "FCtl_FMI(989)" VALUE 0x001E5CDE /* @ECU_Address@FCtl_FMI@0x021B73DD@ */ ECIPP_ALIGNMENT_UBYTE 255 Compu_IDENTITY 0 255 PHYS_UNIT "FMI" /end CHARACTERISTIC
/begin CHARACTERISTIC FCfmi_CD_MF6 "FCtl_FMI(990)" VALUE 0x001E5CDF /* @ECU_Address@FCtl_FMI@0x021B73DE@ */ ECIPP_ALIGNMENT_UBYTE 255 Compu_IDENTITY 0 255 PHYS_UNIT "FMI" /end CHARACTERISTIC
/begin CHARACTERISTIC FCfmi_CD_MF7 "FCtl_FMI(991)" VALUE 0x001E5CE0 /* @ECU_Address@FCtl_FMI@0x021B73DF@ */ ECIPP_ALIGNMENT_UBYTE 255 Compu_IDENTITY 0 255 PHYS_UNIT "FMI" /end CHARACTERISTIC
/begin CHARACTERISTIC FCfmi_CD_MF8 "FCtl_FMI(992)" VALUE 0x001E5CE1 /* @ECU_Address@FCtl_FMI@0x021B73E0@ */ ECIPP_ALIGNMENT_UBYTE 255 Compu_IDENTITY 0 255 PHYS_UNIT "FMI" /end CHARACTERISTIC
/begin CHARACTERISTIC FCfmi_CD_MF9 "FCtl_FMI(993)" VALUE 0x001E5CE2 /* @ECU_Address@FCtl_FMI@0x021B73E1@ */ ECIPP_ALIGNMENT_UBYTE 255 Compu_IDENTITY 0 255 PHYS_UNIT "FMI" /end CHARACTERISTIC
/begin CHARACTERISTIC FCfmi_CFVxminFT "FCtl_FMI(533)" VALUE 0x001E5B16 /* @ECU_Address@FCtl_FMI@0x021B7215@ */ ECIPP_ALIGNMENT_UBYTE 255 Compu_IDENTITY 0 255 PHYS_UNIT "FMI" /end CHARACTERISTIC
/begin CHARACTERISTIC FCfmi_CL2_hi "FCtl_FMI(34)" VALUE 0x001E5923 /* @ECU_Address@FCtl_FMI@0x021B7022@ */ ECIPP_ALIGNMENT_UBYTE 255 Compu_IDENTITY 0 255 PHYS_UNIT "FMI" /end CHARACTERISTIC
/begin CHARACTERISTIC FCfmi_CL2_lo "FCtl_FMI(35)" VALUE 0x001E5924 /* @ECU_Address@FCtl_FMI@0x021B7023@ */ ECIPP_ALIGNMENT_UBYTE 255 Compu_IDENTITY 0 255 PHYS_UNIT "FMI" /end CHARACTERISTIC
/begin CHARACTERISTIC FCfmi_CM2_unresp "FCtl_FMI(800)" VALUE 0x001E5C21 /* @ECU_Address@FCtl_FMI@0x021B7320@ */ ECIPP_ALIGNMENT_UBYTE 255 Compu_IDENTITY 0 255 PHYS_UNIT "FMI" /end CHARACTERISTIC
/begin CHARACTERISTIC FCfmi_CM2gsln_inact "FCtl_FMI(199)" VALUE 0x001E59C8 /* @ECU_Address@FCtl_FMI@0x021B70C7@ */ ECIPP_ALIGNMENT_UBYTE 255 Compu_IDENTITY 0 255 PHYS_UNIT "FMI" /end CHARACTERISTIC
/begin CHARACTERISTIC FCfmi_EGO4_open "FCtl_FMI(200)" VALUE 0x001E59C9 /* @ECU_Address@FCtl_FMI@0x021B70C8@ */ ECIPP_ALIGNMENT_UBYTE 255 Compu_IDENTITY 0 255 PHYS_UNIT "FMI" /end CHARACTERISTIC
/begin CHARACTERISTIC FCfmi_EMWT2_HiExp1 "FCtl_FMI(226)" VALUE 0x001E59E3 /* @ECU_Address@FCtl_FMI@0x021B70E2@ */ ECIPP_ALIGNMENT_UBYTE 255 Compu_IDENTITY 0 255 PHYS_UNIT "FMI" /end CHARACTERISTIC
/begin CHARACTERISTIC FCfmi_EMWT2_HiExp2 "FCtl_FMI(228)" VALUE 0x001E59E5 /* @ECU_Address@FCtl_FMI@0x021B70E4@ */ ECIPP_ALIGNMENT_UBYTE 255 Compu_IDENTITY 0 255 PHYS_UNIT "FMI" /end CHARACTERISTIC
/begin CHARACTERISTIC FCfmi_EMWT2_maxv "FCtl_FMI(222)" VALUE 0x001E59DF /* @ECU_Address@FCtl_FMI@0x021B70DE@ */ ECIPP_ALIGNMENT_UBYTE 255 Compu_IDENTITY 0 255 PHYS_UNIT "FMI" /end CHARACTERISTIC
/begin CHARACTERISTIC FCfmi_EMWT2_minv "FCtl_FMI(224)" VALUE 0x001E59E1 /* @ECU_Address@FCtl_FMI@0x021B70E0@ */ ECIPP_ALIGNMENT_UBYTE 255 Compu_IDENTITY 0 255 PHYS_UNIT "FMI" /end CHARACTERISTIC
/begin CHARACTERISTIC FCfmi_ERWT2_HiExp1 "FCtl_FMI(238)" VALUE 0x001E59EF /* @ECU_Address@FCtl_FMI@0x021B70EE@ */ ECIPP_ALIGNMENT_UBYTE 255 Compu_IDENTITY 0 255 PHYS_UNIT "FMI" /end CHARACTERISTIC
/begin CHARACTERISTIC FCfmi_ERWT2_HiExp2 "FCtl_FMI(240)" VALUE 0x001E59F1 /* @ECU_Address@FCtl_FMI@0x021B70F0@ */ ECIPP_ALIGNMENT_UBYTE 255 Compu_IDENTITY 0 255 PHYS_UNIT "FMI" /end CHARACTERISTIC
/begin CHARACTERISTIC FCfmi_ERWT2_maxv "FCtl_FMI(234)" VALUE 0x001E59EB /* @ECU_Address@FCtl_FMI@0x021B70EA@ */ ECIPP_ALIGNMENT_UBYTE 255 Compu_IDENTITY 0 255 PHYS_UNIT "FMI" /end CHARACTERISTIC
/begin CHARACTERISTIC FCfmi_ERWT2_minv "FCtl_FMI(236)" VALUE 0x001E59ED /* @ECU_Address@FCtl_FMI@0x021B70EC@ */ ECIPP_ALIGNMENT_UBYTE 255 Compu_IDENTITY 0 255 PHYS_UNIT "FMI" /end CHARACTERISTIC
/begin CHARACTERISTIC FCfmi_GLOW10_open "FCtl_FMI(492)" VALUE 0x001E5AED /* @ECU_Address@FCtl_FMI@0x021B71EC@ */ ECIPP_ALIGNMENT_UBYTE 255 Compu_IDENTITY 0 255 PHYS_UNIT "FMI" /end CHARACTERISTIC
/begin CHARACTERISTIC FCfmi_GLOW10_short "FCtl_FMI(502)" VALUE 0x001E5AF7 /* @ECU_Address@FCtl_FMI@0x021B71F6@ */ ECIPP_ALIGNMENT_UBYTE 255 Compu_IDENTITY 0 255 PHYS_UNIT "FMI" /end CHARACTERISTIC
/begin CHARACTERISTIC FCfmi_GLOW11_open "FCtl_FMI(1033)" VALUE 0x001E5D0A /* @ECU_Address@FCtl_FMI@0x021B7409@ */ ECIPP_ALIGNMENT_UBYTE 255 Compu_IDENTITY 0 255 PHYS_UNIT "FMI" /end CHARACTERISTIC
/begin CHARACTERISTIC FCfmi_GLOW11_short "FCtl_FMI(1035)" VALUE 0x001E5D0C /* @ECU_Address@FCtl_FMI@0x021B740B@ */ ECIPP_ALIGNMENT_UBYTE 255 Compu_IDENTITY 0 255 PHYS_UNIT "FMI" /end CHARACTERISTIC
/begin CHARACTERISTIC FCfmi_GLOW12_open "FCtl_FMI(1034)" VALUE 0x001E5D0B /* @ECU_Address@FCtl_FMI@0x021B740A@ */ ECIPP_ALIGNMENT_UBYTE 255 Compu_IDENTITY 0 255 PHYS_UNIT "FMI" /end CHARACTERISTIC
/begin CHARACTERISTIC FCfmi_GLOW12_short "FCtl_FMI(1036)" VALUE 0x001E5D0D /* @ECU_Address@FCtl_FMI@0x021B740C@ */ ECIPP_ALIGNMENT_UBYTE 255 Compu_IDENTITY 0 255 PHYS_UNIT "FMI" /end CHARACTERISTIC
/end MODULE
/end PROJECT
